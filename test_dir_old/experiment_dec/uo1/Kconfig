## test_dir_old/experiment_dec_copy/uo2/Kconfig
```kconfig
config AAA 
  bool "AAA"

choice NAMED_CH
  depends on AAA
  config CH_C
    bool "Op C" 
  config CH_D
    bool "Op D" 
endchoice 
```

## transform_projects/transform_px4/PX4_output/platforms/common/Kconfig
```kconfig
source "platforms/common/px4_work_queue/Kconfig"
source "platforms/common/uORB/Kconfig"
```

## transform_projects/transform_px4/PX4_output/src/drivers/Kconfig
```kconfig
source "src/drivers/actuators/Kconfig"
source "src/drivers/adc/Kconfig"
source "src/drivers/barometer/Kconfig"
source "src/drivers/batt_smbus/Kconfig"
source "src/drivers/bootloaders/Kconfig"
source "src/drivers/camera_capture/Kconfig"
source "src/drivers/camera_trigger/Kconfig"
source "src/drivers/cdcacm_autostart/Kconfig"
source "src/drivers/cyphal/Kconfig"
source "src/drivers/differential_pressure/Kconfig"
source "src/drivers/distance_sensor/Kconfig"
source "src/drivers/dshot/Kconfig"
source "src/drivers/gpio/Kconfig"
source "src/drivers/gps/Kconfig"
source "src/drivers/heater/Kconfig"
source "src/drivers/hygrometer/Kconfig"
source "src/drivers/imu/Kconfig"
source "src/drivers/ins/Kconfig"
source "src/drivers/irlock/Kconfig"
source "src/drivers/lights/Kconfig"
source "src/drivers/linux_pwm_out/Kconfig"
source "src/drivers/magnetometer/Kconfig"
source "src/drivers/optical_flow/Kconfig"
source "src/drivers/osd/Kconfig"
source "src/drivers/pca9685_pwm_out/Kconfig"
source "src/drivers/power_monitor/Kconfig"
source "src/drivers/pps_capture/Kconfig"
source "src/drivers/pwm_input/Kconfig"
source "src/drivers/pwm_out/Kconfig"
source "src/drivers/px4io/Kconfig"
source "src/drivers/qshell/Kconfig"
source "src/drivers/rc/Kconfig"
source "src/drivers/rc_input/Kconfig"
source "src/drivers/roboclaw/Kconfig"
source "src/drivers/rpi_rc_in/Kconfig"
source "src/drivers/rpm/Kconfig"
source "src/drivers/rpm_capture/Kconfig"
source "src/drivers/safety_button/Kconfig"
source "src/drivers/smart_battery/Kconfig"
source "src/drivers/stub_keystore/Kconfig"
source "src/drivers/sw_crypto/Kconfig"
source "src/drivers/tap_esc/Kconfig"
source "src/drivers/tattu_can/Kconfig"
source "src/drivers/telemetry/Kconfig"
source "src/drivers/temperature_sensor/Kconfig"
source "src/drivers/test_ppm/Kconfig"
source "src/drivers/tone_alarm/Kconfig"
source "src/drivers/transponder/Kconfig"
source "src/drivers/uavcan/Kconfig"
source "src/drivers/uavcannode/Kconfig"
source "src/drivers/uwb/Kconfig"
source "src/drivers/voxl2_io/Kconfig"
source "src/drivers/wind_sensor/Kconfig"
```

## transform_projects/transform_px4/PX4_output/src/drivers/actuators/Kconfig
```kconfig
menu "actuators"
source "src/drivers/actuators/vertiq_io/Kconfig"
source "src/drivers/actuators/voxl_esc/Kconfig"
endmenu #actuators
```

## transform_projects/transform_px4/PX4_output/src/drivers/adc/Kconfig
```kconfig
menu "ADC"
source "src/drivers/adc/ads1115/Kconfig"
source "src/drivers/adc/ads7953/Kconfig"
source "src/drivers/adc/board_adc/Kconfig"
source "src/drivers/adc/tla2528/Kconfig"
endmenu #ADC
```

## transform_projects/transform_px4/PX4_output/src/drivers/barometer/Kconfig
```kconfig
menu "barometer"
    menuconfig COMMON_BAROMETERS
        bool "Common barometers"
        default n
        select DRIVERS_BAROMETER_BMP280
        select DRIVERS_BAROMETER_BMP388
        select DRIVERS_BAROMETER_BMP581
        select DRIVERS_BAROMETER_DPS310
        select DRIVERS_BAROMETER_LPS22HB
        select DRIVERS_BAROMETER_LPS33HW
        select DRIVERS_BAROMETER_MS5611
        select DRIVERS_BAROMETER_MAIERTEK_MPC2520
        select DRIVERS_BAROMETER_GOERTEK_SPL06
        select DRIVERS_BAROMETER_GOERTEK_SPA06
        select DRIVERS_BAROMETER_INVENSENSE_ICP101XX
        select DRIVERS_BAROMETER_INVENSENSE_ICP201XX
        help
            Enable default set of barometer drivers
    source "src/drivers/barometer/bmp280/Kconfig"
    source "src/drivers/barometer/bmp388/Kconfig"
    source "src/drivers/barometer/bmp581/Kconfig"
    source "src/drivers/barometer/dps310/Kconfig"
    source "src/drivers/barometer/goertek/Kconfig"
    source "src/drivers/barometer/invensense/Kconfig"
    source "src/drivers/barometer/lps22hb/Kconfig"
    source "src/drivers/barometer/lps25h/Kconfig"
    source "src/drivers/barometer/lps33hw/Kconfig"
    source "src/drivers/barometer/mpl3115a2/Kconfig"
    source "src/drivers/barometer/ms5611/Kconfig"
    source "src/drivers/barometer/ms5837/Kconfig"
    source "src/drivers/barometer/tcbp001ta/Kconfig"
endmenu #barometer
```

## transform_projects/transform_px4/PX4_output/src/drivers/barometer/goertek/Kconfig
```kconfig
menu "Goertek"
source "src/drivers/barometer/goertek/spa06/Kconfig"
source "src/drivers/barometer/goertek/spl06/Kconfig"
endmenu #Goertek
```

## transform_projects/transform_px4/PX4_output/src/drivers/barometer/invensense/Kconfig
```kconfig
menu "InvenSense"
source "src/drivers/barometer/invensense/icp101xx/Kconfig"
source "src/drivers/barometer/invensense/icp201xx/Kconfig"
endmenu #InvenSense
```

## transform_projects/transform_px4/PX4_output/src/drivers/barometer/maiertek/Kconfig
```kconfig
#menu "Maiertek"
source "src/drivers/barometer/maiertek/mpc2520/Kconfig"
#endmenu #Maiertek
```

## transform_projects/transform_px4/PX4_output/src/drivers/differential_pressure/Kconfig
```kconfig
menu "Differential pressure"
    menuconfig COMMON_DIFFERENTIAL_PRESSURE
        bool "Common differential pressure module's"
        default n
        select DRIVERS_DIFFERENTIAL_PRESSURE_MS4525DO
        select DRIVERS_DIFFERENTIAL_PRESSURE_MS5525DSO
        select DRIVERS_DIFFERENTIAL_PRESSURE_SDP3X
        ---help---
            Enable default set of differential pressure drivers
    source "src/drivers/differential_pressure/asp5033/Kconfig"
    source "src/drivers/differential_pressure/auav/Kconfig"
    source "src/drivers/differential_pressure/ets/Kconfig"
    source "src/drivers/differential_pressure/ms4515/Kconfig"
    source "src/drivers/differential_pressure/ms4525do/Kconfig"
    source "src/drivers/differential_pressure/ms5525dso/Kconfig"
    source "src/drivers/differential_pressure/sdp3x/Kconfig"
endmenu
```

## transform_projects/transform_px4/PX4_output/src/drivers/distance_sensor/Kconfig
```kconfig
menu "Distance sensors"
    menuconfig COMMON_DISTANCE_SENSOR
        bool "Common distance sensor's"
        default n
        select DRIVERS_DISTANCE_SENSOR_LIGHTWARE_LASER_I2C
        select DRIVERS_DISTANCE_SENSOR_LIGHTWARE_LASER_SERIAL
        select DRIVERS_DISTANCE_SENSOR_LL40LS
        select DRIVERS_DISTANCE_SENSOR_TF02PRO
        select DRIVERS_DISTANCE_SENSOR_TFMINI
        select DRIVERS_DISTANCE_SENSOR_ULANDING_RADAR
        select DRIVERS_DISTANCE_SENSOR_VL53L0X
        select DRIVERS_DISTANCE_SENSOR_VL53L1X
        ---help---
            Enable default set of distance sensor drivers

    source "src/drivers/distance_sensor/cm8jl65/Kconfig"
    source "src/drivers/distance_sensor/gy_us42/Kconfig"
    source "src/drivers/distance_sensor/leddar_one/Kconfig"
    source "src/drivers/distance_sensor/lightware_laser_i2c/Kconfig"
    source "src/drivers/distance_sensor/lightware_laser_serial/Kconfig"
    source "src/drivers/distance_sensor/lightware_sf45_serial/Kconfig"
    source "src/drivers/distance_sensor/ll40ls/Kconfig"
    source "src/drivers/distance_sensor/ll40ls_pwm/Kconfig"
    source "src/drivers/distance_sensor/mappydot/Kconfig"
    source "src/drivers/distance_sensor/mb12xx/Kconfig"
    source "src/drivers/distance_sensor/pga460/Kconfig"
    source "src/drivers/distance_sensor/srf02/Kconfig"
    source "src/drivers/distance_sensor/srf05/Kconfig"
    source "src/drivers/distance_sensor/teraranger/Kconfig"
    source "src/drivers/distance_sensor/tf02pro/Kconfig"
    source "src/drivers/distance_sensor/tfmini/Kconfig"
    source "src/drivers/distance_sensor/ulanding_radar/Kconfig"
    source "src/drivers/distance_sensor/vl53l0x/Kconfig"
    source "src/drivers/distance_sensor/vl53l1x/Kconfig"
endmenu
```

## transform_projects/transform_px4/PX4_output/src/drivers/gpio/Kconfig
```kconfig
menu "GPIO"
    source "src/drivers/gpio/mcp23009/Kconfig"
    source "src/drivers/gpio/mcp23017/Kconfig"
endmenu
```

## transform_projects/transform_px4/PX4_output/src/drivers/hygrometer/Kconfig
```kconfig
menu "Hygrometers"
    menuconfig COMMON_HYGROMETERS
        bool "Hygrometer sensors"
        default n
        select DRIVERS_HYGROMETER_SHT3x
        ---help---
            Enable default set of hygrometer sensors
    source "src/drivers/hygrometer/sht3x/Kconfig"
endmenu #Hygrometers
```

## transform_projects/transform_px4/PX4_output/src/drivers/imu/analog_devices/Kconfig
```kconfig
menu "Analog Devices"
source "src/drivers/imu/analog_devices/adis16448/Kconfig"
source "src/drivers/imu/analog_devices/adis16470/Kconfig"
source "src/drivers/imu/analog_devices/adis16477/Kconfig"
source "src/drivers/imu/analog_devices/adis16497/Kconfig"
source "src/drivers/imu/analog_devices/adis16507/Kconfig"
endmenu #Analog Devices
```

## transform_projects/transform_px4/PX4_output/src/drivers/imu/bosch/Kconfig
```kconfig
menu "Bosch"
source "src/drivers/imu/bosch/bmi055/Kconfig"
source "src/drivers/imu/bosch/bmi085/Kconfig"
source "src/drivers/imu/bosch/bmi088/Kconfig"
source "src/drivers/imu/bosch/bmi088_i2c/Kconfig"
source "src/drivers/imu/bosch/bmi270/Kconfig"
endmenu #Bosch
```

## transform_projects/transform_px4/PX4_output/src/drivers/imu/invensense/Kconfig
```kconfig
menu "Invensense"
source "src/drivers/imu/invensense/iam20680hp/Kconfig"
source "src/drivers/imu/invensense/icm20602/Kconfig"
source "src/drivers/imu/invensense/icm20608g/Kconfig"
source "src/drivers/imu/invensense/icm20649/Kconfig"
source "src/drivers/imu/invensense/icm20689/Kconfig"
source "src/drivers/imu/invensense/icm20948/Kconfig"
source "src/drivers/imu/invensense/icm40609d/Kconfig"
source "src/drivers/imu/invensense/icm42605/Kconfig"
source "src/drivers/imu/invensense/icm42670p/Kconfig"
source "src/drivers/imu/invensense/icm42688p/Kconfig"
source "src/drivers/imu/invensense/icm45686/Kconfig"
source "src/drivers/imu/invensense/iim42652/Kconfig"
source "src/drivers/imu/invensense/iim42653/Kconfig"
source "src/drivers/imu/invensense/mpu6000/Kconfig"
source "src/drivers/imu/invensense/mpu6500/Kconfig"
source "src/drivers/imu/invensense/mpu9250/Kconfig"
endmenu #Invensense
```

## transform_projects/transform_px4/PX4_output/src/drivers/imu/nxp/Kconfig
```kconfig
menu "NXP"
source "src/drivers/imu/nxp/fxas21002c/Kconfig"
source "src/drivers/imu/nxp/fxos8701cq/Kconfig"
endmenu #NXP
```

## transform_projects/transform_px4/PX4_output/src/drivers/imu/st/Kconfig
```kconfig
menu "ST"
source "src/drivers/imu/st/l3gd20/Kconfig"
source "src/drivers/imu/st/lsm303d/Kconfig"
source "src/drivers/imu/st/lsm9ds1/Kconfig"
endmenu #ST
```

## transform_projects/transform_px4/PX4_output/src/drivers/ins/Kconfig
```kconfig
menu "Inertial Navigation Systems (INS)"
    menuconfig COMMON_INS
        bool "All INS sensors"
        default n
        select DRIVERS_INS_VECTORNAV
        select DRIVERS_INS_ILABS
        select DRIVERS_INS_MICROSTRAIN
        select DRIVERS_INS_EULERNAV_BAHRS
        select DRIVERS_INS_SBGECOM
        ---help---
            Enable default set of INS sensors
    source "src/drivers/ins/eulernav_bahrs/Kconfig"
    source "src/drivers/ins/ilabs/Kconfig"
    source "src/drivers/ins/microstrain/Kconfig"
    source "src/drivers/ins/sbgecom/Kconfig"
    source "src/drivers/ins/vectornav/Kconfig"
endmenu
```
