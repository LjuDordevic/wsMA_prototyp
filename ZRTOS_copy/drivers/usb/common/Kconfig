## ZRTOS_copy/drivers/usb/common/Kconfig
```kconfig
# Copyright (c) 2023 Nordic Semiconductor ASA
# SPDX-License-Identifier: Apache-2.0

menu "USB common"

rsource "/home/ljd/wsMA_prototyp/ZRTOS_demo/zephyr/drivers/usb/common/drivers/usb/common/nrf_usbd_common/Kconfig"

endmenu
```

## ZRTOS_copy/dts/Kconfig
```kconfig
# SPDX-License-Identifier: Apache-2.0

menu "Devicetree Info"

osource "/home/ljd/wsMA_prototyp/ZRTOS_demo/zephyr/dts/build/Kconfig/Kconfig.dts"

endmenu
```

## ZRTOS_copy/soc/ambiq/Kconfig.soc
```kconfig
# SPDX-License-Identifier: Apache-2.0
#
# Copyright (c) 2023 Antmicro <www.antmicro.com>

config SOC_FAMILY_AMBIQ
	bool

config SOC_FAMILY
	default "ambiq" if SOC_FAMILY_AMBIQ

config SOC_AMBIQ_BT_SUPPORTED
	bool

rsource "/home/ljd/wsMA_prototyp/ZRTOS_demo/zephyr/soc/ambiq/soc/ambiq/apollo2x/Kconfig.soc"
rsource "/home/ljd/wsMA_prototyp/ZRTOS_demo/zephyr/soc/ambiq/soc/ambiq/apollo3x/Kconfig.soc"
rsource "/home/ljd/wsMA_prototyp/ZRTOS_demo/zephyr/soc/ambiq/soc/ambiq/apollo4x/Kconfig.soc"
rsource "/home/ljd/wsMA_prototyp/ZRTOS_demo/zephyr/soc/ambiq/soc/ambiq/apollo5x/Kconfig.soc"
```

## ZRTOS_copy/soc/andestech/Kconfig.defconfig
```kconfig
# Copyright (c) 2024 Nordic Semiconductor ASA
# SPDX-License-Identifier: Apache-2.0

if SOC_FAMILY_ANDES_V5

rsource "/home/ljd/wsMA_prototyp/ZRTOS_demo/zephyr/soc/andestech/soc/andestech/ae350/Kconfig.defconfig"

endif # SOC_FAMILY_ANDES_V5
```

## ZRTOS_copy/soc/arm/Kconfig.defconfig
```kconfig
# Copyright (c) 2024 Nordic Semiconductor ASA
# SPDX-License-Identifier: Apache-2.0

if SOC_FAMILY_ARM || SOC_FAMILY_ARM64

rsource "/home/ljd/wsMA_prototyp/ZRTOS_demo/zephyr/soc/arm/soc/arm/beetle/Kconfig.defconfig"
rsource "/home/ljd/wsMA_prototyp/ZRTOS_demo/zephyr/soc/arm/soc/arm/fvp_aem/Kconfig.defconfig"
rsource "/home/ljd/wsMA_prototyp/ZRTOS_demo/zephyr/soc/arm/soc/arm/fvp_aemv8r/Kconfig.defconfig"
rsource "/home/ljd/wsMA_prototyp/ZRTOS_demo/zephyr/soc/arm/soc/arm/mps2/Kconfig.defconfig"
rsource "/home/ljd/wsMA_prototyp/ZRTOS_demo/zephyr/soc/arm/soc/arm/mps3/Kconfig.defconfig"
rsource "/home/ljd/wsMA_prototyp/ZRTOS_demo/zephyr/soc/arm/soc/arm/mps4/Kconfig.defconfig"
rsource "/home/ljd/wsMA_prototyp/ZRTOS_demo/zephyr/soc/arm/soc/arm/musca/Kconfig.defconfig"
rsource "/home/ljd/wsMA_prototyp/ZRTOS_demo/zephyr/soc/arm/soc/arm/qemu_cortex_a53/Kconfig.defconfig"
rsource "/home/ljd/wsMA_prototyp/ZRTOS_demo/zephyr/soc/arm/soc/arm/qemu_virt_arm64/Kconfig.defconfig"

endif # SOC_FAMILY_ARM || SOC_FAMILY_ARM64
```

## ZRTOS_copy/soc/arm/mps2/Kconfig.defconfig
```kconfig
# Copyright (c) 2017 Linaro Limited
# SPDX-License-Identifier: Apache-2.0

if SOC_SERIES_MPS2

config SYS_CLOCK_HW_CYCLES_PER_SEC
	default 25000000

rsource "/home/ljd/wsMA_prototyp/ZRTOS_demo/zephyr/soc/arm/mps2/soc/arm/mps2/Kconfig.defconfig.an383"
rsource "/home/ljd/wsMA_prototyp/ZRTOS_demo/zephyr/soc/arm/mps2/soc/arm/mps2/Kconfig.defconfig.an385"
rsource "/home/ljd/wsMA_prototyp/ZRTOS_demo/zephyr/soc/arm/mps2/soc/arm/mps2/Kconfig.defconfig.an386"
rsource "/home/ljd/wsMA_prototyp/ZRTOS_demo/zephyr/soc/arm/mps2/soc/arm/mps2/Kconfig.defconfig.an500"
rsource "/home/ljd/wsMA_prototyp/ZRTOS_demo/zephyr/soc/arm/mps2/soc/arm/mps2/Kconfig.defconfig.an521"

endif # SOC_SERIES_MPS2
```

## ZRTOS_copy/soc/atmel/sam/Kconfig
```kconfig
# Copyright (c) 2024 Gerson Fernando Budke <nandojve@gmail.com>
# SPDX-License-Identifier: Apache-2.0

config SOC_FAMILY_ATMEL_SAM
	select ASF
	select HAS_SEGGER_RTT if ZEPHYR_SEGGER_MODULE

if SOC_FAMILY_ATMEL_SAM

rsource "/home/ljd/wsMA_prototyp/ZRTOS_demo/zephyr/soc/atmel/sam/soc/atmel/sam/common/Kconfig"
rsource "/home/ljd/wsMA_prototyp/ZRTOS_demo/zephyr/soc/atmel/sam/soc/atmel/sam/sam3x/Kconfig"
rsource "/home/ljd/wsMA_prototyp/ZRTOS_demo/zephyr/soc/atmel/sam/soc/atmel/sam/sam4e/Kconfig"
rsource "/home/ljd/wsMA_prototyp/ZRTOS_demo/zephyr/soc/atmel/sam/soc/atmel/sam/sam4l/Kconfig"
rsource "/home/ljd/wsMA_prototyp/ZRTOS_demo/zephyr/soc/atmel/sam/soc/atmel/sam/sam4s/Kconfig"
rsource "/home/ljd/wsMA_prototyp/ZRTOS_demo/zephyr/soc/atmel/sam/soc/atmel/sam/samx7x/Kconfig"

endif # SOC_FAMILY_ATMEL_SAM
```

## ZRTOS_copy/soc/atmel/sam0/Kconfig.soc
```kconfig
# Copyright (c) 2017 Google LLC.
# Copyright (c) 2022-2024 Gerson Fernando Budke <nandojve@gmail.com>
# SPDX-License-Identifier: Apache-2.0

config SOC_FAMILY_ATMEL_SAM0
	bool

config SOC_FAMILY
	default "atmel_sam0" if SOC_FAMILY_ATMEL_SAM0

config SOC_SERIES_REVISION_N
	bool
	depends on SOC_FAMILY_ATMEL_SAM0

config SOC_SERIES_REVISION
	string
	default "n" if SOC_SERIES_REVISION_N
	default ""
	depends on SOC_FAMILY_ATMEL_SAM0

rsource "/home/ljd/wsMA_prototyp/ZRTOS_demo/zephyr/soc/atmel/sam0/soc/atmel/sam0/samc20/Kconfig.soc"
rsource "/home/ljd/wsMA_prototyp/ZRTOS_demo/zephyr/soc/atmel/sam0/soc/atmel/sam0/samc21/Kconfig.soc"
rsource "/home/ljd/wsMA_prototyp/ZRTOS_demo/zephyr/soc/atmel/sam0/soc/atmel/sam0/samd20/Kconfig.soc"
rsource "/home/ljd/wsMA_prototyp/ZRTOS_demo/zephyr/soc/atmel/sam0/soc/atmel/sam0/samd21/Kconfig.soc"
rsource "/home/ljd/wsMA_prototyp/ZRTOS_demo/zephyr/soc/atmel/sam0/soc/atmel/sam0/samd51/Kconfig.soc"
rsource "/home/ljd/wsMA_prototyp/ZRTOS_demo/zephyr/soc/atmel/sam0/soc/atmel/sam0/same51/Kconfig.soc"
rsource "/home/ljd/wsMA_prototyp/ZRTOS_demo/zephyr/soc/atmel/sam0/soc/atmel/sam0/same53/Kconfig.soc"
rsource "/home/ljd/wsMA_prototyp/ZRTOS_demo/zephyr/soc/atmel/sam0/soc/atmel/sam0/same54/Kconfig.soc"
rsource "/home/ljd/wsMA_prototyp/ZRTOS_demo/zephyr/soc/atmel/sam0/soc/atmel/sam0/saml21/Kconfig.soc"
rsource "/home/ljd/wsMA_prototyp/ZRTOS_demo/zephyr/soc/atmel/sam0/soc/atmel/sam0/samr21/Kconfig.soc"
rsource "/home/ljd/wsMA_prototyp/ZRTOS_demo/zephyr/soc/atmel/sam0/soc/atmel/sam0/samr34/Kconfig.soc"
rsource "/home/ljd/wsMA_prototyp/ZRTOS_demo/zephyr/soc/atmel/sam0/soc/atmel/sam0/samr35/Kconfig.soc"
```

## ZRTOS_copy/soc/bflb/Kconfig
```kconfig
# Copyright (c) 2021-2025 ATL Electronics
#
# SPDX-License-Identifier: Apache-2.0

if SOC_FAMILY_BFLB

rsource "/home/ljd/wsMA_prototyp/ZRTOS_demo/zephyr/soc/bflb/soc/bflb/bl60x/Kconfig"
rsource "/home/ljd/wsMA_prototyp/ZRTOS_demo/zephyr/soc/bflb/soc/bflb/bl61x/Kconfig"
rsource "/home/ljd/wsMA_prototyp/ZRTOS_demo/zephyr/soc/bflb/soc/bflb/bl70x/Kconfig"

endif # SOC_FAMILY_BFLB
```

## ZRTOS_copy/soc/bflb/Kconfig.defconfig
```kconfig
# Copyright (c) 2021-2025 ATL Electronics
#
# SPDX-License-Identifier: Apache-2.0

if SOC_FAMILY_BFLB

config SYS_CLOCK_HW_CYCLES_PER_SEC
	default $(dt_node_int_prop_int,/cpus,timebase-frequency)

rsource "/home/ljd/wsMA_prototyp/ZRTOS_demo/zephyr/soc/bflb/soc/bflb/bl60x/Kconfig.defconfig"
rsource "/home/ljd/wsMA_prototyp/ZRTOS_demo/zephyr/soc/bflb/soc/bflb/bl61x/Kconfig.defconfig"
rsource "/home/ljd/wsMA_prototyp/ZRTOS_demo/zephyr/soc/bflb/soc/bflb/bl70x/Kconfig.defconfig"

endif # SOC_FAMILY_BFLB
```

## ZRTOS_copy/soc/brcm/bcmvk/Kconfig
```kconfig
# SPDX-License-Identifier: Apache-2.0
#
# Copyright 2020 Broadcom.
#

if SOC_FAMILY_BCMVK

rsource "/home/ljd/wsMA_prototyp/ZRTOS_demo/zephyr/soc/brcm/bcmvk/soc/brcm/bcmvk/valkyrie/Kconfig"
rsource "/home/ljd/wsMA_prototyp/ZRTOS_demo/zephyr/soc/brcm/bcmvk/soc/brcm/bcmvk/viper/Kconfig"

endif
```

## ZRTOS_copy/soc/brcm/bcmvk/Kconfig.defconfig
```kconfig
# SPDX-License-Identifier: Apache-2.0
#
# Copyright 2020 Broadcom.
#

if SOC_FAMILY_BCMVK

rsource "/home/ljd/wsMA_prototyp/ZRTOS_demo/zephyr/soc/brcm/bcmvk/soc/brcm/bcmvk/valkyrie/Kconfig.defconfig"

endif # SOC_FAMILY_BCMVK
```

## ZRTOS_copy/soc/egis/Kconfig
```kconfig
# Copyright (c) 2025 Egis Technology Inc.
# SPDX-License-Identifier: Apache-2.0

if SOC_EGIS_ET171

rsource "/home/ljd/wsMA_prototyp/ZRTOS_demo/zephyr/soc/egis/soc/egis/et171/Kconfig"

endif # SOC_EGIS_ET171
```

## ZRTOS_copy/soc/gaisler/gr716a/Kconfig
```kconfig
# Copyright (c) 2019-2020 Cobham Gaisler AB
# SPDX-License-Identifier: Apache-2.0

config SOC_GR716A
	select SPARC
	select SOC_SPARC_LEON
	select CPU_HAS_FPU

rsource "/home/ljd/wsMA_prototyp/ZRTOS_demo/zephyr/soc/gaisler/gr716a/soc/gaisler/Kconfig"
```

## ZRTOS_copy/soc/gaisler/leon3/Kconfig
```kconfig
# Copyright (c) 2019-2020 Cobham Gaisler AB
# SPDX-License-Identifier: Apache-2.0

config SOC_LEON3
	select SPARC
	select SOC_SPARC_LEON

rsource "/home/ljd/wsMA_prototyp/ZRTOS_demo/zephyr/soc/gaisler/leon3/soc/gaisler/Kconfig"
```

## ZRTOS_copy/soc/gd/gd32/Kconfig
```kconfig
# Copyright (c) 2021, ATL Electronics
# SPDX-License-Identifier: Apache-2.0

config SOC_FAMILY_GD_GD32
	select HAS_GD32_HAL
	select BUILD_OUTPUT_HEX
	select HAS_SEGGER_RTT if ZEPHYR_SEGGER_MODULE

if SOC_FAMILY_GD_GD32

rsource "/home/ljd/wsMA_prototyp/ZRTOS_demo/zephyr/soc/gd/gd32/soc/gd/gd32/gd32a50x/Kconfig"
rsource "/home/ljd/wsMA_prototyp/ZRTOS_demo/zephyr/soc/gd/gd32/soc/gd/gd32/gd32e10x/Kconfig"
rsource "/home/ljd/wsMA_prototyp/ZRTOS_demo/zephyr/soc/gd/gd32/soc/gd/gd32/gd32e50x/Kconfig"
rsource "/home/ljd/wsMA_prototyp/ZRTOS_demo/zephyr/soc/gd/gd32/soc/gd/gd32/gd32f3x0/Kconfig"
rsource "/home/ljd/wsMA_prototyp/ZRTOS_demo/zephyr/soc/gd/gd32/soc/gd/gd32/gd32f403/Kconfig"
rsource "/home/ljd/wsMA_prototyp/ZRTOS_demo/zephyr/soc/gd/gd32/soc/gd/gd32/gd32f4xx/Kconfig"
rsource "/home/ljd/wsMA_prototyp/ZRTOS_demo/zephyr/soc/gd/gd32/soc/gd/gd32/gd32l23x/Kconfig"
rsource "/home/ljd/wsMA_prototyp/ZRTOS_demo/zephyr/soc/gd/gd32/soc/gd/gd32/gd32vf103/Kconfig"

endif # SOC_FAMILY_GD_GD32
```

## ZRTOS_copy/soc/infineon/cat1a/Kconfig.defconfig
```kconfig
# PSOC CAT1A Configuration

# Copyright (c) 2024 Cypress Semiconductor Corporation.
# SPDX-License-Identifier: Apache-2.0

if SOC_FAMILY_INFINEON_CAT1A

rsource "/home/ljd/wsMA_prototyp/ZRTOS_demo/zephyr/soc/infineon/cat1a/soc/infineon/cat1a/psoc6_01/Kconfig.defconfig"
rsource "/home/ljd/wsMA_prototyp/ZRTOS_demo/zephyr/soc/infineon/cat1a/soc/infineon/cat1a/psoc6_02/Kconfig.defconfig"
rsource "/home/ljd/wsMA_prototyp/ZRTOS_demo/zephyr/soc/infineon/cat1a/soc/infineon/cat1a/psoc6_03/Kconfig.defconfig"
rsource "/home/ljd/wsMA_prototyp/ZRTOS_demo/zephyr/soc/infineon/cat1a/soc/infineon/cat1a/psoc6_04/Kconfig.defconfig"
rsource "/home/ljd/wsMA_prototyp/ZRTOS_demo/zephyr/soc/infineon/cat1a/soc/infineon/cat1a/psoc6_legacy/Kconfig.defconfig"

endif # SOC_FAMILY_INFINEON_CAT1A
```

## ZRTOS_copy/soc/infineon/cat1c/Kconfig.defconfig
```kconfig
# PSOC CAT1B Configuration

# Copyright (c) 2024 Cypress Semiconductor Corporation.
# SPDX-License-Identifier: Apache-2.0

if SOC_FAMILY_INFINEON_CAT1C

rsource "/home/ljd/wsMA_prototyp/ZRTOS_demo/zephyr/soc/infineon/cat1c/soc/infineon/cat1c/xmc7200/Kconfig.defconfig"

endif # SOC_FAMILY_INFINEON_CAT1C
```

## ZRTOS_copy/soc/infineon/cat1c/Kconfig.soc
```kconfig
# Copyright (c) 2024 Cypress Semiconductor Corporation (an Infineon company) or
# an affiliate of Cypress Semiconductor Corporation
# SPDX-License-Identifier: Apache-2.0

# Family definitions
config SOC_FAMILY_INFINEON_CAT1
	bool

config SOC_FAMILY_INFINEON_CAT1C
	bool
	select SOC_FAMILY_INFINEON_CAT1

# MPNs definitions
rsource "/home/ljd/wsMA_prototyp/ZRTOS_demo/zephyr/soc/infineon/cat1c/soc/infineon/cat1c/xmc7200/Kconfig.soc"
```

## ZRTOS_copy/soc/infineon/edge/Kconfig.soc
```kconfig
# Copyright (c) 2025 Infineon Technologies AG,
# or an affiliate of Infineon Technologies AG.
#
# SPDX-License-Identifier: Apache-2.0

# Family definitions
config SOC_FAMILY_INFINEON_EDGE
	bool

config SOC_FAMILY
	default "infineon_edge" if SOC_FAMILY_INFINEON_EDGE

# MPNs definitions
rsource "/home/ljd/wsMA_prototyp/ZRTOS_demo/zephyr/soc/infineon/edge/soc/infineon/edge/pse84/Kconfig.soc"
```

## ZRTOS_copy/soc/intel/intel_ish/intel_ish5/Kconfig.defconfig.series
```kconfig
# Copyright (c) 2023-2024 Intel Corporation
#
# SPDX-License-Identifier: Apache-2.0
#

if SOC_SERIES_INTEL_ISH5

rsource "/home/ljd/wsMA_prototyp/ZRTOS_demo/zephyr/soc/intel/intel_ish/intel_ish5/soc/intel/intel_ish/intel_ish5/pm/Kconfig.pm"

endif # SOC_SERIES_INTEL_ISH5
```

## ZRTOS_copy/soc/intel/intel_socfpga/Kconfig
```kconfig
# Copyright (c) 2021-2024 Intel Corporation
# SPDX-License-Identifier: Apache-2.0

if SOC_FAMILY_INTEL_SOCFPGA

rsource "/home/ljd/wsMA_prototyp/ZRTOS_demo/zephyr/soc/intel/intel_socfpga/soc/intel/intel_socfpga/agilex/Kconfig"
rsource "/home/ljd/wsMA_prototyp/ZRTOS_demo/zephyr/soc/intel/intel_socfpga/soc/intel/intel_socfpga/agilex5/Kconfig"

endif # SOC_FAMILY_INTEL_SOCFPGA
```

## ZRTOS_copy/soc/intel/intel_socfpga/agilex/Kconfig.defconfig.series
```kconfig
# Copyright (c) 2021-2024 Intel Corporation
# SPDX-License-Identifier: Apache-2.0

if SOC_SERIES_AGILEX

rsource "/home/ljd/wsMA_prototyp/ZRTOS_demo/zephyr/soc/intel/intel_socfpga/agilex/soc/intel/intel_socfpga/agilex/Kconfig.defconfig.agilex"

endif # SOC_SERIES_AGILEX
```

## ZRTOS_copy/soc/intel/intel_socfpga_std/cyclonev/Kconfig.defconfig.series
```kconfig
# Copyright (c) 2022-2024 Intel Corporation
# SPDX-License-Identifier: Apache-2.0

if SOC_SERIES_CYCLONEV

rsource "/home/ljd/wsMA_prototyp/ZRTOS_demo/zephyr/soc/intel/intel_socfpga_std/cyclonev/soc/intel/intel_socfpga_std/cyclonev/Kconfig.defconfig.cyclonev"

endif # SOC_SERIES_CYCLONEV
```
