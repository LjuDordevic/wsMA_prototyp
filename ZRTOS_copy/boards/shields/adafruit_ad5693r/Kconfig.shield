## ZRTOS_copy/boards/shields/adafruit_ad5693r/Kconfig.shield
```kconfig
# Copyright (c) 2025 Jonas Berg
# SPDX-License-Identifier: Apache-2.0

config SHIELD_ADAFRUIT_AD5693R
 bool
 default $(shields_list_contains,adafruit_ad5693r)
```

## ZRTOS_copy/boards/shields/adafruit_adalogger_featherwing/Kconfig.shield
```kconfig
# Copyright (c) 2024 Philip-Dylan Gleonec <philip-dylan@gleonec.bzh>
# SPDX-License-Identifier: Apache-2.0

config SHIELD_ADAFRUIT_DATA_LOGGER
 bool
 default $(shields_list_contains,adafruit_adalogger_featherwing)
```

## ZRTOS_copy/boards/shields/adafruit_drv2605l/Kconfig.shield
```kconfig
# Copyright (c) 2025 Jonas Berg
# SPDX-License-Identifier: Apache-2.0

config SHIELD_ADAFRUIT_DRV2605L
 bool
 default $(shields_list_contains,adafruit_drv2605l)
```

## ZRTOS_copy/boards/shields/adafruit_featherwing_128x32_oled/Kconfig.shield
```kconfig
# Copyright The Zephyr Project Contributors
# SPDX-License-Identifier: Apache-2.0

config SHIELD_ADAFRUIT_FEATHERWING_128X32_OLED
 bool
 default $(shields_list_contains,adafruit_featherwing_128x32_oled)
```

## ZRTOS_copy/boards/shields/adafruit_ht16k33/Kconfig.shield
```kconfig
# Copyright (c) 2025 Jonas Berg
# SPDX-License-Identifier: Apache-2.0

config SHIELD_ADAFRUIT_HT16K33
 bool
 default $(shields_list_contains,adafruit_ht16k33)
```

## ZRTOS_copy/boards/shields/adafruit_ltr329/Kconfig.shield
```kconfig
# Copyright (c) 2025 Jonas Berg
# SPDX-License-Identifier: Apache-2.0

config SHIELD_ADAFRUIT_LTR329
 bool
 default $(shields_list_contains,adafruit_ltr329)
```

## ZRTOS_copy/boards/shields/adafruit_winc1500/Kconfig.shield
```kconfig
# Copyright (c) 2020 Kim Bøndergaard <kim.bondergaard@prevas.dk>, Prevas A/S
# SPDX-License-Identifier: Apache-2.0

config SHIELD_ADAFRUIT_WINC1500
 bool
 default $(shields_list_contains,adafruit_winc1500)
```

## ZRTOS_copy/boards/shields/amg88xx/Kconfig.shield
```kconfig
# Copyright (c) 2022 Nordic Semiconductor ASA
#
# SPDX-License-Identifier: Apache-2.0

config SHIELD_AMG88XX_GRID_EYE_EVAL_SHIELD
 bool
 default $(shields_list_contains,amg88xx_grid_eye_eval_shield)

config SHIELD_AMG88XX_EVAL_KIT
 bool
 default $(shields_list_contains,amg88xx_eval_kit)
```

## ZRTOS_copy/boards/shields/arduino_modulino_movement/Kconfig.shield
```kconfig
# SPDX-FileCopyrightText: Copyright The Zephyr Project Contributors
# SPDX-License-Identifier: Apache-2.0

config SHIELD_ARDUINO_MODULINO_MOVEMENT
 bool
 default $(shields_list_contains,arduino_modulino_movement)
```

## ZRTOS_copy/boards/shields/arduino_uno_click/Kconfig.shield
```kconfig
# Copyright (c) 2023 Andriy Gelman
# SPDX-License-Identifier: Apache-2.0

config ARDUINO_UNO_CLICK
 bool
 default $(shields_list_contains,arduino_uno_click)
```

## ZRTOS_copy/boards/shields/buydisplay_3_5_tft_touch_arduino/Kconfig.shield
```kconfig
# Copyright (c) 2020 Teslabs Engineering S.L.
# SPDX-License-Identifier: Apache-2.0

config SHIELD_BUYDISPLAY_3_5_TFT_TOUCH_ARDUINO
 bool
 default $(shields_list_contains,buydisplay_3_5_tft_touch_arduino)
```

## ZRTOS_copy/boards/shields/dac80508_evm/Kconfig.shield
```kconfig
# Copyright (c) 2020 M2I Corporation
# SPDX-License-Identifier: Apache-2.0

config SHIELD_DAC80508_EVM
 bool
 default $(shields_list_contains,dac80508_evm)
```

## ZRTOS_copy/boards/shields/eval_ad4052_ardz/Kconfig.shield
```kconfig
# Copyright (c) 2025 Analog Devices, Inc.
# SPDX-License-Identifier: Apache-2.0

config SHIELD_EVAL_AD4052_ARDZ
 bool
 default $(shields_list_contains,eval_ad4052_ardz)
```

## ZRTOS_copy/boards/shields/eval_adxl367_ardz/Kconfig.shield
```kconfig
# Copyright (c) 2025 Analog Devices, Inc.
# SPDX-License-Identifier: Apache-2.0

config SHIELD_EVAL_ADXL367_ARDZ
 bool
 default $(shields_list_contains,eval_adxl367_ardz)
```

## ZRTOS_copy/boards/shields/eval_adxl372_ardz/Kconfig.shield
```kconfig
# Copyright (c) 2024 Analog Devices, Inc.
# SPDX-License-Identifier: Apache-2.0

config SHIELD_EVAL_ADXL372_ARDZ
 bool
 default $(shields_list_contains,eval_adxl372_ardz)
```

## ZRTOS_copy/boards/shields/frdm_cr20a/Kconfig.shield
```kconfig
# Copyright (c) 2019 Linaro Limited
# SPDX-License-Identifier: Apache-2.0

config SHIELD_FRDM_CR20A
 bool
 default $(shields_list_contains,frdm_cr20a)
```

## ZRTOS_copy/boards/shields/frdm_kw41z/Kconfig.shield
```kconfig
# Copyright (c) 2019 Linaro Limited
# SPDX-License-Identifier: Apache-2.0

config SHIELD_FRDM_KW41Z
 bool
 default $(shields_list_contains,frdm_kw41z)
```

## ZRTOS_copy/boards/shields/ftdi_vm800c/Kconfig.shield
```kconfig
# Copyright (c) 2021 Hubert Miś <hubert.mis@gmail.com>
# SPDX-License-Identifier: Apache-2.0

config SHIELD_FTDI_VM800C
 bool
 default $(shields_list_contains,ftdi_vm800c)
```

## ZRTOS_copy/boards/shields/inventek_eswifi/Kconfig.shield
```kconfig
# Copyright (c) 2020 ATL Electronics
# SPDX-License-Identifier: Apache-2.0

config SHIELD_INVENTEK_ESWIFI
 bool
 default $(shields_list_contains,inventek_eswifi)

config SHIELD_INVENTEK_ESWIFI_ARDUINO_SPI
 bool
 default $(shields_list_contains,inventek_eswifi_arduino_spi)

config SHIELD_INVENTEK_ESWIFI_ARDUINO_UART
 bool
 default $(shields_list_contains,inventek_eswifi_arduino_uart)
```

## ZRTOS_copy/boards/shields/link_board_eth/Kconfig.shield
```kconfig
# Copyright (c) 2019 Linaro Limited
# SPDX-License-Identifier: Apache-2.0

config SHIELD_LINK_BOARD_ETH
 bool
 default $(shields_list_contains,link_board_eth)
```

## ZRTOS_copy/boards/shields/ls0xx_generic/Kconfig.shield
```kconfig
# Copyright (c) 2020 Rohit Gujarathi
# SPDX-License-Identifier: Apache-2.0

config SHIELD_LS013B7DH03
 bool
 default $(shields_list_contains,ls013b7dh03)
```

## ZRTOS_copy/boards/shields/mcp2515/Kconfig.shield
```kconfig
# Copyright (c) 2019 Linaro Limited
# SPDX-License-Identifier: Apache-2.0

config SHIELD_DFROBOT_CAN_BUS_V2_0
 bool
 default $(shields_list_contains,dfrobot_can_bus_v2_0)

config SHIELD_KEYESTUDIO_CAN_BUS_KS0411
 bool
 default $(shields_list_contains,keyestudio_can_bus_ks0411)

config SHIELD_ADAFRUIT_CAN_PICOWBELL
 bool
 default $(shields_list_contains,adafruit_can_picowbell)
```

## ZRTOS_copy/boards/shields/mikroe_adc_click/Kconfig.shield
```kconfig
# Copyright (c) 2020 Vestas Wind Systems A/S
# SPDX-License-Identifier: Apache-2.0

config SHIELD_MIKROE_ADC_CLICK
 bool
 default $(shields_list_contains,mikroe_adc_click)
```

## ZRTOS_copy/boards/shields/mikroe_eth_click/Kconfig.shield
```kconfig
# Copyright (c) 2020 Linaro Limited.
# SPDX-License-Identifier: Apache-2.0

config SHIELD_MIKROE_ETH_CLICK
 bool
 default $(shields_list_contains,mikroe_eth_click)
```

## ZRTOS_copy/boards/shields/mikroe_ir_gesture_click/Kconfig.shield
```kconfig
# Copyright The Zephyr Project Contributors
# SPDX-License-Identifier: Apache-2.0

config SHIELD_MIKROE_IR_GESTURE_CLICK
 bool
 default $(shields_list_contains,mikroe_ir_gesture_click)
```
