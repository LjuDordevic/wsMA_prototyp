## ZRTOS_copy/build/Kconfig/soc/Kconfig.defconfig
```kconfig
# Load Zephyr SoC defconfig descriptions.
osource "/home/ljd/wsMA_prototyp/ZRTOS_demo/zephyr/build/Kconfig/soc/soc/xlnx/zynqmp/Kconfig.defconfig"
osource "/home/ljd/wsMA_prototyp/ZRTOS_demo/zephyr/build/Kconfig/soc/soc/xlnx/zynq7000/Kconfig.defconfig"
osource "/home/ljd/wsMA_prototyp/ZRTOS_demo/zephyr/build/Kconfig/soc/soc/xlnx/versalnet/Kconfig.defconfig"
osource "/home/ljd/wsMA_prototyp/ZRTOS_demo/zephyr/build/Kconfig/soc/soc/xlnx/versal2/Kconfig.defconfig"
osource "/home/ljd/wsMA_prototyp/ZRTOS_demo/zephyr/build/Kconfig/soc/soc/xen/Kconfig.defconfig"
#osource "/home/ljd/wsMA_prototyp/ZRTOS_demo/zephyr/soc/wch/ch32v/Kconfig.defconfig"
#osource "/home/ljd/wsMA_prototyp/ZRTOS_demo/zephyr/soc/ti/simplelink/Kconfig.defconfig"
osource "/home/ljd/wsMA_prototyp/ZRTOS_demo/zephyr/build/Kconfig/soc/soc/ti/mspm0/Kconfig.defconfig"
osource "/home/ljd/wsMA_prototyp/ZRTOS_demo/zephyr/build/Kconfig/soc/soc/ti/lm3s6965/Kconfig.defconfig"
#osource "/home/ljd/wsMA_prototyp/ZRTOS_demo/zephyr/soc/ti/k3/Kconfig.defconfig"
#osource "/home/ljd/wsMA_prototyp/ZRTOS_demo/zephyr/soc/telink/tlsr/Kconfig.defconfig"
osource "/home/ljd/wsMA_prototyp/ZRTOS_demo/zephyr/build/Kconfig/soc/soc/starfive/jh71xx/Kconfig.defconfig"
osource "/home/ljd/wsMA_prototyp/ZRTOS_demo/zephyr/build/Kconfig/soc/soc/st/stm32/Kconfig.defconfig"
osource "/home/ljd/wsMA_prototyp/ZRTOS_demo/zephyr/build/Kconfig/soc/soc/snps/qemu_arc/Kconfig.defconfig"
#osource "/home/ljd/wsMA_prototyp/ZRTOS_demo/zephyr/soc/snps/nsim/arc_v/Kconfig.defconfig"
osource "/home/ljd/wsMA_prototyp/ZRTOS_demo/zephyr/build/Kconfig/soc/soc/snps/nsim/arc_classic/Kconfig.defconfig"
osource "/home/ljd/wsMA_prototyp/ZRTOS_demo/zephyr/build/Kconfig/soc/soc/snps/hsdk4xd/Kconfig.defconfig"
osource "/home/ljd/wsMA_prototyp/ZRTOS_demo/zephyr/build/Kconfig/soc/soc/snps/hsdk/Kconfig.defconfig"
#osource "/home/ljd/wsMA_prototyp/ZRTOS_demo/zephyr/soc/snps/emsk/Kconfig.defconfig"
osource "/home/ljd/wsMA_prototyp/ZRTOS_demo/zephyr/build/Kconfig/soc/soc/snps/emsdp/Kconfig.defconfig"
osource "/home/ljd/wsMA_prototyp/ZRTOS_demo/zephyr/build/Kconfig/soc/soc/snps/arc_iot/Kconfig.defconfig"
osource "/home/ljd/wsMA_prototyp/ZRTOS_demo/zephyr/build/Kconfig/soc/soc/silabs/Kconfig.defconfig"
osource "/home/ljd/wsMA_prototyp/ZRTOS_demo/zephyr/build/Kconfig/soc/soc/sifli/sf32/Kconfig.defconfig"
#osource "/home/ljd/wsMA_prototyp/ZRTOS_demo/zephyr/soc/sifive/sifive_freedom/Kconfig.defconfig"
#osource "/home/ljd/wsMA_prototyp/ZRTOS_demo/zephyr/soc/sensry/Kconfig.defconfig"
#osource "/home/ljd/wsMA_prototyp/ZRTOS_demo/zephyr/soc/rockchip/Kconfig.defconfig"
osource "/home/ljd/wsMA_prototyp/ZRTOS_demo/zephyr/build/Kconfig/soc/soc/renode/riscv_virtual/Kconfig.defconfig"
osource "/home/ljd/wsMA_prototyp/ZRTOS_demo/zephyr/build/Kconfig/soc/soc/renode/cortex_r8_virtual/Kconfig.defconfig"
#osource "/home/ljd/wsMA_prototyp/ZRTOS_demo/zephyr/soc/renesas/smartbond/Kconfig.defconfig"
#osource "/home/ljd/wsMA_prototyp/ZRTOS_demo/zephyr/soc/renesas/rz/Kconfig.defconfig"
#osource "/home/ljd/wsMA_prototyp/ZRTOS_demo/zephyr/soc/renesas/rx/Kconfig.defconfig"
#osource "/home/ljd/wsMA_prototyp/ZRTOS_demo/zephyr/soc/renesas/rcar/Kconfig.defconfig"
#osource "/home/ljd/wsMA_prototyp/ZRTOS_demo/zephyr/soc/renesas/ra/Kconfig.defconfig"
#osource "/home/ljd/wsMA_prototyp/ZRTOS_demo/zephyr/soc/realtek/ec/Kconfig.defconfig"
#osource "/home/ljd/wsMA_prototyp/ZRTOS_demo/zephyr/soc/raspberrypi/rpi_pico/Kconfig.defconfig"
osource "/home/ljd/wsMA_prototyp/ZRTOS_demo/zephyr/build/Kconfig/soc/soc/quicklogic/eos_s3/Kconfig.defconfig"
osource "/home/ljd/wsMA_prototyp/ZRTOS_demo/zephyr/build/Kconfig/soc/soc/qemu/virt_riscv/Kconfig.defconfig"
osource "/home/ljd/wsMA_prototyp/ZRTOS_demo/zephyr/build/Kconfig/soc/soc/qemu/malta/Kconfig.defconfig"
osource "/home/ljd/wsMA_prototyp/ZRTOS_demo/zephyr/build/Kconfig/soc/soc/openisa/rv32m1/Kconfig.defconfig"
osource "/home/ljd/wsMA_prototyp/ZRTOS_demo/zephyr/build/Kconfig/soc/soc/openhwgroup/cva6/Kconfig.defconfig"
#osource "/home/ljd/wsMA_prototyp/ZRTOS_demo/zephyr/soc/oct/osd32mp15x/Kconfig.defconfig"
#osource "/home/ljd/wsMA_prototyp/ZRTOS_demo/zephyr/soc/nxp/s32/Kconfig.defconfig"
osource "/home/ljd/wsMA_prototyp/ZRTOS_demo/zephyr/build/Kconfig/soc/soc/nxp/rw/Kconfig.defconfig"
#osource "/home/ljd/wsMA_prototyp/ZRTOS_demo/zephyr/soc/nxp/mcx/Kconfig.defconfig"
osource "/home/ljd/wsMA_prototyp/ZRTOS_demo/zephyr/build/Kconfig/soc/soc/nxp/lpc/Kconfig.defconfig"
#osource "/home/ljd/wsMA_prototyp/ZRTOS_demo/zephyr/soc/nxp/layerscape/Kconfig.defconfig"
osource "/home/ljd/wsMA_prototyp/ZRTOS_demo/zephyr/build/Kconfig/soc/soc/nxp/kinetis/Kconfig.defconfig"
osource "/home/ljd/wsMA_prototyp/ZRTOS_demo/zephyr/build/Kconfig/soc/soc/nxp/imxrt/Kconfig.defconfig"
#osource "/home/ljd/wsMA_prototyp/ZRTOS_demo/zephyr/soc/nxp/imx/Kconfig.defconfig"
#osource "/home/ljd/wsMA_prototyp/ZRTOS_demo/zephyr/soc/nuvoton/numicro/Kconfig.defconfig"
osource "/home/ljd/wsMA_prototyp/ZRTOS_demo/zephyr/build/Kconfig/soc/soc/nuvoton/numaker/Kconfig.defconfig"
#osource "/home/ljd/wsMA_prototyp/ZRTOS_demo/zephyr/soc/nuvoton/npcx/Kconfig.defconfig"
#osource "/home/ljd/wsMA_prototyp/ZRTOS_demo/zephyr/soc/nuvoton/npcm/Kconfig.defconfig"
osource "/home/ljd/wsMA_prototyp/ZRTOS_demo/zephyr/build/Kconfig/soc/soc/nordic/Kconfig.defconfig"
osource "/home/ljd/wsMA_prototyp/ZRTOS_demo/zephyr/build/Kconfig/soc/soc/neorv32/Kconfig.defconfig"
#osource "/home/ljd/wsMA_prototyp/ZRTOS_demo/zephyr/soc/native/inf_clock/Kconfig.defconfig"
osource "/home/ljd/wsMA_prototyp/ZRTOS_demo/zephyr/build/Kconfig/soc/soc/microchip/sam/Kconfig.defconfig"
osource "/home/ljd/wsMA_prototyp/ZRTOS_demo/zephyr/build/Kconfig/soc/soc/microchip/sam/sama7/Kconfig.defconfig"
osource "/home/ljd/wsMA_prototyp/ZRTOS_demo/zephyr/build/Kconfig/soc/soc/microchip/sam/sam_d5x_e5x/Kconfig.defconfig"
osource "/home/ljd/wsMA_prototyp/ZRTOS_demo/zephyr/build/Kconfig/soc/soc/microchip/pic32c/pic32cz_ca/Kconfig.defconfig"
osource "/home/ljd/wsMA_prototyp/ZRTOS_demo/zephyr/build/Kconfig/soc/soc/microchip/pic32c/pic32cx_sg/Kconfig.defconfig"
osource "/home/ljd/wsMA_prototyp/ZRTOS_demo/zephyr/build/Kconfig/soc/soc/microchip/pic32c/pic32cm_jh/Kconfig.defconfig"
#osource "/home/ljd/wsMA_prototyp/ZRTOS_demo/zephyr/soc/microchip/miv/Kconfig.defconfig"
#osource "/home/ljd/wsMA_prototyp/ZRTOS_demo/zephyr/soc/microchip/mec/Kconfig.defconfig"
osource "/home/ljd/wsMA_prototyp/ZRTOS_demo/zephyr/build/Kconfig/soc/soc/mediatek/mt8xxx/Kconfig.defconfig"
osource "/home/ljd/wsMA_prototyp/ZRTOS_demo/zephyr/build/Kconfig/soc/soc/lowrisc/opentitan/Kconfig.defconfig"
osource "/home/ljd/wsMA_prototyp/ZRTOS_demo/zephyr/build/Kconfig/soc/soc/litex/litex_vexriscv/Kconfig.defconfig"
osource "/home/ljd/wsMA_prototyp/ZRTOS_demo/zephyr/build/Kconfig/soc/soc/ite/ec/Kconfig.defconfig"
osource "/home/ljd/wsMA_prototyp/ZRTOS_demo/zephyr/build/Kconfig/soc/soc/intel/raptor_lake/Kconfig.defconfig"
osource "/home/ljd/wsMA_prototyp/ZRTOS_demo/zephyr/build/Kconfig/soc/soc/intel/panther_lake/Kconfig.defconfig"
osource "/home/ljd/wsMA_prototyp/ZRTOS_demo/zephyr/build/Kconfig/soc/soc/intel/lakemont/Kconfig.defconfig"
#osource "/home/ljd/wsMA_prototyp/ZRTOS_demo/zephyr/soc/intel/intel_socfpga_std/Kconfig.defconfig"
#osource "/home/ljd/wsMA_prototyp/ZRTOS_demo/zephyr/soc/intel/intel_socfpga/Kconfig.defconfig"
#osource "/home/ljd/wsMA_prototyp/ZRTOS_demo/zephyr/soc/intel/intel_niosv/Kconfig.defconfig"
osource "/home/ljd/wsMA_prototyp/ZRTOS_demo/zephyr/build/Kconfig/soc/soc/intel/intel_ish/Kconfig.defconfig"
osource "/home/ljd/wsMA_prototyp/ZRTOS_demo/zephyr/build/Kconfig/soc/soc/intel/intel_adsp/Kconfig.defconfig"
osource "/home/ljd/wsMA_prototyp/ZRTOS_demo/zephyr/build/Kconfig/soc/soc/intel/elkhart_lake/Kconfig.defconfig"
osource "/home/ljd/wsMA_prototyp/ZRTOS_demo/zephyr/build/Kconfig/soc/soc/intel/atom/Kconfig.defconfig"
osource "/home/ljd/wsMA_prototyp/ZRTOS_demo/zephyr/build/Kconfig/soc/soc/intel/apollo_lake/Kconfig.defconfig"
osource "/home/ljd/wsMA_prototyp/ZRTOS_demo/zephyr/build/Kconfig/soc/soc/intel/alder_lake/Kconfig.defconfig"
#osource "/home/ljd/wsMA_prototyp/ZRTOS_demo/zephyr/soc/infineon/edge/Kconfig.defconfig"
#osource "/home/ljd/wsMA_prototyp/ZRTOS_demo/zephyr/soc/infineon/cat3/Kconfig.defconfig"
#osource "/home/ljd/wsMA_prototyp/ZRTOS_demo/zephyr/soc/infineon/cat1c/Kconfig.defconfig"
#osource "/home/ljd/wsMA_prototyp/ZRTOS_demo/zephyr/soc/infineon/cat1b/Kconfig.defconfig"
#osource "/home/ljd/wsMA_prototyp/ZRTOS_demo/zephyr/soc/infineon/cat1a/Kconfig.defconfig"
osource "/home/ljd/wsMA_prototyp/ZRTOS_demo/zephyr/build/Kconfig/soc/soc/gd/gd32/Kconfig.defconfig"
osource "/home/ljd/wsMA_prototyp/ZRTOS_demo/zephyr/build/Kconfig/soc/soc/gaisler/leon3/Kconfig.defconfig"
osource "/home/ljd/wsMA_prototyp/ZRTOS_demo/zephyr/build/Kconfig/soc/soc/gaisler/gr716a/Kconfig.defconfig"
osource "/home/ljd/wsMA_prototyp/ZRTOS_demo/zephyr/build/Kconfig/soc/soc/espressif/Kconfig.defconfig"
osource "/home/ljd/wsMA_prototyp/ZRTOS_demo/zephyr/build/Kconfig/soc/soc/ene/kb1200/Kconfig.defconfig"
#osource "/home/ljd/wsMA_prototyp/ZRTOS_demo/zephyr/soc/ene/kb106x/Kconfig.defconfig"
#osource "/home/ljd/wsMA_prototyp/ZRTOS_demo/zephyr/soc/egis/Kconfig.defconfig"
osource "/home/ljd/wsMA_prototyp/ZRTOS_demo/zephyr/build/Kconfig/soc/soc/efinix/sapphire/Kconfig.defconfig"
#osource "/home/ljd/wsMA_prototyp/ZRTOS_demo/zephyr/soc/cdns/xtensa_sample_controller/Kconfig.defconfig"
osource "/home/ljd/wsMA_prototyp/ZRTOS_demo/zephyr/build/Kconfig/soc/soc/cdns/sample_controller32/Kconfig.defconfig"
osource "/home/ljd/wsMA_prototyp/ZRTOS_demo/zephyr/build/Kconfig/soc/soc/cdns/dc233c/Kconfig.defconfig"
#osource "/home/ljd/wsMA_prototyp/ZRTOS_demo/zephyr/soc/brcm/bcmvk/Kconfig.defconfig"
osource "/home/ljd/wsMA_prototyp/ZRTOS_demo/zephyr/build/Kconfig/soc/soc/brcm/bcm2712/Kconfig.defconfig"
osource "/home/ljd/wsMA_prototyp/ZRTOS_demo/zephyr/build/Kconfig/soc/soc/brcm/bcm2711/Kconfig.defconfig"
osource "/home/ljd/wsMA_prototyp/ZRTOS_demo/zephyr/build/Kconfig/soc/soc/bflb/Kconfig.defconfig"
osource "/home/ljd/wsMA_prototyp/ZRTOS_demo/zephyr/build/Kconfig/soc/soc/atmel/sam0/Kconfig.defconfig"
osource "/home/ljd/wsMA_prototyp/ZRTOS_demo/zephyr/build/Kconfig/soc/soc/atmel/sam/Kconfig.defconfig"
#osource "/home/ljd/wsMA_prototyp/ZRTOS_demo/zephyr/soc/aspeed/Kconfig.defconfig"
#osource "/home/ljd/wsMA_prototyp/ZRTOS_demo/zephyr/soc/arm/Kconfig.defconfig"
osource "/home/ljd/wsMA_prototyp/ZRTOS_demo/zephyr/build/Kconfig/soc/soc/arm/beetle/Kconfig.defconfig"
#osource "/home/ljd/wsMA_prototyp/ZRTOS_demo/zephyr/soc/antmicro/myra/Kconfig.defconfig"
#osource "/home/ljd/wsMA_prototyp/ZRTOS_demo/zephyr/soc/andestech/Kconfig.defconfig"
osource "/home/ljd/wsMA_prototyp/ZRTOS_demo/zephyr/build/Kconfig/soc/soc/amd/acp_6_0/Kconfig.defconfig"
osource "/home/ljd/wsMA_prototyp/ZRTOS_demo/zephyr/build/Kconfig/soc/soc/ambiq/Kconfig.defconfig"
#osource "/home/ljd/wsMA_prototyp/ZRTOS_demo/zephyr/soc/aesc/Kconfig.defconfig"
osource "/home/ljd/wsMA_prototyp/ZRTOS_demo/zephyr/build/Kconfig/soc/soc/adi/max32/Kconfig.defconfig"
```

## ZRTOS_copy/drivers/fuel_gauge/sbs_gauge/Kconfig
```kconfig
# Copyright (c) 2021 Leica Geosystems AG
# SPDX-License-Identifier: Apache-2.0

config SBS_GAUGE_NEW_API
	bool "Smart Battery Fuel Gauge"
	default y
	depends on DT_HAS_SBS_SBS_GAUGE_NEW_API_ENABLED
	select I2C
	help
	  Enable I2C-based/SMBus-based driver for a Smart Battery Fuel Gauge.

rsource "/home/ljd/wsMA_prototyp/ZRTOS_demo/zephyr/drivers/fuel_gauge/sbs_gauge/drivers/fuel_gauge/sbs_gauge/Kconfig.emul_sbs_gauge"
```

## ZRTOS_copy/drivers/ipm/Kconfig.nrfx
```kconfig
# nRF IPM driver configuration

# Copyright (c) 2019 Nordic Semiconductor ASA
# SPDX-License-Identifier: Apache-2.0

if IPM_NRFX

nrfx_ipc_num = 0
rsource "/home/ljd/wsMA_prototyp/ZRTOS_demo/zephyr/drivers/ipm/drivers/ipm/Kconfig.nrfx_ipc_channel"
nrfx_ipc_num = 1
rsource "/home/ljd/wsMA_prototyp/ZRTOS_demo/zephyr/drivers/ipm/drivers/ipm/Kconfig.nrfx_ipc_channel"
nrfx_ipc_num = 2
rsource "/home/ljd/wsMA_prototyp/ZRTOS_demo/zephyr/drivers/ipm/drivers/ipm/Kconfig.nrfx_ipc_channel"
nrfx_ipc_num = 3
rsource "/home/ljd/wsMA_prototyp/ZRTOS_demo/zephyr/drivers/ipm/drivers/ipm/Kconfig.nrfx_ipc_channel"
nrfx_ipc_num = 4
rsource "/home/ljd/wsMA_prototyp/ZRTOS_demo/zephyr/drivers/ipm/drivers/ipm/Kconfig.nrfx_ipc_channel"
nrfx_ipc_num = 5
rsource "/home/ljd/wsMA_prototyp/ZRTOS_demo/zephyr/drivers/ipm/drivers/ipm/Kconfig.nrfx_ipc_channel"
nrfx_ipc_num = 6
rsource "/home/ljd/wsMA_prototyp/ZRTOS_demo/zephyr/drivers/ipm/drivers/ipm/Kconfig.nrfx_ipc_channel"
nrfx_ipc_num = 7
rsource "/home/ljd/wsMA_prototyp/ZRTOS_demo/zephyr/drivers/ipm/drivers/ipm/Kconfig.nrfx_ipc_channel"
nrfx_ipc_num = 8
rsource "/home/ljd/wsMA_prototyp/ZRTOS_demo/zephyr/drivers/ipm/drivers/ipm/Kconfig.nrfx_ipc_channel"
nrfx_ipc_num = 9
rsource "/home/ljd/wsMA_prototyp/ZRTOS_demo/zephyr/drivers/ipm/drivers/ipm/Kconfig.nrfx_ipc_channel"
nrfx_ipc_num = 10
rsource "/home/ljd/wsMA_prototyp/ZRTOS_demo/zephyr/drivers/ipm/drivers/ipm/Kconfig.nrfx_ipc_channel"
nrfx_ipc_num = 11
rsource "/home/ljd/wsMA_prototyp/ZRTOS_demo/zephyr/drivers/ipm/drivers/ipm/Kconfig.nrfx_ipc_channel"
nrfx_ipc_num = 12
rsource "/home/ljd/wsMA_prototyp/ZRTOS_demo/zephyr/drivers/ipm/drivers/ipm/Kconfig.nrfx_ipc_channel"
nrfx_ipc_num = 13
rsource "/home/ljd/wsMA_prototyp/ZRTOS_demo/zephyr/drivers/ipm/drivers/ipm/Kconfig.nrfx_ipc_channel"
nrfx_ipc_num = 14
rsource "/home/ljd/wsMA_prototyp/ZRTOS_demo/zephyr/drivers/ipm/drivers/ipm/Kconfig.nrfx_ipc_channel"
nrfx_ipc_num = 15
rsource "/home/ljd/wsMA_prototyp/ZRTOS_demo/zephyr/drivers/ipm/drivers/ipm/Kconfig.nrfx_ipc_channel"

endif # IPM_NRFX
```

## ZRTOS_copy/drivers/pinctrl/renesas/Kconfig
```kconfig
# Copyright (c) 2024 EPAM Systems
# SPDX-License-Identifier: Apache-2.0

rsource "/home/ljd/wsMA_prototyp/ZRTOS_demo/zephyr/drivers/pinctrl/renesas/drivers/pinctrl/renesas/ra/Kconfig"
rsource "/home/ljd/wsMA_prototyp/ZRTOS_demo/zephyr/drivers/pinctrl/renesas/drivers/pinctrl/renesas/rcar/Kconfig"
rsource "/home/ljd/wsMA_prototyp/ZRTOS_demo/zephyr/drivers/pinctrl/renesas/drivers/pinctrl/renesas/rx/Kconfig"
rsource "/home/ljd/wsMA_prototyp/ZRTOS_demo/zephyr/drivers/pinctrl/renesas/drivers/pinctrl/renesas/rz/Kconfig"
rsource "/home/ljd/wsMA_prototyp/ZRTOS_demo/zephyr/drivers/pinctrl/renesas/drivers/pinctrl/renesas/smartbond/Kconfig"
```

## ZRTOS_copy/drivers/stepper/Kconfig
```kconfig
# SPDX-FileCopyrightText: Copyright (c) 2023 Carl Zeiss Meditec AG
# SPDX-License-Identifier: Apache-2.0

menuconfig STEPPER
	bool "Stepper Controller"
	help
	  Enable stepper controller

if STEPPER

module = STEPPER
module-str = stepper
source "subsys/logging/Kconfig.template.log_config"

config STEPPER_INIT_PRIORITY
	int "Stepper Motor Controller init priority"
	default 90
	help
	  Stepper motor controller initialization priority.

config STEPPER_SHELL
	bool "Stepper shell"
	depends on SHELL
	help
	  Enable stepper shell for testing.

comment "Stepper Drivers"

# zephyr-keep-sorted-start
rsource "/home/ljd/wsMA_prototyp/ZRTOS_demo/zephyr/drivers/stepper/drivers/stepper/Kconfig.fake"
rsource "/home/ljd/wsMA_prototyp/ZRTOS_demo/zephyr/drivers/stepper/drivers/stepper/adi_tmc/Kconfig"
rsource "/home/ljd/wsMA_prototyp/ZRTOS_demo/zephyr/drivers/stepper/drivers/stepper/allegro/Kconfig"
rsource "gpio_stepper/Kconfig"
rsource "/home/ljd/wsMA_prototyp/ZRTOS_demo/zephyr/drivers/stepper/drivers/stepper/ti/Kconfig"
# zephyr-keep-sorted-stop

endif
```
