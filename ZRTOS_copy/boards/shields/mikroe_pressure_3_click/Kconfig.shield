## ZRTOS_copy/boards/shields/mikroe_pressure_3_click/Kconfig.shield
```kconfig
# Copyright The Zephyr Project Contributors
# SPDX-License-Identifier: Apache-2.0

config SHIELD_MIKROE_PRESSURE_3_CLICK
 bool
 default $(shields_list_contains,mikroe_pressure_3_click)
```

## ZRTOS_copy/boards/shields/mikroe_weather_click/Kconfig.shield
```kconfig
# Copyright (c) 2024 Common Ground Electronics
# SPDX-License-Identifier: Apache-2.0

config SHIELD_MIKROE_WEATHER_CLICK_I2C
 bool
 default $(shields_list_contains,mikroe_weather_click_i2c)

config SHIELD_MIKROE_WEATHER_CLICK_SPI
 bool
 default $(shields_list_contains,mikroe_weather_click_spi)
```

## ZRTOS_copy/boards/shields/npm1300_ek/Kconfig.shield
```kconfig
# Copyright (c) 2023 Nordic Semiconductor ASA
# SPDX-License-Identifier: Apache-2.0

config SHIELD_NPM1300_EK
 bool
 default $(shields_list_contains,npm1300_ek)
```

## ZRTOS_copy/boards/shields/npm1304_ek/Kconfig.shield
```kconfig
# Copyright (c) 2025 Nordic Semiconductor ASA
# SPDX-License-Identifier: Apache-2.0

config SHIELD_NPM1304_EK
 bool
 default $(shields_list_contains,npm1304_ek)
```

## ZRTOS_copy/boards/shields/npm2100_ek/Kconfig.shield
```kconfig
# Copyright (c) 2025 Nordic Semiconductor ASA
# SPDX-License-Identifier: Apache-2.0

config SHIELD_NPM2100_EK
 bool
 default $(shields_list_contains,npm2100_ek)
```

## ZRTOS_copy/boards/shields/nrf7002eb/Kconfig.shield
```kconfig
# Copyright (c) 2024 Nordic Semiconductor ASA
# SPDX-License-Identifier: Apache-2.0

config SHIELD_NRF7002EB
 bool
 default $(shields_list_contains,nrf7002eb)

config SHIELD_NRF7002EB_COEX
 bool
 default $(shields_list_contains,nrf7002eb_coex)
```

## ZRTOS_copy/boards/shields/openthread_rcp_arduino/Kconfig.shield
```kconfig
# Copyright 2025 Basalte bv
# SPDX-License-Identifier: Apache-2.0

config SHIELD_OPENTHREAD_RCP_ARDUINO_SERIAL
 bool
 default $(shields_list_contains,openthread_rcp_arduino_serial)

config SHIELD_OPENTHREAD_RCP_ARDUINO_SPI
 bool
 default $(shields_list_contains,openthread_rcp_arduino_spi)
```

## ZRTOS_copy/boards/shields/renesas_us159_da14531evz/Kconfig.shield
```kconfig
# Copyright (c) 2024 Renesas Electronics Corporation
# SPDX-License-Identifier: Apache-2.0

config SHIELD_RENESAS_US159_DA14531EVZ
 bool
 default $(shields_list_contains,renesas_us159_da14531evz)
```

## ZRTOS_copy/boards/shields/rk043fn02h_ct/Kconfig.shield
```kconfig
# Copyright 2024 NXP
# SPDX-License-Identifier: Apache-2.0

config SHIELD_RK043FN02H_CT
 bool
 default $(shields_list_contains,rk043fn02h_ct)
```

## ZRTOS_copy/boards/shields/rk043fn66hs_ctg/Kconfig.shield
```kconfig
# Copyright 2024 NXP
# SPDX-License-Identifier: Apache-2.0

config SHIELD_RK043FN66HS_CTG
 bool
 default $(shields_list_contains,rk043fn66hs_ctg)
```

## ZRTOS_copy/boards/shields/semtech_sx1272mb2das/Kconfig.shield
```kconfig
# Copyright (c) 2020 Lemonbeat GmbH
# SPDX-License-Identifier: Apache-2.0

config SHIELD_SEMTECH_SX1272MB2DAS
 bool
 default $(shields_list_contains,semtech_sx1272mb2das)
```

## ZRTOS_copy/boards/shields/semtech_sx1276mb1mas/Kconfig.shield
```kconfig
# Copyright (c) 2023 Marcin Niestroj
# SPDX-License-Identifier: Apache-2.0

config SHIELD_SEMTECH_SX1276MB1MAS
 bool
 default $(shields_list_contains,semtech_sx1276mb1mas)
```

## ZRTOS_copy/boards/shields/ssd1306/Kconfig.shield
```kconfig
# Copyright (c) 2019 Linaro Limited
# SPDX-License-Identifier: Apache-2.0

config SHIELD_SSD1306_128X32
 bool
 default $(shields_list_contains,ssd1306_128x32)

config SHIELD_SSD1306_128X64
 bool
 default $(shields_list_contains,ssd1306_128x64)

config SHIELD_SSD1306_128X64_SPI
 bool
 default $(shields_list_contains,ssd1306_128x64_spi)

config SHIELD_SH1106_128X64
 bool
 default $(shields_list_contains,sh1106_128x64)
```

## ZRTOS_copy/boards/shields/st7735r/Kconfig.shield
```kconfig
# Copyright (c) 2020 Kim Bøndergaard <kim@fam-boendergaard.dk>
# SPDX-License-Identifier: Apache-2.0

config SHIELD_ST7735R_ADA_160x128
 bool
 default $(shields_list_contains,st7735r_ada_160x128)
```

## ZRTOS_copy/boards/shields/st_mb1897_cam/Kconfig.shield
```kconfig
# Copyright (c) 2025 STMicroelectronics

# SPDX-License-Identifier: Apache-2.0

config SHIELD_ST_MB1897_CAM
 bool
 default $(shields_list_contains,st_mb1897_cam)
```

## ZRTOS_copy/boards/shields/x_nucleo_iks02a1/Kconfig.shield
```kconfig
# Copyright (c) 2020 STMicroelectronics
# SPDX-License-Identifier: Apache-2.0

config SHIELD_X_NUCLEO_IKS02A1
 bool
 default $(shields_list_contains,x_nucleo_iks02a1)
```

## ZRTOS_copy/boards/shields/x_nucleo_iks4a1/Kconfig.shield
```kconfig
# Copyright (c) 2024 STMicroelectronics
# SPDX-License-Identifier: Apache-2.0

config SHIELD_X_NUCLEO_IKS01A4
 bool
 default $(shields_list_contains,x_nucleo_iks4a1)
```

## ZRTOS_copy/build/Kconfig/arch/Kconfig
```kconfig
# Load Zephyr Arch Kconfig descriptions.
osource "/home/ljd/wsMA_prototyp/ZRTOS_demo/zephyr/build/Kconfig/arch/arch/rx/Kconfig"
osource "/home/ljd/wsMA_prototyp/ZRTOS_demo/zephyr/build/Kconfig/arch/arch/x86/Kconfig"
osource "/home/ljd/wsMA_prototyp/ZRTOS_demo/zephyr/build/Kconfig/arch/arch/xtensa/Kconfig"
osource "/home/ljd/wsMA_prototyp/ZRTOS_demo/zephyr/build/Kconfig/arch/arch/sparc/Kconfig"
osource "/home/ljd/wsMA_prototyp/ZRTOS_demo/zephyr/build/Kconfig/arch/arch/riscv/Kconfig"
osource "/home/ljd/wsMA_prototyp/ZRTOS_demo/zephyr/build/Kconfig/arch/arch/posix/Kconfig"
osource "/home/ljd/wsMA_prototyp/ZRTOS_demo/zephyr/build/Kconfig/arch/arch/mips/Kconfig"
osource "/home/ljd/wsMA_prototyp/ZRTOS_demo/zephyr/build/Kconfig/arch/arch/arm64/Kconfig"
osource "/home/ljd/wsMA_prototyp/ZRTOS_demo/zephyr/build/Kconfig/arch/arch/arm/Kconfig"
osource "/home/ljd/wsMA_prototyp/ZRTOS_demo/zephyr/build/Kconfig/arch/arch/arc/Kconfig"
```

## ZRTOS_copy/build/Kconfig/boards/Kconfig
```kconfig
# Load Zephyr board Kconfig descriptions.
osource "/home/ljd/wsMA_prototyp/ZRTOS_demo/zephyr/build/Kconfig/boards/boards/native/native_sim/Kconfig"
```

## ZRTOS_copy/build/Kconfig/boards/Kconfig.defconfig
```kconfig
# Load Zephyr board defconfig descriptions.
osource "/home/ljd/wsMA_prototyp/ZRTOS_demo/zephyr/build/Kconfig/boards/boards/native/native_sim/Kconfig.defconfig"
```
