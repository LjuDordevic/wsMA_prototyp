## ZRTOS_copy/soc/nordic/common/Kconfig.peripherals
```kconfig
# Nordic Semiconductor nRFx MCU peripherals list.

# Copyright (c) 2018 Nordic Semiconductor ASA
# SPDX-License-Identifier: Apache-2.0

config HAS_HW_NRF_ACL
 bool
 default $(dt_compat_enabled,$(DT_COMPAT_NORDIC_NRF_ACL))

config HAS_HW_NRF_ADC
 bool
 default $(dt_compat_enabled,$(DT_COMPAT_NORDIC_NRF_ADC))

config HAS_HW_NRF_BPROT
 bool
 default $(dt_compat_enabled,$(DT_COMPAT_NORDIC_NRF_BPROT))

config HAS_HW_NRF_CC310
 bool
 default $(dt_compat_enabled,$(DT_COMPAT_ARM_CRYPTOCELL_310))

config HAS_HW_NRF_CC312
 bool
 default $(dt_compat_enabled,$(DT_COMPAT_ARM_CRYPTOCELL_312))

config HAS_HW_NRF_CCM
 bool
 default $(dt_compat_enabled,$(DT_COMPAT_NORDIC_NRF_CCM))

config HAS_HW_NRF_CCM_LFLEN_8BIT
 bool
 default $(dt_nodelabel_bool_prop,ccm,length-field-length-8-bits)

config HAS_HW_NRF_CCM_HEADERMASK
 bool
 default $(dt_nodelabel_bool_prop,ccm,headermask-supported)

config HAS_HW_NRF_CLOCK
 bool
 default $(dt_compat_enabled,$(DT_COMPAT_NORDIC_NRF_CLOCK))

config HAS_HW_NRF_COMP
 bool
 default $(dt_compat_enabled,$(DT_COMPAT_NORDIC_NRF_COMP))

config HAS_HW_NRF_CTRLAP
 bool
 default $(dt_compat_enabled,$(DT_COMPAT_NORDIC_NRF_CTRLAPPERI))

config HAS_HW_NRF_DCNF
 bool
 default $(dt_compat_enabled,$(DT_COMPAT_NORDIC_NRF_DCNF))

config HAS_HW_NRF_DPPIC
 bool
 default $(dt_compat_enabled,$(DT_COMPAT_NORDIC_NRF_DPPIC))

config HAS_HW_NRF_ECB
 bool
 default $(dt_compat_enabled,$(DT_COMPAT_NORDIC_NRF_ECB))

config HAS_HW_NRF_EGU0
 bool
 default $(dt_nodelabel_enabled_with_compat,egu0,$(DT_COMPAT_NORDIC_NRF_EGU))

config HAS_HW_NRF_EGU1
 bool
 default $(dt_nodelabel_enabled_with_compat,egu1,$(DT_COMPAT_NORDIC_NRF_EGU))

config HAS_HW_NRF_EGU2
 bool
 default $(dt_nodelabel_enabled_with_compat,egu2,$(DT_COMPAT_NORDIC_NRF_EGU))

config HAS_HW_NRF_EGU3
 bool
 default $(dt_nodelabel_enabled_with_compat,egu3,$(DT_COMPAT_NORDIC_NRF_EGU))

config HAS_HW_NRF_EGU4
 bool
 default $(dt_nodelabel_enabled_with_compat,egu4,$(DT_COMPAT_NORDIC_NRF_EGU))

config HAS_HW_NRF_EGU5
 bool
 default $(dt_nodelabel_enabled_with_compat,egu5,$(DT_COMPAT_NORDIC_NRF_EGU))

config HAS_HW_NRF_EGU020
 bool
 default $(dt_nodelabel_enabled_with_compat,egu020,$(DT_COMPAT_NORDIC_NRF_EGU))

config HAS_HW_NRF_GPIO0
 bool
 default $(dt_nodelabel_enabled_with_compat,gpio0,$(DT_COMPAT_NORDIC_NRF_GPIO))

config HAS_HW_NRF_GPIO1
 bool
 default $(dt_nodelabel_enabled_with_compat,gpio1,$(DT_COMPAT_NORDIC_NRF_GPIO))

config HAS_HW_NRF_GPIO2
 bool
 default $(dt_nodelabel_enabled_with_compat,gpio2,$(DT_COMPAT_NORDIC_NRF_GPIO))

config HAS_HW_NRF_GPIOTE0
 bool
 default $(dt_nodelabel_enabled_with_compat,gpiote0,$(DT_COMPAT_NORDIC_NRF_GPIOTE))

config HAS_HW_NRF_GPIOTE1
 bool
 default $(dt_nodelabel_enabled_with_compat,gpiote1,$(DT_COMPAT_NORDIC_NRF_GPIOTE))

config HAS_HW_NRF_GPIOTE20
 bool
 default $(dt_nodelabel_enabled_with_compat,gpiote20,$(DT_COMPAT_NORDIC_NRF_GPIOTE))

config HAS_HW_NRF_GPIOTE30
 bool
 default $(dt_nodelabel_enabled_with_compat,gpiote30,$(DT_COMPAT_NORDIC_NRF_GPIOTE))

config HAS_HW_NRF_GPIOTE130
 bool
 default $(dt_nodelabel_enabled_with_compat,gpiote130,$(DT_COMPAT_NORDIC_NRF_GPIOTE))

config HAS_HW_NRF_GPIOTE131
 bool
 default $(dt_nodelabel_enabled_with_compat,gpiote131,$(DT_COMPAT_NORDIC_NRF_GPIOTE))

config HAS_HW_NRF_GRTC
 bool
 default $(dt_compat_enabled,$(DT_COMPAT_NORDIC_NRF_GRTC))

config HAS_HW_NRF_I2S0
 bool
 default $(dt_nodelabel_enabled_with_compat,i2s0,$(DT_COMPAT_NORDIC_NRF_I2S))

config HAS_HW_NRF_I2S20
 bool
 default $(dt_nodelabel_enabled_with_compat,i2s20,$(DT_COMPAT_NORDIC_NRF_I2S))

config HAS_HW_NRF_KMU
 bool
 default $(dt_compat_enabled,$(DT_COMPAT_NORDIC_NRF_KMU))

config HAS_HW_NRF_LPCOMP
 bool
 default $(dt_compat_enabled,$(DT_COMPAT_NORDIC_NRF_LPCOMP))

config HAS_HW_NRF_MPU
 bool
 default $(dt_compat_enabled,$(DT_COMPAT_NORDIC_NRF_MPU))

config HAS_HW_NRF_MUTEX
 bool
 default $(dt_compat_enabled,$(DT_COMPAT_NORDIC_NRF_MUTEX))

config HAS_HW_NRF_MWU
 bool
 default $(dt_compat_enabled,$(DT_COMPAT_NORDIC_NRF_MWU))

config HAS_HW_NRF_NFCT
 bool
 default $(dt_compat_enabled,$(DT_COMPAT_NORDIC_NRF_NFCT)) || \
		 $(dt_compat_enabled,$(DT_COMPAT_NORDIC_NRF_NFCT_V2))

config HAS_HW_NRF_NVMC_PE
 bool
 default $(dt_nodelabel_bool_prop,flash_controller,partial-erase)

config HAS_HW_NRF_OSCILLATORS
 bool
 default $(dt_compat_enabled,$(DT_COMPAT_NORDIC_NRF_OSCILLATORS))

config HAS_HW_NRF_PDM0
 bool
 default $(dt_nodelabel_enabled_with_compat,pdm0,$(DT_COMPAT_NORDIC_NRF_PDM))

config HAS_HW_NRF_PDM20
 bool
 default $(dt_nodelabel_enabled_with_compat,pdm20,$(DT_COMPAT_NORDIC_NRF_PDM))

config HAS_HW_NRF_PDM21
 bool
 default $(dt_nodelabel_enabled_with_compat,pdm21,$(DT_COMPAT_NORDIC_NRF_PDM))

config HAS_HW_NRF_POWER
 bool
 default $(dt_compat_enabled,$(DT_COMPAT_NORDIC_NRF_POWER))

config HAS_HW_NRF_PPI
 bool
 default $(dt_compat_enabled,$(DT_COMPAT_NORDIC_NRF_PPI))

config HAS_HW_NRF_PWM0
 bool
 default $(dt_nodelabel_enabled_with_compat,pwm0,$(DT_COMPAT_NORDIC_NRF_PWM))

config HAS_HW_NRF_PWM1
 bool
 default $(dt_nodelabel_enabled_with_compat,pwm1,$(DT_COMPAT_NORDIC_NRF_PWM))

config HAS_HW_NRF_PWM2
 bool
 default $(dt_nodelabel_enabled_with_compat,pwm2,$(DT_COMPAT_NORDIC_NRF_PWM))

config HAS_HW_NRF_PWM3
 bool
 default $(dt_nodelabel_enabled_with_compat,pwm3,$(DT_COMPAT_NORDIC_NRF_PWM))

config HAS_HW_NRF_PWM20
 bool
 default $(dt_nodelabel_enabled_with_compat,pwm20,$(DT_COMPAT_NORDIC_NRF_PWM))

config HAS_HW_NRF_PWM21
 bool
 default $(dt_nodelabel_enabled_with_compat,pwm21,$(DT_COMPAT_NORDIC_NRF_PWM))

config HAS_HW_NRF_PWM22
 bool
 default $(dt_nodelabel_enabled_with_compat,pwm22,$(DT_COMPAT_NORDIC_NRF_PWM))

config HAS_HW_NRF_PWM120
 bool
 default $(dt_nodelabel_enabled_with_compat,pwm120,$(DT_COMPAT_NORDIC_NRF_PWM))

config HAS_HW_NRF_PWM130
 bool
 default $(dt_nodelabel_enabled_with_compat,pwm130,$(DT_COMPAT_NORDIC_NRF_PWM))

config HAS_HW_NRF_PWM131
 bool
 default $(dt_nodelabel_enabled_with_compat,pwm131,$(DT_COMPAT_NORDIC_NRF_PWM))

config HAS_HW_NRF_PWM132
 bool
 default $(dt_nodelabel_enabled_with_compat,pwm132,$(DT_COMPAT_NORDIC_NRF_PWM))

config HAS_HW_NRF_PWM133
 bool
 default $(dt_nodelabel_enabled_with_compat,pwm133,$(DT_COMPAT_NORDIC_NRF_PWM))

config HAS_HW_NRF_QDEC0
 bool
 default $(dt_nodelabel_enabled_with_compat,qdec0,$(DT_COMPAT_NORDIC_NRF_QDEC))

config HAS_HW_NRF_QDEC1
 bool
 default $(dt_nodelabel_enabled_with_compat,qdec1,$(DT_COMPAT_NORDIC_NRF_QDEC))

config HAS_HW_NRF_QDEC20
 bool
 default $(dt_nodelabel_enabled_with_compat,qdec20,$(DT_COMPAT_NORDIC_NRF_QDEC))

config HAS_HW_NRF_QDEC21
 bool
 default $(dt_nodelabel_enabled_with_compat,qdec21,$(DT_COMPAT_NORDIC_NRF_QDEC))

config HAS_HW_NRF_QDEC130
 bool
 default $(dt_nodelabel_enabled_with_compat,qdec130,$(DT_COMPAT_NORDIC_NRF_QDEC))

config HAS_HW_NRF_QDEC131
 bool
 default $(dt_nodelabel_enabled_with_compat,qdec131,$(DT_COMPAT_NORDIC_NRF_QDEC))

config HAS_HW_NRF_QSPI
 bool
 default $(dt_compat_enabled,$(DT_COMPAT_NORDIC_NRF_QSPI))

config HAS_HW_NRF_RADIO_BLE_2M
 bool
 default $(dt_nodelabel_bool_prop,radio,ble-2mbps-supported)

config HAS_HW_NRF_RADIO_BLE_CODED
 bool
 default $(dt_nodelabel_bool_prop,radio,ble-coded-phy-supported)

config HAS_HW_NRF_RADIO_CS
 bool
 default $(dt_nodelabel_bool_prop,radio,cs-supported)

config HAS_HW_NRF_RADIO_DFE
 bool
 default $(dt_nodelabel_bool_prop,radio,dfe-supported)

config HAS_HW_NRF_RADIO_IEEE802154
 bool
 default $(dt_nodelabel_bool_prop,radio,ieee802154-supported)

config HAS_HW_NRF_RADIO_TX_PWR_HIGH
 bool
 default $(dt_nodelabel_bool_prop,radio,tx-high-power-supported)

config HAS_HW_NRF_REGULATORS
 bool
 default $(dt_compat_enabled,$(DT_COMPAT_NORDIC_NRF_REGULATORS))

config HAS_HW_NRF_RESET
 bool
 default $(dt_compat_enabled,$(DT_COMPAT_NORDIC_NRF_RESET))

config HAS_HW_NRF_RNG
 bool
 default $(dt_compat_enabled,$(DT_COMPAT_NORDIC_NRF_RNG))

config HAS_HW_NRF_RTC0
 bool
 default $(dt_nodelabel_enabled_with_compat,rtc0,$(DT_COMPAT_NORDIC_NRF_RTC))

config HAS_HW_NRF_RTC1
 bool
 default $(dt_nodelabel_enabled_with_compat,rtc1,$(DT_COMPAT_NORDIC_NRF_RTC))

config HAS_HW_NRF_RTC2
 bool
 default $(dt_nodelabel_enabled_with_compat,rtc2,$(DT_COMPAT_NORDIC_NRF_RTC))

config HAS_HW_NRF_RTC130
 bool
 default $(dt_nodelabel_enabled_with_compat,rtc130,$(DT_COMPAT_NORDIC_NRF_RTC))

config HAS_HW_NRF_RTC131
 bool
 default $(dt_nodelabel_enabled_with_compat,rtc131,$(DT_COMPAT_NORDIC_NRF_RTC))

config HAS_HW_NRF_SAADC
 bool
 default $(dt_compat_enabled,$(DT_COMPAT_NORDIC_NRF_SAADC))

config HAS_HW_NRF_SPI0
 bool
 default $(dt_nodelabel_enabled_with_compat,spi0,$(DT_COMPAT_NORDIC_NRF_SPI))

config HAS_HW_NRF_SPI1
 bool
 default $(dt_nodelabel_enabled_with_compat,spi1,$(DT_COMPAT_NORDIC_NRF_SPI))

config HAS_HW_NRF_SPI2
 bool
 default $(dt_nodelabel_enabled_with_compat,spi2,$(DT_COMPAT_NORDIC_NRF_SPI))

config HAS_HW_NRF_SPIM0
 bool
 default $(dt_nodelabel_enabled_with_compat,spi0,$(DT_COMPAT_NORDIC_NRF_SPIM))

config HAS_HW_NRF_SPIM1
 bool
 default $(dt_nodelabel_enabled_with_compat,spi1,$(DT_COMPAT_NORDIC_NRF_SPIM))

config HAS_HW_NRF_SPIM2
 bool
 default $(dt_nodelabel_enabled_with_compat,spi2,$(DT_COMPAT_NORDIC_NRF_SPIM))

config HAS_HW_NRF_SPIM3
 bool
 default $(dt_nodelabel_enabled_with_compat,spi3,$(DT_COMPAT_NORDIC_NRF_SPIM))

config HAS_HW_NRF_SPIM4
 bool
 default $(dt_nodelabel_enabled_with_compat,spi4,$(DT_COMPAT_NORDIC_NRF_SPIM))

config HAS_HW_NRF_SPIM00
 bool
 default $(dt_nodelabel_enabled_with_compat,spi00,$(DT_COMPAT_NORDIC_NRF_SPIM))

config HAS_HW_NRF_SPIM01
 bool
 default $(dt_nodelabel_enabled_with_compat,spi01,$(DT_COMPAT_NORDIC_NRF_SPIM))

config HAS_HW_NRF_SPIM20
 bool
 default $(dt_nodelabel_enabled_with_compat,spi20,$(DT_COMPAT_NORDIC_NRF_SPIM))

config HAS_HW_NRF_SPIM21
 bool
 default $(dt_nodelabel_enabled_with_compat,spi21,$(DT_COMPAT_NORDIC_NRF_SPIM))

config HAS_HW_NRF_SPIM22
 bool
 default $(dt_nodelabel_enabled_with_compat,spi22,$(DT_COMPAT_NORDIC_NRF_SPIM))

config HAS_HW_NRF_SPIM23
 bool
 default $(dt_nodelabel_enabled_with_compat,spi23,$(DT_COMPAT_NORDIC_NRF_SPIM))

config HAS_HW_NRF_SPIM24
 bool
 default $(dt_nodelabel_enabled_with_compat,spi24,$(DT_COMPAT_NORDIC_NRF_SPIM))

config HAS_HW_NRF_SPIM30
 bool
 default $(dt_nodelabel_enabled_with_compat,spi30,$(DT_COMPAT_NORDIC_NRF_SPIM))

config HAS_HW_NRF_SPIM120
 bool
 default $(dt_nodelabel_enabled_with_compat,spi120,$(DT_COMPAT_NORDIC_NRF_SPIM))

config HAS_HW_NRF_SPIM121
 bool
 default $(dt_nodelabel_enabled_with_compat,spi121,$(DT_COMPAT_NORDIC_NRF_SPIM))

config HAS_HW_NRF_SPIM130
 bool
 default $(dt_nodelabel_enabled_with_compat,spi130,$(DT_COMPAT_NORDIC_NRF_SPIM))

config HAS_HW_NRF_SPIM131
 bool
 default $(dt_nodelabel_enabled_with_compat,spi131,$(DT_COMPAT_NORDIC_NRF_SPIM))

config HAS_HW_NRF_SPIM132
 bool
 default $(dt_nodelabel_enabled_with_compat,spi132,$(DT_COMPAT_NORDIC_NRF_SPIM))

config HAS_HW_NRF_SPIM133
 bool
 default $(dt_nodelabel_enabled_with_compat,spi133,$(DT_COMPAT_NORDIC_NRF_SPIM))

config HAS_HW_NRF_SPIM134
 bool
 default $(dt_nodelabel_enabled_with_compat,spi134,$(DT_COMPAT_NORDIC_NRF_SPIM))

config HAS_HW_NRF_SPIM135
 bool
 default $(dt_nodelabel_enabled_with_compat,spi135,$(DT_COMPAT_NORDIC_NRF_SPIM))

config HAS_HW_NRF_SPIM136
 bool
 default $(dt_nodelabel_enabled_with_compat,spi136,$(DT_COMPAT_NORDIC_NRF_SPIM))

config HAS_HW_NRF_SPIM137
 bool
 default $(dt_nodelabel_enabled_with_compat,spi137,$(DT_COMPAT_NORDIC_NRF_SPIM))

config HAS_HW_NRF_SPIS0
 bool
 default $(dt_nodelabel_enabled_with_compat,spi0,$(DT_COMPAT_NORDIC_NRF_SPIS))

config HAS_HW_NRF_SPIS1
 bool
 default $(dt_nodelabel_enabled_with_compat,spi1,$(DT_COMPAT_NORDIC_NRF_SPIS))

config HAS_HW_NRF_SPIS2
 bool
 default $(dt_nodelabel_enabled_with_compat,spi2,$(DT_COMPAT_NORDIC_NRF_SPIS))

config HAS_HW_NRF_SPIS3
 bool
 default $(dt_nodelabel_enabled_with_compat,spi3,$(DT_COMPAT_NORDIC_NRF_SPIS))

config HAS_HW_NRF_SPIS00
 bool
 default $(dt_nodelabel_enabled_with_compat,spi00,$(DT_COMPAT_NORDIC_NRF_SPIS))

config HAS_HW_NRF_SPIS01
 bool
 default $(dt_nodelabel_enabled_with_compat,spi01,$(DT_COMPAT_NORDIC_NRF_SPIS))

config HAS_HW_NRF_SPIS20
 bool
 default $(dt_nodelabel_enabled_with_compat,spi20,$(DT_COMPAT_NORDIC_NRF_SPIS))

config HAS_HW_NRF_SPIS21
 bool
 default $(dt_nodelabel_enabled_with_compat,spi21,$(DT_COMPAT_NORDIC_NRF_SPIS))

config HAS_HW_NRF_SPIS22
 bool
 default $(dt_nodelabel_enabled_with_compat,spi22,$(DT_COMPAT_NORDIC_NRF_SPIS))

config HAS_HW_NRF_SPIS23
 bool
 default $(dt_nodelabel_enabled_with_compat,spi23,$(DT_COMPAT_NORDIC_NRF_SPIS))

config HAS_HW_NRF_SPIS24
 bool
 default $(dt_nodelabel_enabled_with_compat,spi24,$(DT_COMPAT_NORDIC_NRF_SPIS))

config HAS_HW_NRF_SPIS30
 bool
 default $(dt_nodelabel_enabled_with_compat,spi30,$(DT_COMPAT_NORDIC_NRF_SPIS))

config HAS_HW_NRF_SPIS120
 bool
 default $(dt_nodelabel_enabled_with_compat,spis120,$(DT_COMPAT_NORDIC_NRF_SPIS))

config HAS_HW_NRF_SPIS130
 bool
 default $(dt_nodelabel_enabled_with_compat,spi130,$(DT_COMPAT_NORDIC_NRF_SPIS))

config HAS_HW_NRF_SPIS131
 bool
 default $(dt_nodelabel_enabled_with_compat,spi131,$(DT_COMPAT_NORDIC_NRF_SPIS))

config HAS_HW_NRF_SPIS132
 bool
 default $(dt_nodelabel_enabled_with_compat,spi132,$(DT_COMPAT_NORDIC_NRF_SPIS))

config HAS_HW_NRF_SPIS133
 bool
 default $(dt_nodelabel_enabled_with_compat,spi133,$(DT_COMPAT_NORDIC_NRF_SPIS))

config HAS_HW_NRF_SPIS134
 bool
 default $(dt_nodelabel_enabled_with_compat,spi134,$(DT_COMPAT_NORDIC_NRF_SPIS))

config HAS_HW_NRF_SPIS135
 bool
 default $(dt_nodelabel_enabled_with_compat,spi135,$(DT_COMPAT_NORDIC_NRF_SPIS))

config HAS_HW_NRF_SPIS136
 bool
 default $(dt_nodelabel_enabled_with_compat,spi136,$(DT_COMPAT_NORDIC_NRF_SPIS))

config HAS_HW_NRF_SPIS137
 bool
 default $(dt_nodelabel_enabled_with_compat,spi137,$(DT_COMPAT_NORDIC_NRF_SPIS))

config HAS_HW_NRF_SPU
 bool
 default $(dt_compat_enabled,$(DT_COMPAT_NORDIC_NRF_SPU))

config HAS_HW_NRF_SWI0
 bool
 default $(dt_nodelabel_enabled_with_compat,swi0,$(DT_COMPAT_NORDIC_NRF_SWI))

config HAS_HW_NRF_SWI1
 bool
 default $(dt_nodelabel_enabled_with_compat,swi1,$(DT_COMPAT_NORDIC_NRF_SWI))

config HAS_HW_NRF_SWI2
 bool
 default $(dt_nodelabel_enabled_with_compat,swi2,$(DT_COMPAT_NORDIC_NRF_SWI))

config HAS_HW_NRF_SWI3
 bool
 default $(dt_nodelabel_enabled_with_compat,swi3,$(DT_COMPAT_NORDIC_NRF_SWI))

config HAS_HW_NRF_SWI4
 bool
 default $(dt_nodelabel_enabled_with_compat,swi4,$(DT_COMPAT_NORDIC_NRF_SWI))

config HAS_HW_NRF_SWI5
 bool
 default $(dt_nodelabel_enabled_with_compat,swi5,$(DT_COMPAT_NORDIC_NRF_SWI))

config HAS_HW_NRF_TDM
 bool
 default $(dt_nodelabel_enabled_with_compat,tdm,$(DT_COMPAT_NORDIC_NRF_TDM))

config HAS_HW_NRF_TDM130
 bool
 default $(dt_nodelabel_enabled_with_compat,tdm130,$(DT_COMPAT_NORDIC_NRF_TDM))

config HAS_HW_NRF_TDM131
 bool
 default $(dt_nodelabel_enabled_with_compat,tdm131,$(DT_COMPAT_NORDIC_NRF_TDM))

config HAS_HW_NRF_TEMP
 bool
 default $(dt_compat_enabled,$(DT_COMPAT_NORDIC_NRF_TEMP))

config HAS_HW_NRF_TIMER0
 bool
 default $(dt_nodelabel_enabled_with_compat,timer0,$(DT_COMPAT_NORDIC_NRF_TIMER))

config HAS_HW_NRF_TIMER1
 bool
 default $(dt_nodelabel_enabled_with_compat,timer1,$(DT_COMPAT_NORDIC_NRF_TIMER))

config HAS_HW_NRF_TIMER2
 bool
 default $(dt_nodelabel_enabled_with_compat,timer2,$(DT_COMPAT_NORDIC_NRF_TIMER))

config HAS_HW_NRF_TIMER3
 bool
 default $(dt_nodelabel_enabled_with_compat,timer3,$(DT_COMPAT_NORDIC_NRF_TIMER))

config HAS_HW_NRF_TIMER4
 bool
 default $(dt_nodelabel_enabled_with_compat,timer4,$(DT_COMPAT_NORDIC_NRF_TIMER))

config HAS_HW_NRF_TIMER00
 bool
 default $(dt_nodelabel_enabled_with_compat,timer00,$(DT_COMPAT_NORDIC_NRF_TIMER))

config HAS_HW_NRF_TIMER10
 bool
 default $(dt_nodelabel_enabled_with_compat,timer10,$(DT_COMPAT_NORDIC_NRF_TIMER))

config HAS_HW_NRF_TIMER20
 bool
 default $(dt_nodelabel_enabled_with_compat,timer20,$(DT_COMPAT_NORDIC_NRF_TIMER))

config HAS_HW_NRF_TIMER21
 bool
 default $(dt_nodelabel_enabled_with_compat,timer21,$(DT_COMPAT_NORDIC_NRF_TIMER))

config HAS_HW_NRF_TIMER22
 bool
 default $(dt_nodelabel_enabled_with_compat,timer22,$(DT_COMPAT_NORDIC_NRF_TIMER))

config HAS_HW_NRF_TIMER23
 bool
 default $(dt_nodelabel_enabled_with_compat,timer23,$(DT_COMPAT_NORDIC_NRF_TIMER))

config HAS_HW_NRF_TIMER24
 bool
 default $(dt_nodelabel_enabled_with_compat,timer24,$(DT_COMPAT_NORDIC_NRF_TIMER))

config HAS_HW_NRF_TIMER020
 bool
 default $(dt_nodelabel_enabled_with_compat,timer020,$(DT_COMPAT_NORDIC_NRF_TIMER))

config HAS_HW_NRF_TIMER021
 bool
 default $(dt_nodelabel_enabled_with_compat,timer021,$(DT_COMPAT_NORDIC_NRF_TIMER))

config HAS_HW_NRF_TIMER022
 bool
 default $(dt_nodelabel_enabled_with_compat,timer022,$(DT_COMPAT_NORDIC_NRF_TIMER))

config HAS_HW_NRF_TIMER120
 bool
 default $(dt_nodelabel_enabled_with_compat,timer120,$(DT_COMPAT_NORDIC_NRF_TIMER))

config HAS_HW_NRF_TIMER121
 bool
 default $(dt_nodelabel_enabled_with_compat,timer121,$(DT_COMPAT_NORDIC_NRF_TIMER))

config HAS_HW_NRF_TIMER130
 bool
 default $(dt_nodelabel_enabled_with_compat,timer130,$(DT_COMPAT_NORDIC_NRF_TIMER))

config HAS_HW_NRF_TIMER131
 bool
 default $(dt_nodelabel_enabled_with_compat,timer131,$(DT_COMPAT_NORDIC_NRF_TIMER))

config HAS_HW_NRF_TIMER132
 bool
 default $(dt_nodelabel_enabled_with_compat,timer132,$(DT_COMPAT_NORDIC_NRF_TIMER))

config HAS_HW_NRF_TIMER133
 bool
 default $(dt_nodelabel_enabled_with_compat,timer133,$(DT_COMPAT_NORDIC_NRF_TIMER))

config HAS_HW_NRF_TIMER134
 bool
 default $(dt_nodelabel_enabled_with_compat,timer134,$(DT_COMPAT_NORDIC_NRF_TIMER))

config HAS_HW_NRF_TIMER135
 bool
 default $(dt_nodelabel_enabled_with_compat,timer135,$(DT_COMPAT_NORDIC_NRF_TIMER))

config HAS_HW_NRF_TIMER136
 bool
 default $(dt_nodelabel_enabled_with_compat,timer136,$(DT_COMPAT_NORDIC_NRF_TIMER))

config HAS_HW_NRF_TIMER137
 bool
 default $(dt_nodelabel_enabled_with_compat,timer137,$(DT_COMPAT_NORDIC_NRF_TIMER))

config HAS_HW_NRF_TWI0
 bool
 default $(dt_nodelabel_enabled_with_compat,i2c0,$(DT_COMPAT_NORDIC_NRF_TWI))

config HAS_HW_NRF_TWI1
 bool
 default $(dt_nodelabel_enabled_with_compat,i2c1,$(DT_COMPAT_NORDIC_NRF_TWI))

config HAS_HW_NRF_TWIM0
 bool
 default $(dt_nodelabel_enabled_with_compat,i2c0,$(DT_COMPAT_NORDIC_NRF_TWIM))

config HAS_HW_NRF_TWIM1
 bool
 default $(dt_nodelabel_enabled_with_compat,i2c1,$(DT_COMPAT_NORDIC_NRF_TWIM))

config HAS_HW_NRF_TWIM2
 bool
 default $(dt_nodelabel_enabled_with_compat,i2c2,$(DT_COMPAT_NORDIC_NRF_TWIM))

config HAS_HW_NRF_TWIM3
 bool
 default $(dt_nodelabel_enabled_with_compat,i2c3,$(DT_COMPAT_NORDIC_NRF_TWIM))

config HAS_HW_NRF_TWIM20
 bool
 default $(dt_nodelabel_enabled_with_compat,i2c20,$(DT_COMPAT_NORDIC_NRF_TWIM))

config HAS_HW_NRF_TWIM21
 bool
 default $(dt_nodelabel_enabled_with_compat,i2c21,$(DT_COMPAT_NORDIC_NRF_TWIM))

config HAS_HW_NRF_TWIM22
 bool
 default $(dt_nodelabel_enabled_with_compat,i2c22,$(DT_COMPAT_NORDIC_NRF_TWIM))

config HAS_HW_NRF_TWIM23
 bool
 default $(dt_nodelabel_enabled_with_compat,i2c23,$(DT_COMPAT_NORDIC_NRF_TWIM))

config HAS_HW_NRF_TWIM24
 bool
 default $(dt_nodelabel_enabled_with_compat,i2c24,$(DT_COMPAT_NORDIC_NRF_TWIM))

config HAS_HW_NRF_TWIM30
 bool
 default $(dt_nodelabel_enabled_with_compat,i2c30,$(DT_COMPAT_NORDIC_NRF_TWIM))

config HAS_HW_NRF_TWIM120
 bool
 default $(dt_nodelabel_enabled_with_compat,i2c120,$(DT_COMPAT_NORDIC_NRF_TWIM))

config HAS_HW_NRF_TWIM130
 bool
 default $(dt_nodelabel_enabled_with_compat,i2c130,$(DT_COMPAT_NORDIC_NRF_TWIM))

config HAS_HW_NRF_TWIM131
 bool
 default $(dt_nodelabel_enabled_with_compat,i2c131,$(DT_COMPAT_NORDIC_NRF_TWIM))

config HAS_HW_NRF_TWIM132
 bool
 default $(dt_nodelabel_enabled_with_compat,i2c132,$(DT_COMPAT_NORDIC_NRF_TWIM))

config HAS_HW_NRF_TWIM133
 bool
 default $(dt_nodelabel_enabled_with_compat,i2c133,$(DT_COMPAT_NORDIC_NRF_TWIM))

config HAS_HW_NRF_TWIM134
 bool
 default $(dt_nodelabel_enabled_with_compat,i2c134,$(DT_COMPAT_NORDIC_NRF_TWIM))

config HAS_HW_NRF_TWIM135
 bool
 default $(dt_nodelabel_enabled_with_compat,i2c135,$(DT_COMPAT_NORDIC_NRF_TWIM))

config HAS_HW_NRF_TWIM136
 bool
 default $(dt_nodelabel_enabled_with_compat,i2c136,$(DT_COMPAT_NORDIC_NRF_TWIM))

config HAS_HW_NRF_TWIM137
 bool
 default $(dt_nodelabel_enabled_with_compat,i2c137,$(DT_COMPAT_NORDIC_NRF_TWIM))

config HAS_HW_NRF_TWIS0
 bool
 default $(dt_nodelabel_enabled_with_compat,i2c0,$(DT_COMPAT_NORDIC_NRF_TWIS))

config HAS_HW_NRF_TWIS1
 bool
 default $(dt_nodelabel_enabled_with_compat,i2c1,$(DT_COMPAT_NORDIC_NRF_TWIS))

config HAS_HW_NRF_TWIS2
 bool
 default $(dt_nodelabel_enabled_with_compat,i2c2,$(DT_COMPAT_NORDIC_NRF_TWIS))

config HAS_HW_NRF_TWIS3
 bool
 default $(dt_nodelabel_enabled_with_compat,i2c3,$(DT_COMPAT_NORDIC_NRF_TWIS))

config HAS_HW_NRF_TWIS20
 bool
 default $(dt_nodelabel_enabled_with_compat,i2c20,$(DT_COMPAT_NORDIC_NRF_TWIS))

config HAS_HW_NRF_TWIS21
 bool
 default $(dt_nodelabel_enabled_with_compat,i2c21,$(DT_COMPAT_NORDIC_NRF_TWIS))

config HAS_HW_NRF_TWIS22
 bool
 default $(dt_nodelabel_enabled_with_compat,i2c22,$(DT_COMPAT_NORDIC_NRF_TWIS))

config HAS_HW_NRF_TWIS23
 bool
 default $(dt_nodelabel_enabled_with_compat,i2c23,$(DT_COMPAT_NORDIC_NRF_TWIS))

config HAS_HW_NRF_TWIS24
 bool
 default $(dt_nodelabel_enabled_with_compat,i2c24,$(DT_COMPAT_NORDIC_NRF_TWIS))

config HAS_HW_NRF_TWIS30
 bool
 default $(dt_nodelabel_enabled_with_compat,i2c30,$(DT_COMPAT_NORDIC_NRF_TWIS))

config HAS_HW_NRF_TWIS130
 bool
 default $(dt_nodelabel_enabled_with_compat,i2c130,$(DT_COMPAT_NORDIC_NRF_TWIS))

config HAS_HW_NRF_TWIS131
 bool
 default $(dt_nodelabel_enabled_with_compat,i2c131,$(DT_COMPAT_NORDIC_NRF_TWIS))

config HAS_HW_NRF_TWIS132
 bool
 default $(dt_nodelabel_enabled_with_compat,i2c132,$(DT_COMPAT_NORDIC_NRF_TWIS))

config HAS_HW_NRF_TWIS133
 bool
 default $(dt_nodelabel_enabled_with_compat,i2c133,$(DT_COMPAT_NORDIC_NRF_TWIS))

config HAS_HW_NRF_TWIS134
 bool
 default $(dt_nodelabel_enabled_with_compat,i2c134,$(DT_COMPAT_NORDIC_NRF_TWIS))

config HAS_HW_NRF_TWIS135
 bool
 default $(dt_nodelabel_enabled_with_compat,i2c135,$(DT_COMPAT_NORDIC_NRF_TWIS))

config HAS_HW_NRF_TWIS136
 bool
 default $(dt_nodelabel_enabled_with_compat,i2c136,$(DT_COMPAT_NORDIC_NRF_TWIS))

config HAS_HW_NRF_TWIS137
 bool
 default $(dt_nodelabel_enabled_with_compat,i2c137,$(DT_COMPAT_NORDIC_NRF_TWIS))

config HAS_HW_NRF_UART0
 bool
 default $(dt_nodelabel_enabled_with_compat,uart0,$(DT_COMPAT_NORDIC_NRF_UART))

config HAS_HW_NRF_UARTE0
 bool
 default $(dt_nodelabel_enabled_with_compat,uart0,$(DT_COMPAT_NORDIC_NRF_UARTE))

config HAS_HW_NRF_UARTE1
 bool
 default $(dt_nodelabel_enabled_with_compat,uart1,$(DT_COMPAT_NORDIC_NRF_UARTE))

config HAS_HW_NRF_UARTE2
 bool
 default $(dt_nodelabel_enabled_with_compat,uart2,$(DT_COMPAT_NORDIC_NRF_UARTE))

config HAS_HW_NRF_UARTE3
 bool
 default $(dt_nodelabel_enabled_with_compat,uart3,$(DT_COMPAT_NORDIC_NRF_UARTE))

config HAS_HW_NRF_UARTE00
 bool
 default $(dt_nodelabel_enabled_with_compat,uart00,$(DT_COMPAT_NORDIC_NRF_UARTE))

config HAS_HW_NRF_UARTE20
 bool
 default $(dt_nodelabel_enabled_with_compat,uart20,$(DT_COMPAT_NORDIC_NRF_UARTE))

config HAS_HW_NRF_UARTE21
 bool
 default $(dt_nodelabel_enabled_with_compat,uart21,$(DT_COMPAT_NORDIC_NRF_UARTE))

config HAS_HW_NRF_UARTE22
 bool
 default $(dt_nodelabel_enabled_with_compat,uart22,$(DT_COMPAT_NORDIC_NRF_UARTE))

config HAS_HW_NRF_UARTE23
 bool
 default $(dt_nodelabel_enabled_with_compat,uart23,$(DT_COMPAT_NORDIC_NRF_UARTE))

config HAS_HW_NRF_UARTE24
 bool
 default $(dt_nodelabel_enabled_with_compat,uart24,$(DT_COMPAT_NORDIC_NRF_UARTE))

config HAS_HW_NRF_UARTE30
 bool
 default $(dt_nodelabel_enabled_with_compat,uart30,$(DT_COMPAT_NORDIC_NRF_UARTE))

config HAS_HW_NRF_UARTE120
 bool
 default $(dt_nodelabel_enabled_with_compat,uart120,$(DT_COMPAT_NORDIC_NRF_UARTE))

config HAS_HW_NRF_UARTE130
 bool
 default $(dt_nodelabel_enabled_with_compat,uart130,$(DT_COMPAT_NORDIC_NRF_UARTE))

config HAS_HW_NRF_UARTE131
 bool
 default $(dt_nodelabel_enabled_with_compat,uart131,$(DT_COMPAT_NORDIC_NRF_UARTE))

config HAS_HW_NRF_UARTE132
 bool
 default $(dt_nodelabel_enabled_with_compat,uart132,$(DT_COMPAT_NORDIC_NRF_UARTE))

config HAS_HW_NRF_UARTE133
 bool
 default $(dt_nodelabel_enabled_with_compat,uart133,$(DT_COMPAT_NORDIC_NRF_UARTE))

config HAS_HW_NRF_UARTE134
 bool
 default $(dt_nodelabel_enabled_with_compat,uart134,$(DT_COMPAT_NORDIC_NRF_UARTE))

config HAS_HW_NRF_UARTE135
 bool
 default $(dt_nodelabel_enabled_with_compat,uart135,$(DT_COMPAT_NORDIC_NRF_UARTE))

config HAS_HW_NRF_UARTE136
 bool
 default $(dt_nodelabel_enabled_with_compat,uart136,$(DT_COMPAT_NORDIC_NRF_UARTE))

config HAS_HW_NRF_UARTE137
 bool
 default $(dt_nodelabel_enabled_with_compat,uart137,$(DT_COMPAT_NORDIC_NRF_UARTE))

config HAS_HW_NRF_USBD
 bool
 default $(dt_compat_enabled,$(DT_COMPAT_NORDIC_NRF_USBD))

config HAS_HW_NRF_USBREG
 bool
 default $(dt_compat_enabled,$(DT_COMPAT_NORDIC_NRF_USBREG))

config HAS_HW_NRF_VMC
 bool
 default $(dt_compat_enabled,$(DT_COMPAT_NORDIC_NRF_VMC))

config HAS_HW_NRF_WDT0
 bool
 default $(dt_nodelabel_enabled_with_compat,wdt0,$(DT_COMPAT_NORDIC_NRF_WDT))

config HAS_HW_NRF_WDT1
 bool
 default $(dt_nodelabel_enabled_with_compat,wdt1,$(DT_COMPAT_NORDIC_NRF_WDT))

config HAS_HW_NRF_WDT30
 bool
 default $(dt_nodelabel_enabled_with_compat,wdt30,$(DT_COMPAT_NORDIC_NRF_WDT))

config HAS_HW_NRF_WDT31
 bool
 default $(dt_nodelabel_enabled_with_compat,wdt31,$(DT_COMPAT_NORDIC_NRF_WDT))

config HAS_HW_NRF_WDT010
 bool
 default $(dt_nodelabel_enabled_with_compat,wdt010,$(DT_COMPAT_NORDIC_NRF_WDT))

config HAS_HW_NRF_WDT011
 bool
 default $(dt_nodelabel_enabled_with_compat,wdt011,$(DT_COMPAT_NORDIC_NRF_WDT))

config HAS_HW_NRF_WDT130
 bool
 default $(dt_nodelabel_enabled_with_compat,wdt130,$(DT_COMPAT_NORDIC_NRF_WDT))

config HAS_HW_NRF_WDT131
 bool
 default $(dt_nodelabel_enabled_with_compat,wdt131,$(DT_COMPAT_NORDIC_NRF_WDT))

config HAS_HW_NRF_WDT132
 bool
 default $(dt_nodelabel_enabled_with_compat,wdt132,$(DT_COMPAT_NORDIC_NRF_WDT))
```
