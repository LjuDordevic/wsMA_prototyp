## ZRTOS_copy/soc/ite/ec/Kconfig
```kconfig
# Copyright (c) 2020 ITE Corporation. All Rights Reserved.
# SPDX-License-Identifier: Apache-2.0

if SOC_FAMILY_ITE_EC

rsource "/home/ljd/wsMA_prototyp/ZRTOS_demo/zephyr/soc/ite/ec/soc/ite/ec/it51xxx/Kconfig"
rsource "/home/ljd/wsMA_prototyp/ZRTOS_demo/zephyr/soc/ite/ec/soc/ite/ec/it8xxx2/Kconfig"

endif # SOC_FAMILY_ITE_EC
```

## ZRTOS_copy/soc/ite/ec/Kconfig.soc
```kconfig
# Copyright (c) 2020 ITE Corporation. All Rights Reserved.
# SPDX-License-Identifier: Apache-2.0

config SOC_FAMILY_ITE_EC
	bool

config SOC_FAMILY
	default "ite_ec" if SOC_FAMILY_ITE_EC

rsource "/home/ljd/wsMA_prototyp/ZRTOS_demo/zephyr/soc/ite/ec/soc/ite/ec/it51xxx/Kconfig.soc"
rsource "/home/ljd/wsMA_prototyp/ZRTOS_demo/zephyr/soc/ite/ec/soc/ite/ec/it8xxx2/Kconfig.soc"
```

## ZRTOS_copy/soc/ite/ec/it8xxx2/Kconfig.defconfig.series
```kconfig
# Copyright (c) 2020 ITE Corporation. All Rights Reserved.
# SPDX-License-Identifier: Apache-2.0

if SOC_SERIES_IT8XXX2

config ARCH_HAS_CUSTOM_BUSY_WAIT
	default y

config SYS_CLOCK_HW_CYCLES_PER_SEC
	default 32768

config SYS_CLOCK_TICKS_PER_SEC
	default 4096

config UART_NS16550_WA_ISR_REENABLE_INTERRUPT
	default y
	depends on UART_NS16550

config FLASH_INIT_PRIORITY
	default 0

config IT8XXX2_PLL_SEQUENCE_PRIORITY
	int
	default 1
	depends on SOC_IT8XXX2_PLL_FLASH_48M

config VCMP_IT8XXX2_INIT_PRIORITY
	default 91 if VCMP_IT8XXX2_WORKQUEUE

config NUM_IRQS
	default 221 if SOC_IT82000BW
	default 185

config DYNAMIC_INTERRUPTS
	default y

config GEN_ISR_TABLES
	default y

config GEN_IRQ_START_VECTOR
	default 0

config GEN_SW_ISR_TABLE
	default y

config RISCV_SOC_INTERRUPT_INIT
	default y

rsource "/home/ljd/wsMA_prototyp/ZRTOS_demo/zephyr/soc/ite/ec/it8xxx2/soc/ite/ec/it8xxx2/Kconfig.defconfig.it81202bx"
rsource "/home/ljd/wsMA_prototyp/ZRTOS_demo/zephyr/soc/ite/ec/it8xxx2/soc/ite/ec/it8xxx2/Kconfig.defconfig.it81202cx"
rsource "/home/ljd/wsMA_prototyp/ZRTOS_demo/zephyr/soc/ite/ec/it8xxx2/soc/ite/ec/it8xxx2/Kconfig.defconfig.it81202dx"
rsource "/home/ljd/wsMA_prototyp/ZRTOS_demo/zephyr/soc/ite/ec/it8xxx2/soc/ite/ec/it8xxx2/Kconfig.defconfig.it81302bx"
rsource "/home/ljd/wsMA_prototyp/ZRTOS_demo/zephyr/soc/ite/ec/it8xxx2/soc/ite/ec/it8xxx2/Kconfig.defconfig.it81302cx"
rsource "/home/ljd/wsMA_prototyp/ZRTOS_demo/zephyr/soc/ite/ec/it8xxx2/soc/ite/ec/it8xxx2/Kconfig.defconfig.it81302dx"
rsource "/home/ljd/wsMA_prototyp/ZRTOS_demo/zephyr/soc/ite/ec/it8xxx2/soc/ite/ec/it8xxx2/Kconfig.defconfig.it82000bw"
rsource "/home/ljd/wsMA_prototyp/ZRTOS_demo/zephyr/soc/ite/ec/it8xxx2/soc/ite/ec/it8xxx2/Kconfig.defconfig.it82002aw"
rsource "/home/ljd/wsMA_prototyp/ZRTOS_demo/zephyr/soc/ite/ec/it8xxx2/soc/ite/ec/it8xxx2/Kconfig.defconfig.it82002bw"
rsource "/home/ljd/wsMA_prototyp/ZRTOS_demo/zephyr/soc/ite/ec/it8xxx2/soc/ite/ec/it8xxx2/Kconfig.defconfig.it82202ax"
rsource "/home/ljd/wsMA_prototyp/ZRTOS_demo/zephyr/soc/ite/ec/it8xxx2/soc/ite/ec/it8xxx2/Kconfig.defconfig.it82202bw"
rsource "/home/ljd/wsMA_prototyp/ZRTOS_demo/zephyr/soc/ite/ec/it8xxx2/soc/ite/ec/it8xxx2/Kconfig.defconfig.it82302ax"
rsource "/home/ljd/wsMA_prototyp/ZRTOS_demo/zephyr/soc/ite/ec/it8xxx2/soc/ite/ec/it8xxx2/Kconfig.defconfig.it82302bw"

endif # SOC_SERIES_IT8XXX2
```

## ZRTOS_copy/soc/microchip/miv/Kconfig.soc
```kconfig
# Copyright (c) 2024 Nordic Semiconductor ASA
# SPDX-License-Identifier: Apache-2.0

config SOC_FAMILY_MICROCHIP_MIV
	bool

config SOC_FAMILY
	default "microchip_miv" if SOC_FAMILY_MICROCHIP_MIV

rsource "/home/ljd/wsMA_prototyp/ZRTOS_demo/zephyr/soc/microchip/miv/soc/microchip/miv/miv/Kconfig.soc"
rsource "/home/ljd/wsMA_prototyp/ZRTOS_demo/zephyr/soc/microchip/miv/soc/microchip/miv/polarfire/Kconfig.soc"
```

## ZRTOS_copy/soc/microchip/sam/Kconfig.defconfig
```kconfig
# Copyright (C) 2025 Microchip Technology Inc. and its subsidiaries
#
# SPDX-License-Identifier: Apache-2.0
#

if SOC_FAMILY_MICROCHIP_SAM

rsource "/home/ljd/wsMA_prototyp/ZRTOS_demo/zephyr/soc/microchip/sam/soc/microchip/sam/sam_d5x_e5x/Kconfig.defconfig"
rsource "/home/ljd/wsMA_prototyp/ZRTOS_demo/zephyr/soc/microchip/sam/soc/microchip/sam/sama7/Kconfig.defconfig"
rsource "/home/ljd/wsMA_prototyp/ZRTOS_demo/zephyr/soc/microchip/sam/soc/microchip/sam/sama7g5/Kconfig.defconfig"

config CLOCK_CONTROL
	default y

config MFD
	default y
	depends on DT_HAS_MICROCHIP_SAM_FLEXCOM_ENABLED

endif # SOC_FAMILY_MICROCHIP_SAM
```

## ZRTOS_copy/soc/microchip/sam/Kconfig.soc
```kconfig
# Copyright (C) 2025 Microchip Technology Inc. and its subsidiaries
#
# SPDX-License-Identifier: Apache-2.0
#

config SOC_FAMILY_MICROCHIP_SAM
	bool

config SOC_FAMILY
	default "microchip_sam" if SOC_FAMILY_MICROCHIP_SAM

rsource "/home/ljd/wsMA_prototyp/ZRTOS_demo/zephyr/soc/microchip/sam/soc/microchip/sam/sam_d5x_e5x/Kconfig.soc"
rsource "/home/ljd/wsMA_prototyp/ZRTOS_demo/zephyr/soc/microchip/sam/soc/microchip/sam/sama7/Kconfig.soc"
rsource "/home/ljd/wsMA_prototyp/ZRTOS_demo/zephyr/soc/microchip/sam/soc/microchip/sam/sama7g5/Kconfig.soc"
```

## ZRTOS_copy/soc/microchip/sam/sama7/Kconfig.defconfig
```kconfig
# Copyright (C) 2025 Microchip Technology Inc. and its subsidiaries
#
# SPDX-License-Identifier: Apache-2.0
#

rsource "/home/ljd/wsMA_prototyp/ZRTOS_demo/zephyr/soc/microchip/sam/sama7/soc/microchip/sam/sama7/sama7d6/Kconfig.defconfig"
```

## ZRTOS_copy/soc/microchip/sam/sama7g5/Kconfig.soc
```kconfig
# Copyright (C) 2025 Microchip Technology Inc. and its subsidiaries
#
# SPDX-License-Identifier: Apache-2.0
#

config SOC_SERIES_SAMA7G5
	bool
	select SOC_FAMILY_MICROCHIP_SAM
	help
	  Enable support for Microchip SAM Microprocessors.

config SOC_SERIES
	default "sama7g5" if SOC_SERIES_SAMA7G5

rsource "/home/ljd/wsMA_prototyp/ZRTOS_demo/zephyr/soc/microchip/sam/sama7g5/soc/microchip/sam/sama7g5/Kconfig.soc.sama7g54"
```

## ZRTOS_copy/soc/nordic/Kconfig.defconfig
```kconfig
# Nordic Semiconductor nRFx MCU line

# Copyright (c) 2016-2018 Nordic Semiconductor ASA
# SPDX-License-Identifier: Apache-2.0

if SOC_FAMILY_NORDIC_NRF

rsource "/home/ljd/wsMA_prototyp/ZRTOS_demo/zephyr/soc/nordic/soc/nordic/common/Kconfig.defconfig"
rsource "/home/ljd/wsMA_prototyp/ZRTOS_demo/zephyr/soc/nordic/soc/nordic/nrf51/Kconfig.defconfig"
rsource "/home/ljd/wsMA_prototyp/ZRTOS_demo/zephyr/soc/nordic/soc/nordic/nrf52/Kconfig.defconfig"
rsource "/home/ljd/wsMA_prototyp/ZRTOS_demo/zephyr/soc/nordic/soc/nordic/nrf53/Kconfig.defconfig"
rsource "/home/ljd/wsMA_prototyp/ZRTOS_demo/zephyr/soc/nordic/soc/nordic/nrf54h/Kconfig.defconfig"
rsource "/home/ljd/wsMA_prototyp/ZRTOS_demo/zephyr/soc/nordic/soc/nordic/nrf54l/Kconfig.defconfig"
rsource "/home/ljd/wsMA_prototyp/ZRTOS_demo/zephyr/soc/nordic/soc/nordic/nrf91/Kconfig.defconfig"
rsource "/home/ljd/wsMA_prototyp/ZRTOS_demo/zephyr/soc/nordic/soc/nordic/nrf92/Kconfig.defconfig"

# If the kernel has timer support, enable clock control, except for SoCs
# based on the Haltium platform SoCs where clock control is not needed
# for the system timer
config CLOCK_CONTROL
	default y if SYS_CLOCK_EXISTS && !NRF_PLATFORM_HALTIUM && !RISCV_CORE_NORDIC_VPR

config SYS_CLOCK_TICKS_PER_SEC
	default 128 if !TICKLESS_KERNEL
	default 31250  if NRF_GRTC_TIMER
	default 32768

config ARCH_HAS_CUSTOM_BUSY_WAIT
	default y if ARM && !QEMU_TARGET

config BUILD_OUTPUT_HEX
	default y

if !CORTEX_M_DWT && NRF_RTC_TIMER
config SOC_HAS_TIMING_FUNCTIONS
	default y
endif

config GPIO
	default y
	depends on SPI

config UART_USE_RUNTIME_CONFIGURE
	default n

endif # SOC_FAMILY_NORDIC_NRF
```
