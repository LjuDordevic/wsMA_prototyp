## ZRTOS_copy/soc/nordic/nrf52/Kconfig.defconfig
```kconfig
# Nordic Semiconductor nRF52 MCU line

# Copyright (c) 2016-2018 Nordic Semiconductor ASA
# SPDX-License-Identifier: Apache-2.0

if SOC_SERIES_NRF52X

rsource "/home/ljd/wsMA_prototyp/ZRTOS_demo/zephyr/soc/nordic/nrf52/soc/nordic/nrf52/Kconfig.defconfig.nrf52805_CAAA"
rsource "/home/ljd/wsMA_prototyp/ZRTOS_demo/zephyr/soc/nordic/nrf52/soc/nordic/nrf52/Kconfig.defconfig.nrf52810_QFAA"
rsource "/home/ljd/wsMA_prototyp/ZRTOS_demo/zephyr/soc/nordic/nrf52/soc/nordic/nrf52/Kconfig.defconfig.nrf52811_QFAA"
rsource "/home/ljd/wsMA_prototyp/ZRTOS_demo/zephyr/soc/nordic/nrf52/soc/nordic/nrf52/Kconfig.defconfig.nrf52820_QDAA"
rsource "/home/ljd/wsMA_prototyp/ZRTOS_demo/zephyr/soc/nordic/nrf52/soc/nordic/nrf52/Kconfig.defconfig.nrf52832_CIAA"
rsource "/home/ljd/wsMA_prototyp/ZRTOS_demo/zephyr/soc/nordic/nrf52/soc/nordic/nrf52/Kconfig.defconfig.nrf52832_QFAA"
rsource "/home/ljd/wsMA_prototyp/ZRTOS_demo/zephyr/soc/nordic/nrf52/soc/nordic/nrf52/Kconfig.defconfig.nrf52832_QFAB"
rsource "/home/ljd/wsMA_prototyp/ZRTOS_demo/zephyr/soc/nordic/nrf52/soc/nordic/nrf52/Kconfig.defconfig.nrf52833_QDAA"
rsource "/home/ljd/wsMA_prototyp/ZRTOS_demo/zephyr/soc/nordic/nrf52/soc/nordic/nrf52/Kconfig.defconfig.nrf52833_QIAA"
rsource "/home/ljd/wsMA_prototyp/ZRTOS_demo/zephyr/soc/nordic/nrf52/soc/nordic/nrf52/Kconfig.defconfig.nrf52840_QFAA"
rsource "/home/ljd/wsMA_prototyp/ZRTOS_demo/zephyr/soc/nordic/nrf52/soc/nordic/nrf52/Kconfig.defconfig.nrf52840_QIAA"

config SYS_CLOCK_HW_CYCLES_PER_SEC
	default $(dt_nodelabel_int_prop,rtc1,clock-frequency)

endif # SOC_SERIES_NRF52X
```

## ZRTOS_copy/soc/nordic/nrf53/Kconfig.defconfig
```kconfig
# Nordic Semiconductor nRF53 MCU line

# Copyright (c) 2019 Nordic Semiconductor ASA
# SPDX-License-Identifier: Apache-2.0

if SOC_SERIES_NRF53X

rsource "/home/ljd/wsMA_prototyp/ZRTOS_demo/zephyr/soc/nordic/nrf53/soc/nordic/nrf53/Kconfig.defconfig.nrf5340_CPUAPP_QKAA"
rsource "/home/ljd/wsMA_prototyp/ZRTOS_demo/zephyr/soc/nordic/nrf53/soc/nordic/nrf53/Kconfig.defconfig.nrf5340_CPUNET_QKAA"

config SYS_CLOCK_HW_CYCLES_PER_SEC
	default $(dt_nodelabel_int_prop,rtc1,clock-frequency)

endif # SOC_SERIES_NRF53X
```

## ZRTOS_copy/soc/nordic/nrf53/Kconfig.sync_rtc
```kconfig
# Copyright (c) 2019 Nordic Semiconductor ASA
# SPDX-License-Identifier: Apache-2.0

config NRF53_SYNC_RTC
	bool "RTC clock synchronization"
	default y if LOG && !LOG_MODE_MINIMAL && !IS_BOOTLOADER && \
		(SOC_NRF53_CPUNET_ENABLE || SOC_NRF5340_CPUNET)
	depends on NRF_RTC_TIMER
	select NRFX_GPPI
	select MBOX if !IPM

if NRF53_SYNC_RTC

module = SYNC_RTC
module-str = Synchronized RTC
source "subsys/logging/Kconfig.template.log_config"

config NRF53_SYNC_RTC_INIT_PRIORITY
	int "nRF53 Synchronized RTC init priority"
	default APPLICATION_INIT_PRIORITY
	help
	  nRF53 Synchronized RTC initialization priority.

config NRF_RTC_TIMER_USER_CHAN_COUNT
	default 2 if NRF_802154_RADIO_DRIVER && SOC_COMPATIBLE_NRF5340_CPUNET
	default 3 if NRF_802154_RADIO_DRIVER
	default 1

config NRF53_SYNC_RTC_LOG_TIMESTAMP
	bool "Use Synchronized RTC for logging timestamp"
	default y

config NRF53_SYNC_RTC_IPM_OUT
	int "IPM channel from APP to NET"
	range 0 15
	default 7 if SOC_COMPATIBLE_NRF5340_CPUAPP
	default 8

config NRF53_SYNC_RTC_IPM_IN
	int "IPM channel from APP to NET"
	range 0 15
	default 8 if SOC_COMPATIBLE_NRF5340_CPUAPP
	default 7

ipm_num = 0
rsource "/home/ljd/wsMA_prototyp/ZRTOS_demo/zephyr/soc/nordic/nrf53/soc/nordic/nrf53/Kconfig.sync_rtc_ipm"
ipm_num = 1
rsource "/home/ljd/wsMA_prototyp/ZRTOS_demo/zephyr/soc/nordic/nrf53/soc/nordic/nrf53/Kconfig.sync_rtc_ipm"
ipm_num = 2
rsource "/home/ljd/wsMA_prototyp/ZRTOS_demo/zephyr/soc/nordic/nrf53/soc/nordic/nrf53/Kconfig.sync_rtc_ipm"
ipm_num = 3
rsource "/home/ljd/wsMA_prototyp/ZRTOS_demo/zephyr/soc/nordic/nrf53/soc/nordic/nrf53/Kconfig.sync_rtc_ipm"
ipm_num = 4
rsource "/home/ljd/wsMA_prototyp/ZRTOS_demo/zephyr/soc/nordic/nrf53/soc/nordic/nrf53/Kconfig.sync_rtc_ipm"
ipm_num = 5
rsource "/home/ljd/wsMA_prototyp/ZRTOS_demo/zephyr/soc/nordic/nrf53/soc/nordic/nrf53/Kconfig.sync_rtc_ipm"
ipm_num = 6
rsource "/home/ljd/wsMA_prototyp/ZRTOS_demo/zephyr/soc/nordic/nrf53/soc/nordic/nrf53/Kconfig.sync_rtc_ipm"
ipm_num = 7
rsource "/home/ljd/wsMA_prototyp/ZRTOS_demo/zephyr/soc/nordic/nrf53/soc/nordic/nrf53/Kconfig.sync_rtc_ipm"
ipm_num = 8
rsource "/home/ljd/wsMA_prototyp/ZRTOS_demo/zephyr/soc/nordic/nrf53/soc/nordic/nrf53/Kconfig.sync_rtc_ipm"
ipm_num = 9
rsource "/home/ljd/wsMA_prototyp/ZRTOS_demo/zephyr/soc/nordic/nrf53/soc/nordic/nrf53/Kconfig.sync_rtc_ipm"
ipm_num = 10
rsource "/home/ljd/wsMA_prototyp/ZRTOS_demo/zephyr/soc/nordic/nrf53/soc/nordic/nrf53/Kconfig.sync_rtc_ipm"
ipm_num = 11
rsource "/home/ljd/wsMA_prototyp/ZRTOS_demo/zephyr/soc/nordic/nrf53/soc/nordic/nrf53/Kconfig.sync_rtc_ipm"
ipm_num = 12
rsource "/home/ljd/wsMA_prototyp/ZRTOS_demo/zephyr/soc/nordic/nrf53/soc/nordic/nrf53/Kconfig.sync_rtc_ipm"
ipm_num = 13
rsource "/home/ljd/wsMA_prototyp/ZRTOS_demo/zephyr/soc/nordic/nrf53/soc/nordic/nrf53/Kconfig.sync_rtc_ipm"
ipm_num = 14
rsource "/home/ljd/wsMA_prototyp/ZRTOS_demo/zephyr/soc/nordic/nrf53/soc/nordic/nrf53/Kconfig.sync_rtc_ipm"
ipm_num = 15
rsource "/home/ljd/wsMA_prototyp/ZRTOS_demo/zephyr/soc/nordic/nrf53/soc/nordic/nrf53/Kconfig.sync_rtc_ipm"

endif # NRF53_SYNC_RTC
```

## ZRTOS_copy/soc/nuvoton/numaker/Kconfig.defconfig
```kconfig
# Copyright (c) 2023 Nuvoton Technology Corporation.
#
# SPDX-License-Identifier: Apache-2.0

if SOC_FAMILY_NUMAKER

rsource "/home/ljd/wsMA_prototyp/ZRTOS_demo/zephyr/soc/nuvoton/numaker/soc/nuvoton/numaker/m333x/Kconfig.defconfig"
rsource "/home/ljd/wsMA_prototyp/ZRTOS_demo/zephyr/soc/nuvoton/numaker/soc/nuvoton/numaker/m55m1x/Kconfig.defconfig"

config RESET
	default y

endif
```

## ZRTOS_copy/soc/nuvoton/numaker/m46x/Kconfig.defconfig
```kconfig
# Copyright (c) 2023 Nuvoton Technology Corporation.
#
# SPDX-License-Identifier: Apache-2.0

if SOC_SERIES_M46X

rsource "/home/ljd/wsMA_prototyp/ZRTOS_demo/zephyr/soc/nuvoton/numaker/m46x/soc/nuvoton/numaker/m46x/Kconfig.defconfig.m467"

endif # SOC_SERIES_M46X
```

## ZRTOS_copy/soc/nxp/imx/Kconfig.defconfig
```kconfig
# Copyright 2024 NXP
# SPDX-License-Identifier: Apache-2.0

if SOC_FAMILY_NXP_IMX

# Source series Kconfig files first, so SoCs
# can override the defaults given here
rsource "/home/ljd/wsMA_prototyp/ZRTOS_demo/zephyr/soc/nxp/imx/soc/nxp/imx/imx6sx/Kconfig.defconfig"
rsource "/home/ljd/wsMA_prototyp/ZRTOS_demo/zephyr/soc/nxp/imx/soc/nxp/imx/imx7d/Kconfig.defconfig"
rsource "/home/ljd/wsMA_prototyp/ZRTOS_demo/zephyr/soc/nxp/imx/soc/nxp/imx/imx8/Kconfig.defconfig"
rsource "/home/ljd/wsMA_prototyp/ZRTOS_demo/zephyr/soc/nxp/imx/soc/nxp/imx/imx8ulp/Kconfig.defconfig"
rsource "/home/ljd/wsMA_prototyp/ZRTOS_demo/zephyr/soc/nxp/imx/soc/nxp/imx/imx8x/Kconfig.defconfig"

endif # SOC_FAMILY_NXP_IMX
```

## ZRTOS_copy/soc/nxp/imx/imx8m/Kconfig.defconfig
```kconfig
# Copyright 2024 NXP
# SPDX-License-Identifier: Apache-2.0

if SOC_SERIES_IMX8M

rsource "/home/ljd/wsMA_prototyp/ZRTOS_demo/zephyr/soc/nxp/imx/imx8m/soc/nxp/imx/imx8m/Kconfig.defconfig.mimx8ml8_a53"
rsource "/home/ljd/wsMA_prototyp/ZRTOS_demo/zephyr/soc/nxp/imx/imx8m/soc/nxp/imx/imx8m/Kconfig.defconfig.mimx8ml8_adsp"
rsource "/home/ljd/wsMA_prototyp/ZRTOS_demo/zephyr/soc/nxp/imx/imx8m/soc/nxp/imx/imx8m/Kconfig.defconfig.mimx8ml8_m7"
rsource "/home/ljd/wsMA_prototyp/ZRTOS_demo/zephyr/soc/nxp/imx/imx8m/soc/nxp/imx/imx8m/Kconfig.defconfig.mimx8mm6_a53"
rsource "/home/ljd/wsMA_prototyp/ZRTOS_demo/zephyr/soc/nxp/imx/imx8m/soc/nxp/imx/imx8m/Kconfig.defconfig.mimx8mm6_m4"
rsource "/home/ljd/wsMA_prototyp/ZRTOS_demo/zephyr/soc/nxp/imx/imx8m/soc/nxp/imx/imx8m/Kconfig.defconfig.mimx8mn6_a53"
rsource "/home/ljd/wsMA_prototyp/ZRTOS_demo/zephyr/soc/nxp/imx/imx8m/soc/nxp/imx/imx8m/Kconfig.defconfig.mimx8mq6_m4"

endif # SOC_SERIES_IMX8M
```

## ZRTOS_copy/soc/nxp/imxrt/Kconfig.soc
```kconfig
# Copyright 2024 NXP
# SPDX-License-Identifier: Apache-2.0

config SOC_FAMILY_NXP_IMXRT
	bool

config SOC_FAMILY
	default "nxp_imxrt" if SOC_FAMILY_NXP_IMXRT

rsource "/home/ljd/wsMA_prototyp/ZRTOS_demo/zephyr/soc/nxp/imxrt/soc/nxp/imxrt/imxrt10xx/Kconfig.soc"
rsource "/home/ljd/wsMA_prototyp/ZRTOS_demo/zephyr/soc/nxp/imxrt/soc/nxp/imxrt/imxrt118x/Kconfig.soc"
rsource "/home/ljd/wsMA_prototyp/ZRTOS_demo/zephyr/soc/nxp/imxrt/soc/nxp/imxrt/imxrt11xx/Kconfig.soc"
rsource "/home/ljd/wsMA_prototyp/ZRTOS_demo/zephyr/soc/nxp/imxrt/soc/nxp/imxrt/imxrt5xx/Kconfig.soc"
rsource "/home/ljd/wsMA_prototyp/ZRTOS_demo/zephyr/soc/nxp/imxrt/soc/nxp/imxrt/imxrt6xx/Kconfig.soc"
rsource "/home/ljd/wsMA_prototyp/ZRTOS_demo/zephyr/soc/nxp/imxrt/soc/nxp/imxrt/imxrt7xx/Kconfig.soc"
```

## ZRTOS_copy/soc/nxp/kinetis/Kconfig.soc
```kconfig
# Copyright 2024 NXP
# SPDX-License-Identifier: Apache-2.0

config SOC_FAMILY_KINETIS
	bool

config SOC_FAMILY
	default "nxp_kinetis" if SOC_FAMILY_KINETIS

rsource "/home/ljd/wsMA_prototyp/ZRTOS_demo/zephyr/soc/nxp/kinetis/soc/nxp/kinetis/k2x/Kconfig.soc"
rsource "/home/ljd/wsMA_prototyp/ZRTOS_demo/zephyr/soc/nxp/kinetis/soc/nxp/kinetis/k32lx/Kconfig.soc"
rsource "/home/ljd/wsMA_prototyp/ZRTOS_demo/zephyr/soc/nxp/kinetis/soc/nxp/kinetis/k6x/Kconfig.soc"
rsource "/home/ljd/wsMA_prototyp/ZRTOS_demo/zephyr/soc/nxp/kinetis/soc/nxp/kinetis/k8x/Kconfig.soc"
rsource "/home/ljd/wsMA_prototyp/ZRTOS_demo/zephyr/soc/nxp/kinetis/soc/nxp/kinetis/ke1xf/Kconfig.soc"
rsource "/home/ljd/wsMA_prototyp/ZRTOS_demo/zephyr/soc/nxp/kinetis/soc/nxp/kinetis/ke1xz/Kconfig.soc"
rsource "/home/ljd/wsMA_prototyp/ZRTOS_demo/zephyr/soc/nxp/kinetis/soc/nxp/kinetis/kl2x/Kconfig.soc"
rsource "/home/ljd/wsMA_prototyp/ZRTOS_demo/zephyr/soc/nxp/kinetis/soc/nxp/kinetis/kv5x/Kconfig.soc"
rsource "/home/ljd/wsMA_prototyp/ZRTOS_demo/zephyr/soc/nxp/kinetis/soc/nxp/kinetis/kwx/Kconfig.soc"
```

## ZRTOS_copy/soc/nxp/layerscape/Kconfig.defconfig
```kconfig
#
# Copyright 2024 NXP
#
# SPDX-License-Identifier: Apache-2.0
#

if SOC_FAMILY_NXP_LAYERSCAPE

rsource "/home/ljd/wsMA_prototyp/ZRTOS_demo/zephyr/soc/nxp/layerscape/soc/nxp/layerscape/ls1046a/Kconfig.defconfig"

endif # SOC_FAMILY_NXP_LAYERSCAPE
```

## ZRTOS_copy/soc/nxp/lpc/Kconfig.defconfig
```kconfig
# Copyright 2017,2024 NXP
# SPDX-License-Identifier: Apache-2.0

if SOC_FAMILY_LPC

config BUILD_WITH_TFM
	default y if TRUSTED_EXECUTION_NONSECURE

rsource "/home/ljd/wsMA_prototyp/ZRTOS_demo/zephyr/soc/nxp/lpc/soc/nxp/lpc/lpc11u6x/Kconfig.defconfig"
rsource "/home/ljd/wsMA_prototyp/ZRTOS_demo/zephyr/soc/nxp/lpc/soc/nxp/lpc/lpc51u68/Kconfig.defconfig"
rsource "/home/ljd/wsMA_prototyp/ZRTOS_demo/zephyr/soc/nxp/lpc/soc/nxp/lpc/lpc54xxx/Kconfig.defconfig"
rsource "/home/ljd/wsMA_prototyp/ZRTOS_demo/zephyr/soc/nxp/lpc/soc/nxp/lpc/lpc55xxx/Kconfig.defconfig"

endif # SOC_FAMILY_LPC
```

## ZRTOS_copy/soc/nxp/mcx/Kconfig
```kconfig
# Copyright 2024-2025 NXP
# SPDX-License-Identifier: Apache-2.0

rsource "/home/ljd/wsMA_prototyp/ZRTOS_demo/zephyr/soc/nxp/mcx/soc/nxp/mcx/mcxa/Kconfig"
rsource "/home/ljd/wsMA_prototyp/ZRTOS_demo/zephyr/soc/nxp/mcx/soc/nxp/mcx/mcxc/Kconfig"
rsource "/home/ljd/wsMA_prototyp/ZRTOS_demo/zephyr/soc/nxp/mcx/soc/nxp/mcx/mcxn/Kconfig"
rsource "/home/ljd/wsMA_prototyp/ZRTOS_demo/zephyr/soc/nxp/mcx/soc/nxp/mcx/mcxw/Kconfig"
```

## ZRTOS_copy/soc/nxp/mcx/mcxw/mcxw7xx/Kconfig
```kconfig
# Copyright 2025 NXP
#
# SPDX-License-Identifier: Apache-2.0

rsource "/home/ljd/wsMA_prototyp/ZRTOS_demo/zephyr/soc/nxp/mcx/mcxw/mcxw7xx/soc/nxp/common/Kconfig.nbu"

config MCUX_CORE_SUFFIX
	default "_cm33_core0" if SOC_MCXW727C_CPU0
	default "_cm33_core1" if SOC_MCXW727C_CPU1
```

## ZRTOS_copy/soc/raspberrypi/rpi_pico/Kconfig.defconfig
```kconfig
# Raspberry Pi (RP) MCU line

# Copyright (c) 2021 Nordic Semiconductor ASA
# SPDX-License-Identifier: Apache-2.0

if SOC_FAMILY_RPI_PICO

rsource "/home/ljd/wsMA_prototyp/ZRTOS_demo/zephyr/soc/raspberrypi/rpi_pico/soc/raspberrypi/rpi_pico/rp2040/Kconfig.defconfig"
rsource "/home/ljd/wsMA_prototyp/ZRTOS_demo/zephyr/soc/raspberrypi/rpi_pico/soc/raspberrypi/rpi_pico/rp2350/Kconfig.defconfig"

endif # SOC_FAMILY_RPI_PICO
```

## ZRTOS_copy/soc/realtek/ec/Kconfig.soc
```kconfig
# SPDX-License-Identifier: Apache-2.0
#
# Copyright (c) 2024 Realtek Semiconductor Corporation, SIBG-SD7
#

config SOC_FAMILY_REALTEK_EC
	bool

config SOC_FAMILY
	string
	default "realtek_ec" if SOC_FAMILY_REALTEK_EC

rsource "/home/ljd/wsMA_prototyp/ZRTOS_demo/zephyr/soc/realtek/ec/soc/realtek/ec/rts5912/Kconfig.soc"
```
