## ZRTOS_copy/soc/st/stm32/stm32wbx/Kconfig.defconfig
```kconfig
# ST Microelectronics STM32WB MCU line

# Copyright (c) 2019 Linaro Limited
# SPDX-License-Identifier: Apache-2.0

if SOC_SERIES_STM32WBX

rsource "/home/ljd/wsMA_prototyp/ZRTOS_demo/zephyr/soc/st/stm32/stm32wbx/soc/st/stm32/stm32wbx/Kconfig.defconfig.stm32wb55xx"

config BT_USER_PHY_UPDATE
	default y if BT

endif # SOC_SERIES_STM32WBX
```

## ZRTOS_copy/soc/st/stm32/stm32wlx/Kconfig.defconfig
```kconfig
# STMicroelectronics STM32WL MCU line

# Copyright (c) 2020 STMicroelectronics.
# SPDX-License-Identifier: Apache-2.0

if SOC_SERIES_STM32WLX

rsource "/home/ljd/wsMA_prototyp/ZRTOS_demo/zephyr/soc/st/stm32/stm32wlx/soc/st/stm32/stm32wlx/Kconfig.defconfig.stm32wl54xx"
rsource "/home/ljd/wsMA_prototyp/ZRTOS_demo/zephyr/soc/st/stm32/stm32wlx/soc/st/stm32/stm32wlx/Kconfig.defconfig.stm32wl55xx"
rsource "/home/ljd/wsMA_prototyp/ZRTOS_demo/zephyr/soc/st/stm32/stm32wlx/soc/st/stm32/stm32wlx/Kconfig.defconfig.stm32wle4xx"
rsource "/home/ljd/wsMA_prototyp/ZRTOS_demo/zephyr/soc/st/stm32/stm32wlx/soc/st/stm32/stm32wlx/Kconfig.defconfig.stm32wle5xx"

endif # SOC_SERIES_STM32WLX
```

## ZRTOS_copy/soc/ti/k3/Kconfig.defconfig
```kconfig
# Copyright (c) 2024 Nordic Semiconductor ASA
# SPDX-License-Identifier: Apache-2.0

if SOC_FAMILY_TI_K3

rsource "/home/ljd/wsMA_prototyp/ZRTOS_demo/zephyr/soc/ti/k3/soc/ti/k3/am6x/Kconfig.defconfig"

endif # SOC_FAMILY_TI_K3
```

## ZRTOS_copy/soc/ti/simplelink/Kconfig
```kconfig
# Texas Instruments SimpleLink Family
# SPDX-License-Identifier: Apache-2.0
# Copyright (c) 2017 Zephyr Contributors

if SOC_FAMILY_TI_SIMPLELINK

rsource "/home/ljd/wsMA_prototyp/ZRTOS_demo/zephyr/soc/ti/simplelink/soc/ti/simplelink/cc13x2_cc26x2/Kconfig"
rsource "/home/ljd/wsMA_prototyp/ZRTOS_demo/zephyr/soc/ti/simplelink/soc/ti/simplelink/cc13x2x7_cc26x2x7/Kconfig"
rsource "/home/ljd/wsMA_prototyp/ZRTOS_demo/zephyr/soc/ti/simplelink/soc/ti/simplelink/cc23x0/Kconfig"
rsource "/home/ljd/wsMA_prototyp/ZRTOS_demo/zephyr/soc/ti/simplelink/soc/ti/simplelink/cc32xx/Kconfig"
rsource "/home/ljd/wsMA_prototyp/ZRTOS_demo/zephyr/soc/ti/simplelink/soc/ti/simplelink/msp432p4xx/Kconfig"

config HAS_TI_CCFG
	bool
	help
	  Selected when CCFG (Customer Configuration) registers
	  appear at the end of flash

config TI_SIMPLELINK_DYNAMIC_DPL_OBJECTS
	bool
	help
	  Turn on dynamic memory allocation for DPL objects. Reserves
	  extra memory for this.

endif # SOC_FAMILY_TI_SIMPLELINK
```

## ZRTOS_copy/soc/ti/simplelink/Kconfig.soc
```kconfig
# Texas Instruments SimpleLink Family
# SPDX-License-Identifier: Apache-2.0
# Copyright (c) 2017 Zephyr Contributors

config SOC_FAMILY_TI_SIMPLELINK
	bool

config SOC_FAMILY
	default "ti_simplelink" if SOC_FAMILY_TI_SIMPLELINK

rsource "/home/ljd/wsMA_prototyp/ZRTOS_demo/zephyr/soc/ti/simplelink/soc/ti/simplelink/cc13x2_cc26x2/Kconfig.soc"
rsource "/home/ljd/wsMA_prototyp/ZRTOS_demo/zephyr/soc/ti/simplelink/soc/ti/simplelink/cc13x2x7_cc26x2x7/Kconfig.soc"
rsource "/home/ljd/wsMA_prototyp/ZRTOS_demo/zephyr/soc/ti/simplelink/soc/ti/simplelink/cc23x0/Kconfig.soc"
rsource "/home/ljd/wsMA_prototyp/ZRTOS_demo/zephyr/soc/ti/simplelink/soc/ti/simplelink/cc32xx/Kconfig.soc"
rsource "/home/ljd/wsMA_prototyp/ZRTOS_demo/zephyr/soc/ti/simplelink/soc/ti/simplelink/msp432p4xx/Kconfig.soc"
```

## ZRTOS_copy/soc/wch/ch32v/Kconfig
```kconfig
# Copyright (c) 2024 Michael Hope
# Copyright (c) 2024 Jianxiong Gu
# SPDX-License-Identifier: Apache-2.0

config SOC_FAMILY_CH32V
	select RISCV
	select BUILD_OUTPUT_HEX
	select CH32V00X_SYSTICK
	imply XIP

if SOC_FAMILY_CH32V

config VECTOR_TABLE_SIZE
	int "Number of Interrupt and Exception Vectors"
	range 20 256
	help
	  This option defines the total number of interrupt and exception
	  vectors in the vector table.

rsource "/home/ljd/wsMA_prototyp/ZRTOS_demo/zephyr/soc/wch/ch32v/soc/wch/ch32v/ch32v00x/Kconfig"
rsource "/home/ljd/wsMA_prototyp/ZRTOS_demo/zephyr/soc/wch/ch32v/soc/wch/ch32v/qingke_v2a/Kconfig"
rsource "/home/ljd/wsMA_prototyp/ZRTOS_demo/zephyr/soc/wch/ch32v/soc/wch/ch32v/qingke_v4b/Kconfig"
rsource "/home/ljd/wsMA_prototyp/ZRTOS_demo/zephyr/soc/wch/ch32v/soc/wch/ch32v/qingke_v4c/Kconfig"
rsource "/home/ljd/wsMA_prototyp/ZRTOS_demo/zephyr/soc/wch/ch32v/soc/wch/ch32v/qingke_v4f/Kconfig"

endif # SOC_FAMILY_CH32V
```

## ZRTOS_copy/soc/wch/ch32v/qingke_v4f/Kconfig.defconfig
```kconfig
# Copyright (c) 2025 Bootlin
# SPDX-License-Identifier: Apache-2.0

if SOC_SERIES_QINGKE_V4F

config SYS_CLOCK_HW_CYCLES_PER_SEC
	default $(dt_node_int_prop_int,/cpus/cpu@0,clock-frequency)

config CLOCK_CONTROL
	default y

rsource "/home/ljd/wsMA_prototyp/ZRTOS_demo/zephyr/soc/wch/ch32v/qingke_v4f/soc/wch/ch32v/qingke_v4f/Kconfig.defconfig.ch32v303"
rsource "/home/ljd/wsMA_prototyp/ZRTOS_demo/zephyr/soc/wch/ch32v/qingke_v4f/soc/wch/ch32v/qingke_v4f/Kconfig.defconfig.ch32v307"

endif # SOC_SERIES_QINGKE_V4F
```

## ZRTOS_copy/subsys/bluetooth/audio/Kconfig
```kconfig
# Bluetooth Audio configuration options

#
# Copyright (c) 2020 Intel Corporation
# Copyright (c) 2022 Nordic Semiconductor ASA
#
# SPDX-License-Identifier: Apache-2.0
#

menuconfig BT_AUDIO
	bool "Bluetooth Audio support"
	help
	  This option enables Bluetooth Audio support. The specific
	  features that are available may depend on other features
	  that have been enabled in the stack, such as Periodic
	  Advertisement for Broadcast and L2CAP Dynamic Channel
	  for Unicast.

if BT_AUDIO

config BT_AUDIO_RX
 bool
 default BT_ASCS_ASE_SNK || BT_BAP_UNICAST_CLIENT_ASE_SRC || BT_BAP_BROADCAST_SINK

config BT_AUDIO_TX
 bool
 default BT_ASCS_ASE_SRC || BT_BAP_UNICAST_CLIENT_ASE_SNK || BT_BAP_BROADCAST_SOURCE

config BT_AUDIO_NOTIFY_RETRY_DELAY
	int "Delay for notification sending retried attempt in 1.25 ms units"
	range 6 3200
	default 20
	help
	  This option sets the time in 1.25 ms units before the stack will
	  retry to send notification that failed due to lack of TX buffers
	  available.

rsource "/home/ljd/wsMA_prototyp/ZRTOS_demo/zephyr/subsys/bluetooth/audio/subsys/bluetooth/audio/Kconfig.bap"
rsource "/home/ljd/wsMA_prototyp/ZRTOS_demo/zephyr/subsys/bluetooth/audio/subsys/bluetooth/audio/Kconfig.ccp"
rsource "/home/ljd/wsMA_prototyp/ZRTOS_demo/zephyr/subsys/bluetooth/audio/subsys/bluetooth/audio/Kconfig.vocs"
rsource "/home/ljd/wsMA_prototyp/ZRTOS_demo/zephyr/subsys/bluetooth/audio/subsys/bluetooth/audio/Kconfig.aics"
rsource "/home/ljd/wsMA_prototyp/ZRTOS_demo/zephyr/subsys/bluetooth/audio/subsys/bluetooth/audio/Kconfig.vcp"
rsource "/home/ljd/wsMA_prototyp/ZRTOS_demo/zephyr/subsys/bluetooth/audio/subsys/bluetooth/audio/Kconfig.micp"
rsource "/home/ljd/wsMA_prototyp/ZRTOS_demo/zephyr/subsys/bluetooth/audio/subsys/bluetooth/audio/Kconfig.csip"
rsource "/home/ljd/wsMA_prototyp/ZRTOS_demo/zephyr/subsys/bluetooth/audio/subsys/bluetooth/audio/Kconfig.tbs"
rsource "/home/ljd/wsMA_prototyp/ZRTOS_demo/zephyr/subsys/bluetooth/audio/subsys/bluetooth/audio/Kconfig.mcs"
rsource "/home/ljd/wsMA_prototyp/ZRTOS_demo/zephyr/subsys/bluetooth/audio/subsys/bluetooth/audio/Kconfig.has"
rsource "/home/ljd/wsMA_prototyp/ZRTOS_demo/zephyr/subsys/bluetooth/audio/subsys/bluetooth/audio/Kconfig.mpl"
rsource "/home/ljd/wsMA_prototyp/ZRTOS_demo/zephyr/subsys/bluetooth/audio/subsys/bluetooth/audio/Kconfig.mctl"
rsource "/home/ljd/wsMA_prototyp/ZRTOS_demo/zephyr/subsys/bluetooth/audio/subsys/bluetooth/audio/Kconfig.cap"
rsource "/home/ljd/wsMA_prototyp/ZRTOS_demo/zephyr/subsys/bluetooth/audio/subsys/bluetooth/audio/Kconfig.tmap"
rsource "/home/ljd/wsMA_prototyp/ZRTOS_demo/zephyr/subsys/bluetooth/audio/subsys/bluetooth/audio/Kconfig.gmap"
rsource "/home/ljd/wsMA_prototyp/ZRTOS_demo/zephyr/subsys/bluetooth/audio/subsys/bluetooth/audio/Kconfig.pbp"

module = BT_AUDIO
module-str = "Bluetooth Audio"
source "subsys/logging/Kconfig.template.log_config"

endif # BT_AUDIO
```

## ZRTOS_copy/subsys/gnss/Kconfig
```kconfig
# Copyright (c) 2025 Croxel Inc.
# Copyright (c) 2025 CogniPilot Foundation
# SPDX-License-Identifier: Apache-2.0

rsource "/home/ljd/wsMA_prototyp/ZRTOS_demo/zephyr/subsys/gnss/subsys/gnss/rtk/Kconfig"
```

## ZRTOS_copy/subsys/ipc/ipc_service/Kconfig
```kconfig
# Copyright (c) 2021 Nordic Semiconductor (ASA)
# SPDX-License-Identifier: Apache-2.0

menuconfig IPC_SERVICE
	bool "IPC service support multiple backends"
	help
	  Enables support for a service that can be shared by multiple
	  users. Ability to work in different backends. The backend
	  should be registered before application starts using
	  the IPC Service.

if IPC_SERVICE

rsource "/home/ljd/wsMA_prototyp/ZRTOS_demo/zephyr/subsys/ipc/ipc_service/subsys/ipc/ipc_service/backends/Kconfig"
rsource "/home/ljd/wsMA_prototyp/ZRTOS_demo/zephyr/subsys/ipc/ipc_service/subsys/ipc/ipc_service/lib/Kconfig"

module = IPC_SERVICE
module-str = IPC service and backend
source "subsys/logging/Kconfig.template.log_config"

endif # IPC_SERVICE
```

## ZRTOS_copy/subsys/mgmt/mcumgr/grp/Kconfig
```kconfig
# Copyright Runtime.io 2018. All rights reserved.
# Copyright Nordic Semiconductor ASA 2020-2022. All rights reserved.
# SPDX-License-Identifier: Apache-2.0

rsource "/home/ljd/wsMA_prototyp/ZRTOS_demo/zephyr/subsys/mgmt/mcumgr/grp/subsys/mgmt/mcumgr/grp/fs_mgmt/Kconfig"

rsource "/home/ljd/wsMA_prototyp/ZRTOS_demo/zephyr/subsys/mgmt/mcumgr/grp/subsys/mgmt/mcumgr/grp/img_mgmt/Kconfig"

rsource "/home/ljd/wsMA_prototyp/ZRTOS_demo/zephyr/subsys/mgmt/mcumgr/grp/subsys/mgmt/mcumgr/grp/img_mgmt_client/Kconfig"

rsource "/home/ljd/wsMA_prototyp/ZRTOS_demo/zephyr/subsys/mgmt/mcumgr/grp/subsys/mgmt/mcumgr/grp/os_mgmt/Kconfig"

rsource "/home/ljd/wsMA_prototyp/ZRTOS_demo/zephyr/subsys/mgmt/mcumgr/grp/subsys/mgmt/mcumgr/grp/os_mgmt_client/Kconfig"

rsource "/home/ljd/wsMA_prototyp/ZRTOS_demo/zephyr/subsys/mgmt/mcumgr/grp/subsys/mgmt/mcumgr/grp/shell_mgmt/Kconfig"

rsource "/home/ljd/wsMA_prototyp/ZRTOS_demo/zephyr/subsys/mgmt/mcumgr/grp/subsys/mgmt/mcumgr/grp/stat_mgmt/Kconfig"

rsource "/home/ljd/wsMA_prototyp/ZRTOS_demo/zephyr/subsys/mgmt/mcumgr/grp/subsys/mgmt/mcumgr/grp/zephyr_basic/Kconfig"

rsource "/home/ljd/wsMA_prototyp/ZRTOS_demo/zephyr/subsys/mgmt/mcumgr/grp/subsys/mgmt/mcumgr/grp/settings_mgmt/Kconfig"

rsource "/home/ljd/wsMA_prototyp/ZRTOS_demo/zephyr/subsys/mgmt/mcumgr/grp/subsys/mgmt/mcumgr/grp/enum_mgmt/Kconfig"
```

## ZRTOS_copy/subsys/usb/device_next/class/Kconfig
```kconfig
# Copyright (c) 2022 Nordic Semiconductor ASA
#
# SPDX-License-Identifier: Apache-2.0

rsource "/home/ljd/wsMA_prototyp/ZRTOS_demo/zephyr/subsys/usb/device_next/class/subsys/usb/device_next/class/Kconfig.loopback"
rsource "/home/ljd/wsMA_prototyp/ZRTOS_demo/zephyr/subsys/usb/device_next/class/subsys/usb/device_next/class/Kconfig.cdc_acm"
rsource "/home/ljd/wsMA_prototyp/ZRTOS_demo/zephyr/subsys/usb/device_next/class/subsys/usb/device_next/class/Kconfig.cdc_ecm"
rsource "/home/ljd/wsMA_prototyp/ZRTOS_demo/zephyr/subsys/usb/device_next/class/subsys/usb/device_next/class/Kconfig.cdc_ncm"
rsource "/home/ljd/wsMA_prototyp/ZRTOS_demo/zephyr/subsys/usb/device_next/class/subsys/usb/device_next/class/Kconfig.bt"
rsource "/home/ljd/wsMA_prototyp/ZRTOS_demo/zephyr/subsys/usb/device_next/class/subsys/usb/device_next/class/Kconfig.msc"
rsource "/home/ljd/wsMA_prototyp/ZRTOS_demo/zephyr/subsys/usb/device_next/class/subsys/usb/device_next/class/Kconfig.uac2"
rsource "/home/ljd/wsMA_prototyp/ZRTOS_demo/zephyr/subsys/usb/device_next/class/subsys/usb/device_next/class/Kconfig.hid"
rsource "/home/ljd/wsMA_prototyp/ZRTOS_demo/zephyr/subsys/usb/device_next/class/subsys/usb/device_next/class/Kconfig.midi2"
rsource "/home/ljd/wsMA_prototyp/ZRTOS_demo/zephyr/subsys/usb/device_next/class/subsys/usb/device_next/class/Kconfig.dfu"
rsource "/home/ljd/wsMA_prototyp/ZRTOS_demo/zephyr/subsys/usb/device_next/class/subsys/usb/device_next/class/Kconfig.uvc"
```

## core/test_dir/experiment_dec_copy/Kconfig
```kconfig
source "uo2/Kconfig"
source "uo3/Kconfig"
source "uo4/Kconfig"
source "uo4/Kconfig41"
source "uo5/Kconfig"
```

## exp/exp_u1/Kconfig
```kconfig
config HUNTER
  string "set name"
  default "user"

config OUNT
  int "set years"
  default "20"
```

## exp_old/Kconfig
```kconfig
config FOO
  string "FOO"
  default "first"

config BARR
  def_bool y

config FOO
  default "second"
```

## test_dir/experiment_dec/Kconfig
```kconfig
choice NAMED_CH
  prompt "pick"
  bool 
  config CH_A 
    bool "Op A"
  config CH_B
    bool "Op B"
endchoice   

source "uo2/Kconfig"
```
