## ZRTOS_copy/soc/renesas/ra/Kconfig.soc
```kconfig
# Copyright (c) 2023 TOKITA Hiroshi <tokita.hiroshi@fujitsu.com>
# SPDX-License-Identifier: Apache-2.0

config SOC_FAMILY_RENESAS_RA
	bool

config SOC_FAMILY
	default "renesas_ra" if SOC_FAMILY_RENESAS_RA

rsource "/home/ljd/wsMA_prototyp/ZRTOS_demo/zephyr/soc/renesas/ra/soc/renesas/ra/ra2a1/Kconfig.soc"
rsource "/home/ljd/wsMA_prototyp/ZRTOS_demo/zephyr/soc/renesas/ra/soc/renesas/ra/ra2l1/Kconfig.soc"
rsource "/home/ljd/wsMA_prototyp/ZRTOS_demo/zephyr/soc/renesas/ra/soc/renesas/ra/ra4c1/Kconfig.soc"
rsource "/home/ljd/wsMA_prototyp/ZRTOS_demo/zephyr/soc/renesas/ra/soc/renesas/ra/ra4e1/Kconfig.soc"
rsource "/home/ljd/wsMA_prototyp/ZRTOS_demo/zephyr/soc/renesas/ra/soc/renesas/ra/ra4e2/Kconfig.soc"
rsource "/home/ljd/wsMA_prototyp/ZRTOS_demo/zephyr/soc/renesas/ra/soc/renesas/ra/ra4l1/Kconfig.soc"
rsource "/home/ljd/wsMA_prototyp/ZRTOS_demo/zephyr/soc/renesas/ra/soc/renesas/ra/ra4m1/Kconfig.soc"
rsource "/home/ljd/wsMA_prototyp/ZRTOS_demo/zephyr/soc/renesas/ra/soc/renesas/ra/ra4m2/Kconfig.soc"
rsource "/home/ljd/wsMA_prototyp/ZRTOS_demo/zephyr/soc/renesas/ra/soc/renesas/ra/ra4m3/Kconfig.soc"
rsource "/home/ljd/wsMA_prototyp/ZRTOS_demo/zephyr/soc/renesas/ra/soc/renesas/ra/ra4w1/Kconfig.soc"
rsource "/home/ljd/wsMA_prototyp/ZRTOS_demo/zephyr/soc/renesas/ra/soc/renesas/ra/ra6e1/Kconfig.soc"
rsource "/home/ljd/wsMA_prototyp/ZRTOS_demo/zephyr/soc/renesas/ra/soc/renesas/ra/ra6e2/Kconfig.soc"
rsource "/home/ljd/wsMA_prototyp/ZRTOS_demo/zephyr/soc/renesas/ra/soc/renesas/ra/ra6m1/Kconfig.soc"
rsource "/home/ljd/wsMA_prototyp/ZRTOS_demo/zephyr/soc/renesas/ra/soc/renesas/ra/ra6m2/Kconfig.soc"
rsource "/home/ljd/wsMA_prototyp/ZRTOS_demo/zephyr/soc/renesas/ra/soc/renesas/ra/ra6m3/Kconfig.soc"
rsource "/home/ljd/wsMA_prototyp/ZRTOS_demo/zephyr/soc/renesas/ra/soc/renesas/ra/ra6m4/Kconfig.soc"
rsource "/home/ljd/wsMA_prototyp/ZRTOS_demo/zephyr/soc/renesas/ra/soc/renesas/ra/ra6m5/Kconfig.soc"
rsource "/home/ljd/wsMA_prototyp/ZRTOS_demo/zephyr/soc/renesas/ra/soc/renesas/ra/ra8d1/Kconfig.soc"
rsource "/home/ljd/wsMA_prototyp/ZRTOS_demo/zephyr/soc/renesas/ra/soc/renesas/ra/ra8d2/Kconfig.soc"
rsource "/home/ljd/wsMA_prototyp/ZRTOS_demo/zephyr/soc/renesas/ra/soc/renesas/ra/ra8m1/Kconfig.soc"
rsource "/home/ljd/wsMA_prototyp/ZRTOS_demo/zephyr/soc/renesas/ra/soc/renesas/ra/ra8m2/Kconfig.soc"
rsource "/home/ljd/wsMA_prototyp/ZRTOS_demo/zephyr/soc/renesas/ra/soc/renesas/ra/ra8p1/Kconfig.soc"
rsource "/home/ljd/wsMA_prototyp/ZRTOS_demo/zephyr/soc/renesas/ra/soc/renesas/ra/ra8t1/Kconfig.soc"
rsource "/home/ljd/wsMA_prototyp/ZRTOS_demo/zephyr/soc/renesas/ra/soc/renesas/ra/ra8t2/Kconfig.soc"
```

## ZRTOS_copy/soc/renesas/rx/Kconfig.soc
```kconfig
# Copyright (c) 2024 Renesas Electronics Corporation
# SPDX-License-Identifier: Apache-2.0

config SOC_FAMILY_RENESAS_RX
	bool

config SOC_FAMILY
	default "renesas_rx" if SOC_FAMILY_RENESAS_RX

rsource "/home/ljd/wsMA_prototyp/ZRTOS_demo/zephyr/soc/renesas/rx/soc/renesas/rx/rx130/Kconfig.soc"
rsource "/home/ljd/wsMA_prototyp/ZRTOS_demo/zephyr/soc/renesas/rx/soc/renesas/rx/rx261/Kconfig.soc"
rsource "/home/ljd/wsMA_prototyp/ZRTOS_demo/zephyr/soc/renesas/rx/soc/renesas/rx/rx26t/Kconfig.soc"
rsource "/home/ljd/wsMA_prototyp/ZRTOS_demo/zephyr/soc/renesas/rx/soc/renesas/rx/rx62n/Kconfig.soc"
```

## ZRTOS_copy/soc/renesas/rz/Kconfig
```kconfig
# Copyright (c) 2024-2025 Renesas Electronics Corporation
# SPDX-License-Identifier: Apache-2.0

config SOC_FAMILY_RENESAS_RZ
	select HAS_SEGGER_RTT if ZEPHYR_SEGGER_MODULE

if SOC_FAMILY_RENESAS_RZ

rsource "/home/ljd/wsMA_prototyp/ZRTOS_demo/zephyr/soc/renesas/rz/soc/renesas/rz/rza2m/Kconfig"
rsource "/home/ljd/wsMA_prototyp/ZRTOS_demo/zephyr/soc/renesas/rz/soc/renesas/rz/rza3ul/Kconfig"
rsource "/home/ljd/wsMA_prototyp/ZRTOS_demo/zephyr/soc/renesas/rz/soc/renesas/rz/rzg2l/Kconfig"
rsource "/home/ljd/wsMA_prototyp/ZRTOS_demo/zephyr/soc/renesas/rz/soc/renesas/rz/rzg2ul/Kconfig"
rsource "/home/ljd/wsMA_prototyp/ZRTOS_demo/zephyr/soc/renesas/rz/soc/renesas/rz/rzg3s/Kconfig"
rsource "/home/ljd/wsMA_prototyp/ZRTOS_demo/zephyr/soc/renesas/rz/soc/renesas/rz/rzn2l/Kconfig"
rsource "/home/ljd/wsMA_prototyp/ZRTOS_demo/zephyr/soc/renesas/rz/soc/renesas/rz/rzt2l/Kconfig"
rsource "/home/ljd/wsMA_prototyp/ZRTOS_demo/zephyr/soc/renesas/rz/soc/renesas/rz/rzt2m/Kconfig"
rsource "/home/ljd/wsMA_prototyp/ZRTOS_demo/zephyr/soc/renesas/rz/soc/renesas/rz/rzv2h/Kconfig"
rsource "/home/ljd/wsMA_prototyp/ZRTOS_demo/zephyr/soc/renesas/rz/soc/renesas/rz/rzv2l/Kconfig"
rsource "/home/ljd/wsMA_prototyp/ZRTOS_demo/zephyr/soc/renesas/rz/soc/renesas/rz/rzv2n/Kconfig"

endif # SOC_FAMILY_RENESAS_RZ
```

## ZRTOS_copy/soc/renesas/smartbond/Kconfig
```kconfig
# Copyright (c) 2022 Renesas Electronics Corporation
# SPDX-License-Identifier: Apache-2.0

if SOC_FAMILY_RENESAS_SMARTBOND

rsource "/home/ljd/wsMA_prototyp/ZRTOS_demo/zephyr/soc/renesas/smartbond/soc/renesas/smartbond/da1469x/Kconfig"

endif # SOC_FAMILY_RENESAS_SMARTBOND
```

## ZRTOS_copy/soc/rockchip/rk3399/Kconfig.defconfig
```kconfig
#
# Copyright 2022 Huawei France Technologies SASU
#
# SPDX-License-Identifier: Apache-2.0
#

if SOC_SERIES_RK3399

rsource "/home/ljd/wsMA_prototyp/ZRTOS_demo/zephyr/soc/rockchip/rk3399/soc/rockchip/rk3399/Kconfig.defconfig.rk3399"

endif # SOC_SERIES_RK3399
```

## ZRTOS_copy/soc/silabs/silabs_s1/Kconfig
```kconfig
# Copyright (c) 2024 GARDENA GmbH
# SPDX-License-Identifier: Apache-2.0

if SOC_FAMILY_SILABS_S1

config SOC_FAMILY_SILABS_S1
	select HAS_SEGGER_RTT if ZEPHYR_SEGGER_MODULE
	select BUILD_OUTPUT_HEX
	select SOC_EARLY_INIT_HOOK

rsource "/home/ljd/wsMA_prototyp/ZRTOS_demo/zephyr/soc/silabs/silabs_s1/soc/silabs/silabs_s1/efm32gg11b/Kconfig"
rsource "/home/ljd/wsMA_prototyp/ZRTOS_demo/zephyr/soc/silabs/silabs_s1/soc/silabs/silabs_s1/efm32gg12b/Kconfig"
rsource "/home/ljd/wsMA_prototyp/ZRTOS_demo/zephyr/soc/silabs/silabs_s1/soc/silabs/silabs_s1/efm32jg12b/Kconfig"
rsource "/home/ljd/wsMA_prototyp/ZRTOS_demo/zephyr/soc/silabs/silabs_s1/soc/silabs/silabs_s1/efm32pg12b/Kconfig"
rsource "/home/ljd/wsMA_prototyp/ZRTOS_demo/zephyr/soc/silabs/silabs_s1/soc/silabs/silabs_s1/efm32pg1b/Kconfig"
rsource "/home/ljd/wsMA_prototyp/ZRTOS_demo/zephyr/soc/silabs/silabs_s1/soc/silabs/silabs_s1/efr32bg13p/Kconfig"
rsource "/home/ljd/wsMA_prototyp/ZRTOS_demo/zephyr/soc/silabs/silabs_s1/soc/silabs/silabs_s1/efr32fg13p/Kconfig"
rsource "/home/ljd/wsMA_prototyp/ZRTOS_demo/zephyr/soc/silabs/silabs_s1/soc/silabs/silabs_s1/efr32fg1p/Kconfig"
rsource "/home/ljd/wsMA_prototyp/ZRTOS_demo/zephyr/soc/silabs/silabs_s1/soc/silabs/silabs_s1/efr32mg12p/Kconfig"

endif
```

## ZRTOS_copy/soc/silabs/silabs_s1/Kconfig.defconfig
```kconfig
# Copyright (c) 2024 Silicon Laboratories Inc.
# SPDX-License-Identifier: Apache-2.0

rsource "/home/ljd/wsMA_prototyp/ZRTOS_demo/zephyr/soc/silabs/silabs_s1/soc/silabs/silabs_s1/efm32gg11b/Kconfig.defconfig"
rsource "/home/ljd/wsMA_prototyp/ZRTOS_demo/zephyr/soc/silabs/silabs_s1/soc/silabs/silabs_s1/efm32gg12b/Kconfig.defconfig"
rsource "/home/ljd/wsMA_prototyp/ZRTOS_demo/zephyr/soc/silabs/silabs_s1/soc/silabs/silabs_s1/efm32jg12b/Kconfig.defconfig"
rsource "/home/ljd/wsMA_prototyp/ZRTOS_demo/zephyr/soc/silabs/silabs_s1/soc/silabs/silabs_s1/efm32pg12b/Kconfig.defconfig"
rsource "/home/ljd/wsMA_prototyp/ZRTOS_demo/zephyr/soc/silabs/silabs_s1/soc/silabs/silabs_s1/efm32pg1b/Kconfig.defconfig"
rsource "/home/ljd/wsMA_prototyp/ZRTOS_demo/zephyr/soc/silabs/silabs_s1/soc/silabs/silabs_s1/efr32bg13p/Kconfig.defconfig"
rsource "/home/ljd/wsMA_prototyp/ZRTOS_demo/zephyr/soc/silabs/silabs_s1/soc/silabs/silabs_s1/efr32fg13p/Kconfig.defconfig"
rsource "/home/ljd/wsMA_prototyp/ZRTOS_demo/zephyr/soc/silabs/silabs_s1/soc/silabs/silabs_s1/efr32fg1p/Kconfig.defconfig"
rsource "/home/ljd/wsMA_prototyp/ZRTOS_demo/zephyr/soc/silabs/silabs_s1/soc/silabs/silabs_s1/efr32mg12p/Kconfig.defconfig"
```

## ZRTOS_copy/soc/silabs/silabs_s2/Kconfig.defconfig
```kconfig
# Copyright (c) 2024 Silicon Laboratories Inc.
# SPDX-License-Identifier: Apache-2.0

rsource "/home/ljd/wsMA_prototyp/ZRTOS_demo/zephyr/soc/silabs/silabs_s2/soc/silabs/silabs_s2/xg21/Kconfig.defconfig"
rsource "/home/ljd/wsMA_prototyp/ZRTOS_demo/zephyr/soc/silabs/silabs_s2/soc/silabs/silabs_s2/xg22/Kconfig.defconfig"
rsource "/home/ljd/wsMA_prototyp/ZRTOS_demo/zephyr/soc/silabs/silabs_s2/soc/silabs/silabs_s2/xg23/Kconfig.defconfig"
rsource "/home/ljd/wsMA_prototyp/ZRTOS_demo/zephyr/soc/silabs/silabs_s2/soc/silabs/silabs_s2/xg24/Kconfig.defconfig"
rsource "/home/ljd/wsMA_prototyp/ZRTOS_demo/zephyr/soc/silabs/silabs_s2/soc/silabs/silabs_s2/xg26/Kconfig.defconfig"
rsource "/home/ljd/wsMA_prototyp/ZRTOS_demo/zephyr/soc/silabs/silabs_s2/soc/silabs/silabs_s2/xg27/Kconfig.defconfig"
rsource "/home/ljd/wsMA_prototyp/ZRTOS_demo/zephyr/soc/silabs/silabs_s2/soc/silabs/silabs_s2/xg28/Kconfig.defconfig"
rsource "/home/ljd/wsMA_prototyp/ZRTOS_demo/zephyr/soc/silabs/silabs_s2/soc/silabs/silabs_s2/xg29/Kconfig.defconfig"
```

## ZRTOS_copy/soc/silabs/silabs_s2/Kconfig.soc
```kconfig
# Copyright (c) 2017 Christian Taedcke
# SPDX-License-Identifier: Apache-2.0

config SOC_FAMILY_SILABS_S2
	bool

rsource "/home/ljd/wsMA_prototyp/ZRTOS_demo/zephyr/soc/silabs/silabs_s2/soc/silabs/silabs_s2/xg21/Kconfig.soc"
rsource "/home/ljd/wsMA_prototyp/ZRTOS_demo/zephyr/soc/silabs/silabs_s2/soc/silabs/silabs_s2/xg22/Kconfig.soc"
rsource "/home/ljd/wsMA_prototyp/ZRTOS_demo/zephyr/soc/silabs/silabs_s2/soc/silabs/silabs_s2/xg23/Kconfig.soc"
rsource "/home/ljd/wsMA_prototyp/ZRTOS_demo/zephyr/soc/silabs/silabs_s2/soc/silabs/silabs_s2/xg24/Kconfig.soc"
rsource "/home/ljd/wsMA_prototyp/ZRTOS_demo/zephyr/soc/silabs/silabs_s2/soc/silabs/silabs_s2/xg26/Kconfig.soc"
rsource "/home/ljd/wsMA_prototyp/ZRTOS_demo/zephyr/soc/silabs/silabs_s2/soc/silabs/silabs_s2/xg27/Kconfig.soc"
rsource "/home/ljd/wsMA_prototyp/ZRTOS_demo/zephyr/soc/silabs/silabs_s2/soc/silabs/silabs_s2/xg28/Kconfig.soc"
rsource "/home/ljd/wsMA_prototyp/ZRTOS_demo/zephyr/soc/silabs/silabs_s2/soc/silabs/silabs_s2/xg29/Kconfig.soc"
```

## ZRTOS_copy/soc/silabs/silabs_sim3/Kconfig.defconfig
```kconfig
# Copyright (c) 2024 Silicon Laboratories Inc.
# SPDX-License-Identifier: Apache-2.0

rsource "/home/ljd/wsMA_prototyp/ZRTOS_demo/zephyr/soc/silabs/silabs_sim3/soc/silabs/silabs_sim3/sim3u/Kconfig.defconfig"
```

## ZRTOS_copy/soc/snps/emsdp/Kconfig.defconfig
```kconfig
# Copyright (c) 2019 Synopsys, Inc. All rights reserved.
# SPDX-License-Identifier: Apache-2.0

if SOC_ARC_EMSDP

config NUM_IRQ_PRIO_LEVELS
	# This processor supports 4 priority levels:
	# 0 for Fast Interrupts (FIRQs) and 1-3 for Regular Interrupts (IRQs).
	default 4

rsource "/home/ljd/wsMA_prototyp/ZRTOS_demo/zephyr/soc/snps/emsdp/soc/snps/emsdp/Kconfig.defconfig.em11d"
rsource "/home/ljd/wsMA_prototyp/ZRTOS_demo/zephyr/soc/snps/emsdp/soc/snps/emsdp/Kconfig.defconfig.em4"
rsource "/home/ljd/wsMA_prototyp/ZRTOS_demo/zephyr/soc/snps/emsdp/soc/snps/emsdp/Kconfig.defconfig.em5d"
rsource "/home/ljd/wsMA_prototyp/ZRTOS_demo/zephyr/soc/snps/emsdp/soc/snps/emsdp/Kconfig.defconfig.em6"
rsource "/home/ljd/wsMA_prototyp/ZRTOS_demo/zephyr/soc/snps/emsdp/soc/snps/emsdp/Kconfig.defconfig.em7d"
rsource "/home/ljd/wsMA_prototyp/ZRTOS_demo/zephyr/soc/snps/emsdp/soc/snps/emsdp/Kconfig.defconfig.em7d_esp"
rsource "/home/ljd/wsMA_prototyp/ZRTOS_demo/zephyr/soc/snps/emsdp/soc/snps/emsdp/Kconfig.defconfig.em9d"

endif # SOC_ARC_EMSDP
```

## ZRTOS_copy/soc/snps/emsk/Kconfig.defconfig
```kconfig
# Copyright (c) 2014 Wind River Systems, Inc.
# Copyright (c) 2018 Synopsys, Inc. All rights reserved.
# SPDX-License-Identifier: Apache-2.0

if SOC_EMSK

rsource "/home/ljd/wsMA_prototyp/ZRTOS_demo/zephyr/soc/snps/emsk/soc/snps/emsk/Kconfig.defconfig.em11d"
rsource "/home/ljd/wsMA_prototyp/ZRTOS_demo/zephyr/soc/snps/emsk/soc/snps/emsk/Kconfig.defconfig.em7d"
rsource "/home/ljd/wsMA_prototyp/ZRTOS_demo/zephyr/soc/snps/emsk/soc/snps/emsk/Kconfig.defconfig.em9d"

endif # SOC_EMSK
```

## ZRTOS_copy/soc/snps/nsim/arc_classic/Kconfig
```kconfig
# Copyright (c) 2024 Synopsys, Inc.
# SPDX-License-Identifier: Apache-2.0

if SOC_FAMILY_NSIM_ARC_CLASSIC

rsource "/home/ljd/wsMA_prototyp/ZRTOS_demo/zephyr/soc/snps/nsim/arc_classic/soc/snps/nsim/arc_classic/em/Kconfig"
rsource "/home/ljd/wsMA_prototyp/ZRTOS_demo/zephyr/soc/snps/nsim/arc_classic/soc/snps/nsim/arc_classic/hs/Kconfig"
rsource "/home/ljd/wsMA_prototyp/ZRTOS_demo/zephyr/soc/snps/nsim/arc_classic/soc/snps/nsim/arc_classic/sem/Kconfig"
rsource "/home/ljd/wsMA_prototyp/ZRTOS_demo/zephyr/soc/snps/nsim/arc_classic/soc/snps/nsim/arc_classic/vpx5/Kconfig"

endif # SOC_FAMILY_NSIM_ARC_CLASSIC
```

## ZRTOS_copy/soc/snps/nsim/arc_classic/Kconfig.soc
```kconfig
# Copyright (c) 2024 Synopsys, Inc.
# SPDX-License-Identifier: Apache-2.0

config SOC_FAMILY_NSIM_ARC_CLASSIC
	bool

config SOC_FAMILY
	default "nsim_arc_classic" if SOC_FAMILY_NSIM_ARC_CLASSIC

rsource "/home/ljd/wsMA_prototyp/ZRTOS_demo/zephyr/soc/snps/nsim/arc_classic/soc/snps/nsim/arc_classic/em/Kconfig.soc"
rsource "/home/ljd/wsMA_prototyp/ZRTOS_demo/zephyr/soc/snps/nsim/arc_classic/soc/snps/nsim/arc_classic/hs/Kconfig.soc"
rsource "/home/ljd/wsMA_prototyp/ZRTOS_demo/zephyr/soc/snps/nsim/arc_classic/soc/snps/nsim/arc_classic/sem/Kconfig.soc"
rsource "/home/ljd/wsMA_prototyp/ZRTOS_demo/zephyr/soc/snps/nsim/arc_classic/soc/snps/nsim/arc_classic/vpx5/Kconfig.soc"
```

## ZRTOS_copy/soc/snps/nsim/arc_classic/hs/Kconfig.defconfig
```kconfig
# Copyright (c) 2024 Synopsys, Inc.
# SPDX-License-Identifier: Apache-2.0

if SOC_SERIES_NSIM_HS

rsource "/home/ljd/wsMA_prototyp/ZRTOS_demo/zephyr/soc/snps/nsim/arc_classic/hs/soc/snps/nsim/arc_classic/hs/Kconfig.defconfig.hs"
rsource "/home/ljd/wsMA_prototyp/ZRTOS_demo/zephyr/soc/snps/nsim/arc_classic/hs/soc/snps/nsim/arc_classic/hs/Kconfig.defconfig.hs5x"
rsource "/home/ljd/wsMA_prototyp/ZRTOS_demo/zephyr/soc/snps/nsim/arc_classic/hs/soc/snps/nsim/arc_classic/hs/Kconfig.defconfig.hs5x_smp"
rsource "/home/ljd/wsMA_prototyp/ZRTOS_demo/zephyr/soc/snps/nsim/arc_classic/hs/soc/snps/nsim/arc_classic/hs/Kconfig.defconfig.hs6x"
rsource "/home/ljd/wsMA_prototyp/ZRTOS_demo/zephyr/soc/snps/nsim/arc_classic/hs/soc/snps/nsim/arc_classic/hs/Kconfig.defconfig.hs6x_smp"
rsource "/home/ljd/wsMA_prototyp/ZRTOS_demo/zephyr/soc/snps/nsim/arc_classic/hs/soc/snps/nsim/arc_classic/hs/Kconfig.defconfig.hs_mpuv6"
rsource "/home/ljd/wsMA_prototyp/ZRTOS_demo/zephyr/soc/snps/nsim/arc_classic/hs/soc/snps/nsim/arc_classic/hs/Kconfig.defconfig.hs_smp"

endif # SOC_SERIES_NSIM_HS
```
