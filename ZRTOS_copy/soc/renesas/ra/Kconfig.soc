## ZRTOS_copy/soc/st/stm32/Kconfig
```kconfig
# Copyright (c) 2024 STMicroelectronics
# SPDX-License-Identifier: Apache-2.0

config SOC_FAMILY_STM32
	select HAS_SEGGER_RTT if ZEPHYR_SEGGER_MODULE
	select STM32_ENABLE_DEBUG_SLEEP_STOP if ZTEST
	select BUILD_OUTPUT_HEX

if SOC_FAMILY_STM32

rsource "/home/ljd/wsMA_prototyp/ZRTOS_demo/zephyr/soc/st/stm32/soc/st/stm32/stm32c0x/Kconfig"
rsource "/home/ljd/wsMA_prototyp/ZRTOS_demo/zephyr/soc/st/stm32/soc/st/stm32/stm32f0x/Kconfig"
rsource "/home/ljd/wsMA_prototyp/ZRTOS_demo/zephyr/soc/st/stm32/soc/st/stm32/stm32f1x/Kconfig"
rsource "/home/ljd/wsMA_prototyp/ZRTOS_demo/zephyr/soc/st/stm32/soc/st/stm32/stm32f2x/Kconfig"
rsource "/home/ljd/wsMA_prototyp/ZRTOS_demo/zephyr/soc/st/stm32/soc/st/stm32/stm32f3x/Kconfig"
rsource "/home/ljd/wsMA_prototyp/ZRTOS_demo/zephyr/soc/st/stm32/soc/st/stm32/stm32f4x/Kconfig"
rsource "/home/ljd/wsMA_prototyp/ZRTOS_demo/zephyr/soc/st/stm32/soc/st/stm32/stm32f7x/Kconfig"
rsource "/home/ljd/wsMA_prototyp/ZRTOS_demo/zephyr/soc/st/stm32/soc/st/stm32/stm32g0x/Kconfig"
rsource "/home/ljd/wsMA_prototyp/ZRTOS_demo/zephyr/soc/st/stm32/soc/st/stm32/stm32g4x/Kconfig"
rsource "/home/ljd/wsMA_prototyp/ZRTOS_demo/zephyr/soc/st/stm32/soc/st/stm32/stm32h5x/Kconfig"
rsource "/home/ljd/wsMA_prototyp/ZRTOS_demo/zephyr/soc/st/stm32/soc/st/stm32/stm32h7rsx/Kconfig"
rsource "/home/ljd/wsMA_prototyp/ZRTOS_demo/zephyr/soc/st/stm32/soc/st/stm32/stm32h7x/Kconfig"
rsource "/home/ljd/wsMA_prototyp/ZRTOS_demo/zephyr/soc/st/stm32/soc/st/stm32/stm32l0x/Kconfig"
rsource "/home/ljd/wsMA_prototyp/ZRTOS_demo/zephyr/soc/st/stm32/soc/st/stm32/stm32l1x/Kconfig"
rsource "/home/ljd/wsMA_prototyp/ZRTOS_demo/zephyr/soc/st/stm32/soc/st/stm32/stm32l4x/Kconfig"
rsource "/home/ljd/wsMA_prototyp/ZRTOS_demo/zephyr/soc/st/stm32/soc/st/stm32/stm32l5x/Kconfig"
rsource "/home/ljd/wsMA_prototyp/ZRTOS_demo/zephyr/soc/st/stm32/soc/st/stm32/stm32mp13x/Kconfig"
rsource "/home/ljd/wsMA_prototyp/ZRTOS_demo/zephyr/soc/st/stm32/soc/st/stm32/stm32mp1x/Kconfig"
rsource "/home/ljd/wsMA_prototyp/ZRTOS_demo/zephyr/soc/st/stm32/soc/st/stm32/stm32mp2x/Kconfig"
rsource "/home/ljd/wsMA_prototyp/ZRTOS_demo/zephyr/soc/st/stm32/soc/st/stm32/stm32n6x/Kconfig"
rsource "/home/ljd/wsMA_prototyp/ZRTOS_demo/zephyr/soc/st/stm32/soc/st/stm32/stm32u0x/Kconfig"
rsource "/home/ljd/wsMA_prototyp/ZRTOS_demo/zephyr/soc/st/stm32/soc/st/stm32/stm32u3x/Kconfig"
rsource "/home/ljd/wsMA_prototyp/ZRTOS_demo/zephyr/soc/st/stm32/soc/st/stm32/stm32u5x/Kconfig"
rsource "/home/ljd/wsMA_prototyp/ZRTOS_demo/zephyr/soc/st/stm32/soc/st/stm32/stm32wb0x/Kconfig"
rsource "/home/ljd/wsMA_prototyp/ZRTOS_demo/zephyr/soc/st/stm32/soc/st/stm32/stm32wbax/Kconfig"
rsource "/home/ljd/wsMA_prototyp/ZRTOS_demo/zephyr/soc/st/stm32/soc/st/stm32/stm32wbx/Kconfig"
rsource "/home/ljd/wsMA_prototyp/ZRTOS_demo/zephyr/soc/st/stm32/soc/st/stm32/stm32wlx/Kconfig"

# STM32 wide symbols definitions

# Workaround for not being able to have commas in macro arguments
DT_CHOSEN_Z_CCM := zephyr,ccm

config STM32_CCM
 bool
 default $(dt_chosen_enabled,$(DT_CHOSEN_Z_CCM))

config USE_STM32_ASSERT
	depends on ASSERT
	bool "STM32Cube HAL and LL drivers asserts"
	help
	  Enable asserts in STM32Cube HAL and LL drivers.

config STM32_BACKUP_SRAM
	bool "STM32 Backup SRAM"
	default y
	depends on DT_HAS_ST_STM32_BACKUP_SRAM_ENABLED
	help
	  Enable support for STM32 backup SRAM.

config STM32_BACKUP_SRAM_INIT_PRIORITY
	int "STM32 Backup SRAM init priority"
	default APPLICATION_INIT_PRIORITY
	depends on STM32_BACKUP_SRAM
	help
	  STM32 Backup SRAM device initialization priority.

config STM32_ENABLE_DEBUG_SLEEP_STOP
	bool "Allow debugger attach in stop/sleep Mode"
	default y if DEBUG
	help
	  Some STM32 parts disable the DBGMCU in sleep/stop modes because
	  of power consumption. As a side-effects this prevents
	  debuggers from attaching w/o resetting the target. This
	  effectively destroys the use-case of `west attach`. Also
	  SEGGER RTT and similar technologies need this.

config SWJ_ANALOG_PRIORITY
	int "SWJ DP port to analog routine initialization priority"
	default 49
	help
	  Initialization priority of the routine within the PRE_KERNEL1 level.
	  This priority must be greater than GPIO_INIT_PRIORITY and lower than
	  UART_INIT_PRIORITY.

config HAS_STM32_FLASH_PREFETCH
	bool
	help
	  Hidden symbol selected by SoCs which support flash prefetch.

config STM32_FLASH_PREFETCH
	bool "Flash prefetch buffer"
	default y
	depends on HAS_STM32_FLASH_PREFETCH
	help
	  Enable flash prefetch. For power efficiency, it is recommended to
	  be enabled when flash is accessed through a cache memory. Flash
	  prefetch also improves performances a bit.

config STM32_WKUP_PINS
	bool "STM32 PWR Wake-up Pins"
	depends on DT_HAS_ST_STM32_PWR_ENABLED
	help
	  Enable support for STM32 PWR wake-up pins.

config STM32_BACKUP_PROTECTION
	bool "SoC has backup domain protection access"
	help
	  Enabled for SoCs for which access protection to backup domain
	  resources needs to be explicitly handled.

config STM32_APP_IN_EXT_FLASH
	bool
	help
	  Allows the SoC clock driver to correctly initialize the
	  Q/O/XSPI controller clocks when the application is residing
	  in external Flash and is chainloaded with MCUboot.
	  Whether the app is eXecuted in Place (XiP) depends on the MCUboot mode used.

endif # SOC_FAMILY_STM32
```

## ZRTOS_copy/soc/st/stm32/stm32c0x/Kconfig.defconfig
```kconfig
# STMicroelectronics STM32C0 MCU line

# Copyright (c) 2023 Benjamin Björnsson <benjamin.bjornsson@gmail.com>
# SPDX-License-Identifier: Apache-2.0

if SOC_SERIES_STM32C0X

rsource "/home/ljd/wsMA_prototyp/ZRTOS_demo/zephyr/soc/st/stm32/stm32c0x/soc/st/stm32/stm32c0x/Kconfig.defconfig.stm32c011xx"
rsource "/home/ljd/wsMA_prototyp/ZRTOS_demo/zephyr/soc/st/stm32/stm32c0x/soc/st/stm32/stm32c0x/Kconfig.defconfig.stm32c031xx"
rsource "/home/ljd/wsMA_prototyp/ZRTOS_demo/zephyr/soc/st/stm32/stm32c0x/soc/st/stm32/stm32c0x/Kconfig.defconfig.stm32c051xx"
rsource "/home/ljd/wsMA_prototyp/ZRTOS_demo/zephyr/soc/st/stm32/stm32c0x/soc/st/stm32/stm32c0x/Kconfig.defconfig.stm32c071xx"
rsource "/home/ljd/wsMA_prototyp/ZRTOS_demo/zephyr/soc/st/stm32/stm32c0x/soc/st/stm32/stm32c0x/Kconfig.defconfig.stm32c091xx"
rsource "/home/ljd/wsMA_prototyp/ZRTOS_demo/zephyr/soc/st/stm32/stm32c0x/soc/st/stm32/stm32c0x/Kconfig.defconfig.stm32c092xx"

if PM

config COUNTER
	default y

config COUNTER_RTC_STM32_SUBSECONDS
	default y if DT_HAS_ST_STM32_RTC_ENABLED

endif # PM

endif # SOC_SERIES_STM32C0X
```

## ZRTOS_copy/soc/st/stm32/stm32f1x/Kconfig.defconfig
```kconfig
# ST Microelectronics STM32F1 MCU line

# Copyright (c) 2016 Open-RnD Sp. z o.o.
# SPDX-License-Identifier: Apache-2.0

# Kconfig symbols common to STM32F1 series

if SOC_SERIES_STM32F1X

rsource "/home/ljd/wsMA_prototyp/ZRTOS_demo/zephyr/soc/st/stm32/stm32f1x/soc/st/stm32/stm32f1x/Kconfig.defconfig.stm32f100xx"
rsource "/home/ljd/wsMA_prototyp/ZRTOS_demo/zephyr/soc/st/stm32/stm32f1x/soc/st/stm32/stm32f1x/Kconfig.defconfig.stm32f103xx"
rsource "/home/ljd/wsMA_prototyp/ZRTOS_demo/zephyr/soc/st/stm32/stm32f1x/soc/st/stm32/stm32f1x/Kconfig.defconfig.stm32f105xx"
rsource "/home/ljd/wsMA_prototyp/ZRTOS_demo/zephyr/soc/st/stm32/stm32f1x/soc/st/stm32/stm32f1x/Kconfig.defconfig.stm32f107xc"

# adjust the fallback because of the LSI oscaillator characteristics
config TASK_WDT_HW_FALLBACK_DELAY
	depends on TASK_WDT_HW_FALLBACK
	default 200

if PM

config COUNTER
	default y

endif # PM

endif # SOC_SERIES_STM32F1X
```

## ZRTOS_copy/soc/st/stm32/stm32f4x/Kconfig.defconfig
```kconfig
# STMicroelectronics STM32F4 MCU line

# Copyright (c) 2016 Linaro Limited
# SPDX-License-Identifier: Apache-2.0

# Kconfig symbols common to STM32F4 series

if SOC_SERIES_STM32F4X

rsource "/home/ljd/wsMA_prototyp/ZRTOS_demo/zephyr/soc/st/stm32/stm32f4x/soc/st/stm32/stm32f4x/Kconfig.defconfig.stm32f401xc"
rsource "/home/ljd/wsMA_prototyp/ZRTOS_demo/zephyr/soc/st/stm32/stm32f4x/soc/st/stm32/stm32f4x/Kconfig.defconfig.stm32f401xd"
rsource "/home/ljd/wsMA_prototyp/ZRTOS_demo/zephyr/soc/st/stm32/stm32f4x/soc/st/stm32/stm32f4x/Kconfig.defconfig.stm32f401xe"
rsource "/home/ljd/wsMA_prototyp/ZRTOS_demo/zephyr/soc/st/stm32/stm32f4x/soc/st/stm32/stm32f4x/Kconfig.defconfig.stm32f405xx"
rsource "/home/ljd/wsMA_prototyp/ZRTOS_demo/zephyr/soc/st/stm32/stm32f4x/soc/st/stm32/stm32f4x/Kconfig.defconfig.stm32f407xx"
rsource "/home/ljd/wsMA_prototyp/ZRTOS_demo/zephyr/soc/st/stm32/stm32f4x/soc/st/stm32/stm32f4x/Kconfig.defconfig.stm32f410xx"
rsource "/home/ljd/wsMA_prototyp/ZRTOS_demo/zephyr/soc/st/stm32/stm32f4x/soc/st/stm32/stm32f4x/Kconfig.defconfig.stm32f411xe"
rsource "/home/ljd/wsMA_prototyp/ZRTOS_demo/zephyr/soc/st/stm32/stm32f4x/soc/st/stm32/stm32f4x/Kconfig.defconfig.stm32f412rx"
rsource "/home/ljd/wsMA_prototyp/ZRTOS_demo/zephyr/soc/st/stm32/stm32f4x/soc/st/stm32/stm32f4x/Kconfig.defconfig.stm32f412xx"
rsource "/home/ljd/wsMA_prototyp/ZRTOS_demo/zephyr/soc/st/stm32/stm32f4x/soc/st/stm32/stm32f4x/Kconfig.defconfig.stm32f413xx"
rsource "/home/ljd/wsMA_prototyp/ZRTOS_demo/zephyr/soc/st/stm32/stm32f4x/soc/st/stm32/stm32f4x/Kconfig.defconfig.stm32f415xx"
rsource "/home/ljd/wsMA_prototyp/ZRTOS_demo/zephyr/soc/st/stm32/stm32f4x/soc/st/stm32/stm32f4x/Kconfig.defconfig.stm32f417xx"
rsource "/home/ljd/wsMA_prototyp/ZRTOS_demo/zephyr/soc/st/stm32/stm32f4x/soc/st/stm32/stm32f4x/Kconfig.defconfig.stm32f423xx"
rsource "/home/ljd/wsMA_prototyp/ZRTOS_demo/zephyr/soc/st/stm32/stm32f4x/soc/st/stm32/stm32f4x/Kconfig.defconfig.stm32f427xx"
rsource "/home/ljd/wsMA_prototyp/ZRTOS_demo/zephyr/soc/st/stm32/stm32f4x/soc/st/stm32/stm32f4x/Kconfig.defconfig.stm32f429xx"
rsource "/home/ljd/wsMA_prototyp/ZRTOS_demo/zephyr/soc/st/stm32/stm32f4x/soc/st/stm32/stm32f4x/Kconfig.defconfig.stm32f437xx"
rsource "/home/ljd/wsMA_prototyp/ZRTOS_demo/zephyr/soc/st/stm32/stm32f4x/soc/st/stm32/stm32f4x/Kconfig.defconfig.stm32f439xx"
rsource "/home/ljd/wsMA_prototyp/ZRTOS_demo/zephyr/soc/st/stm32/stm32f4x/soc/st/stm32/stm32f4x/Kconfig.defconfig.stm32f446xx"
rsource "/home/ljd/wsMA_prototyp/ZRTOS_demo/zephyr/soc/st/stm32/stm32f4x/soc/st/stm32/stm32f4x/Kconfig.defconfig.stm32f469xx"
rsource "/home/ljd/wsMA_prototyp/ZRTOS_demo/zephyr/soc/st/stm32/stm32f4x/soc/st/stm32/stm32f4x/Kconfig.defconfig.stm32f479xx"

# adjust the fallback because of the LSI oscaillator characteristics
config TASK_WDT_HW_FALLBACK_DELAY
	depends on TASK_WDT_HW_FALLBACK
	default 200

if PM

config COUNTER
	default y

config COUNTER_RTC_STM32_SUBSECONDS
	default y if DT_HAS_ST_STM32_RTC_ENABLED

config IDLE_STACK_SIZE
	default 512

endif # PM

endif # SOC_SERIES_STM32F4X
```

## ZRTOS_copy/soc/st/stm32/stm32f7x/Kconfig.defconfig
```kconfig
# ST Microelectronics STM32F7 MCU line

# Copyright (c) 2018 Yurii Hamann
# SPDX-License-Identifier: Apache-2.0

# Kconfig symbols common to STM32F7 series

if SOC_SERIES_STM32F7X

rsource "/home/ljd/wsMA_prototyp/ZRTOS_demo/zephyr/soc/st/stm32/stm32f7x/soc/st/stm32/stm32f7x/Kconfig.defconfig.stm32f722xx"
rsource "/home/ljd/wsMA_prototyp/ZRTOS_demo/zephyr/soc/st/stm32/stm32f7x/soc/st/stm32/stm32f7x/Kconfig.defconfig.stm32f723xx"
rsource "/home/ljd/wsMA_prototyp/ZRTOS_demo/zephyr/soc/st/stm32/stm32f7x/soc/st/stm32/stm32f7x/Kconfig.defconfig.stm32f745xx"
rsource "/home/ljd/wsMA_prototyp/ZRTOS_demo/zephyr/soc/st/stm32/stm32f7x/soc/st/stm32/stm32f7x/Kconfig.defconfig.stm32f746xx"
rsource "/home/ljd/wsMA_prototyp/ZRTOS_demo/zephyr/soc/st/stm32/stm32f7x/soc/st/stm32/stm32f7x/Kconfig.defconfig.stm32f750xx"
rsource "/home/ljd/wsMA_prototyp/ZRTOS_demo/zephyr/soc/st/stm32/stm32f7x/soc/st/stm32/stm32f7x/Kconfig.defconfig.stm32f756xx"
rsource "/home/ljd/wsMA_prototyp/ZRTOS_demo/zephyr/soc/st/stm32/stm32f7x/soc/st/stm32/stm32f7x/Kconfig.defconfig.stm32f765xx"
rsource "/home/ljd/wsMA_prototyp/ZRTOS_demo/zephyr/soc/st/stm32/stm32f7x/soc/st/stm32/stm32f7x/Kconfig.defconfig.stm32f767xx"
rsource "/home/ljd/wsMA_prototyp/ZRTOS_demo/zephyr/soc/st/stm32/stm32f7x/soc/st/stm32/stm32f7x/Kconfig.defconfig.stm32f769xx"

endif # SOC_SERIES_STM32F7X
```

## ZRTOS_copy/soc/st/stm32/stm32g4x/Kconfig.defconfig
```kconfig
# STMicroelectronics STM32G4 MCU line

# Copyright (c) 2019 Richard Osterloh <richard.osterloh@gmail.com>
# SPDX-License-Identifier: Apache-2.0

if SOC_SERIES_STM32G4X

rsource "/home/ljd/wsMA_prototyp/ZRTOS_demo/zephyr/soc/st/stm32/stm32g4x/soc/st/stm32/stm32g4x/Kconfig.defconfig.stm32g431xx"
rsource "/home/ljd/wsMA_prototyp/ZRTOS_demo/zephyr/soc/st/stm32/stm32g4x/soc/st/stm32/stm32g4x/Kconfig.defconfig.stm32g441xx"
rsource "/home/ljd/wsMA_prototyp/ZRTOS_demo/zephyr/soc/st/stm32/stm32g4x/soc/st/stm32/stm32g4x/Kconfig.defconfig.stm32g473xx"
rsource "/home/ljd/wsMA_prototyp/ZRTOS_demo/zephyr/soc/st/stm32/stm32g4x/soc/st/stm32/stm32g4x/Kconfig.defconfig.stm32g474xx"
rsource "/home/ljd/wsMA_prototyp/ZRTOS_demo/zephyr/soc/st/stm32/stm32g4x/soc/st/stm32/stm32g4x/Kconfig.defconfig.stm32g483xx"
rsource "/home/ljd/wsMA_prototyp/ZRTOS_demo/zephyr/soc/st/stm32/stm32g4x/soc/st/stm32/stm32g4x/Kconfig.defconfig.stm32g484xx"
rsource "/home/ljd/wsMA_prototyp/ZRTOS_demo/zephyr/soc/st/stm32/stm32g4x/soc/st/stm32/stm32g4x/Kconfig.defconfig.stm32g491xx"
rsource "/home/ljd/wsMA_prototyp/ZRTOS_demo/zephyr/soc/st/stm32/stm32g4x/soc/st/stm32/stm32g4x/Kconfig.defconfig.stm32g4a1xx"

if PM
config PM_DEVICE
	default y

config STM32_LPTIM_TIMER
	default y
endif # PM

endif # SOC_SERIES_STM32G4X
```

## ZRTOS_copy/soc/st/stm32/stm32l1x/Kconfig.defconfig
```kconfig
# STMicroelectronics STM32L1 MCU line

# Copyright (c) 2019 Linaro Ltd.
# SPDX-License-Identifier: Apache-2.0

if SOC_SERIES_STM32L1X

rsource "/home/ljd/wsMA_prototyp/ZRTOS_demo/zephyr/soc/st/stm32/stm32l1x/soc/st/stm32/stm32l1x/Kconfig.defconfig.stm32l100xb"
rsource "/home/ljd/wsMA_prototyp/ZRTOS_demo/zephyr/soc/st/stm32/stm32l1x/soc/st/stm32/stm32l1x/Kconfig.defconfig.stm32l151xb"
rsource "/home/ljd/wsMA_prototyp/ZRTOS_demo/zephyr/soc/st/stm32/stm32l1x/soc/st/stm32/stm32l1x/Kconfig.defconfig.stm32l151xba"
rsource "/home/ljd/wsMA_prototyp/ZRTOS_demo/zephyr/soc/st/stm32/stm32l1x/soc/st/stm32/stm32l1x/Kconfig.defconfig.stm32l151xc"
rsource "/home/ljd/wsMA_prototyp/ZRTOS_demo/zephyr/soc/st/stm32/stm32l1x/soc/st/stm32/stm32l1x/Kconfig.defconfig.stm32l152xc"
rsource "/home/ljd/wsMA_prototyp/ZRTOS_demo/zephyr/soc/st/stm32/stm32l1x/soc/st/stm32/stm32l1x/Kconfig.defconfig.stm32l152xe"

# adjust the fallback because of the LSI oscaillator characteristics
config TASK_WDT_HW_FALLBACK_DELAY
	depends on TASK_WDT_HW_FALLBACK
	default 200

if PM

config COUNTER
	default y

endif # PM

endif # SOC_SERIES_STM32L1X
```

## ZRTOS_copy/soc/st/stm32/stm32mp2x/Kconfig.defconfig
```kconfig
# STMicroelectronics STM32MP2 MPU series
#
# Copyright (C) 2025 Savoir-faire Linux, Inc.
# SPDX-License-Identifier: Apache-2.0

if SOC_SERIES_STM32MP2X

rsource "/home/ljd/wsMA_prototyp/ZRTOS_demo/zephyr/soc/st/stm32/stm32mp2x/soc/st/stm32/stm32mp2x/Kconfig.defconfig.stm32mp257fxx"

endif # SOC_SERIES_STM32MP2X
```

## ZRTOS_copy/soc/st/stm32/stm32u0x/Kconfig.defconfig
```kconfig
# ST Microelectronics STM32U0 MCU line

# Copyright (c) 2024 STMicroelectronics
# SPDX-License-Identifier: Apache-2.0

if SOC_SERIES_STM32U0X

rsource "/home/ljd/wsMA_prototyp/ZRTOS_demo/zephyr/soc/st/stm32/stm32u0x/soc/st/stm32/stm32u0x/Kconfig.defconfig.stm32u031xx"
rsource "/home/ljd/wsMA_prototyp/ZRTOS_demo/zephyr/soc/st/stm32/stm32u0x/soc/st/stm32/stm32u0x/Kconfig.defconfig.stm32u073xx"
rsource "/home/ljd/wsMA_prototyp/ZRTOS_demo/zephyr/soc/st/stm32/stm32u0x/soc/st/stm32/stm32u0x/Kconfig.defconfig.stm32u083xx"

if I2C_STM32

config SHARED_INTERRUPTS
	default y if $(dt_nodelabel_enabled,i2c2) && $(dt_nodelabel_enabled,i2c3)
	default y if $(dt_nodelabel_enabled,i2c2) && $(dt_nodelabel_enabled,i2c4)
	default y if $(dt_nodelabel_enabled,i2c3) && $(dt_nodelabel_enabled,i2c4)

endif # I2C_STM32

endif # SOC_SERIES_STM32U0X
```
