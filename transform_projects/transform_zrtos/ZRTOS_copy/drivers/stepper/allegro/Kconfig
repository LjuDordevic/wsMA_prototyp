## transform_projects/transform_zrtos/ZRTOS_copy/drivers/stepper/allegro/Kconfig
```kconfig
# SPDX-FileCopyrightText: Copyright (c) 2025 Carl Zeiss Meditec AG
# SPDX-License-Identifier: Apache-2.0

comment "Allegro Stepper Drivers"

# zephyr-keep-sorted-start
rsource "/home/ljd/wsMA_prototyp/ZRTOS_demo/zephyr/drivers/stepper/allegro/drivers/stepper/allegro/Kconfig.a4979"
# zephyr-keep-sorted-stop
```

## transform_projects/transform_zrtos/ZRTOS_copy/drivers/stepper/ti/Kconfig
```kconfig
# SPDX-FileCopyrightText: Copyright (c) 2024 Navimatix GmbH
# SPDX-License-Identifier: Apache-2.0

comment "TI Stepper Drivers"

rsource "/home/ljd/wsMA_prototyp/ZRTOS_demo/zephyr/drivers/stepper/ti/drivers/stepper/ti/Kconfig.drv84xx"
```

## transform_projects/transform_zrtos/ZRTOS_copy/lib/hash/Kconfig
```kconfig
# Copyright (c) 2022 Meta
#
# SPDX-License-Identifier: Apache-2.0
rsource "/home/ljd/wsMA_prototyp/ZRTOS_demo/zephyr/lib/hash/lib/hash/Kconfig.hash_func"
rsource "/home/ljd/wsMA_prototyp/ZRTOS_demo/zephyr/lib/hash/lib/hash/Kconfig.hash_map"
```

## transform_projects/transform_zrtos/ZRTOS_copy/lib/posix/Kconfig
```kconfig
# Copyright (c) 2024 Meta
# Copyright (c) 2025 Tenstorrent AI ULC
#
# SPDX-License-Identifier: Apache-2.0

menu "POSIX API Support"

# POSIX Subprofile Definitions
rsource "/home/ljd/wsMA_prototyp/ZRTOS_demo/zephyr/lib/posix/lib/posix/Kconfig.profile"

# Toolchain hooks for external implementations
rsource "/home/ljd/wsMA_prototyp/ZRTOS_demo/zephyr/lib/posix/lib/posix/Kconfig.toolchain"

# POSIX C Library Extensions
# This menu is for POSIX Option Groups that do not require OS support.
menu "POSIX C Library Extensions"
rsource "/home/ljd/wsMA_prototyp/ZRTOS_demo/zephyr/lib/posix/lib/posix/c_lang_support_r/Kconfig"
rsource "/home/ljd/wsMA_prototyp/ZRTOS_demo/zephyr/lib/posix/lib/posix/c_lib_ext/Kconfig"
endmenu

# POSIX System Interfaces
menuconfig POSIX_SYSTEM_INTERFACES
	bool "POSIX System Interfaces"
	select NATIVE_LIBC_INCOMPATIBLE
	help
	  Select 'y' here to support POSIX System Interfaces within Zephyr.

	  Options in this menu are organized by POSIX subprofiling Option Group.

	  For more information, see
	  https://pubs.opengroup.org/onlinepubs/9699919799/xrat/V4_subprofiles.html

if POSIX_SYSTEM_INTERFACES
rsource "/home/ljd/wsMA_prototyp/ZRTOS_demo/zephyr/lib/posix/lib/posix/options/Kconfig"

# POSIX Shell utilities
rsource "/home/ljd/wsMA_prototyp/ZRTOS_demo/zephyr/lib/posix/lib/posix/shell/Kconfig"
endif

endmenu

# Eventfd Support (not officially POSIX)
rsource "/home/ljd/wsMA_prototyp/ZRTOS_demo/zephyr/lib/posix/lib/posix/eventfd/Kconfig"
```

## transform_projects/transform_zrtos/ZRTOS_copy/lib/posix/shell/Kconfig
```kconfig
# Copyright (c) 2024 Meta
# SPDX-License-Identifier: Apache-2.0

menu "POSIX Shell Utilities"

if SHELL

config POSIX_SHELL
	bool
	help
	  Compile the parent `posix` shell command.

rsource "/home/ljd/wsMA_prototyp/ZRTOS_demo/zephyr/lib/posix/shell/lib/posix/shell/Kconfig.env"
rsource "/home/ljd/wsMA_prototyp/ZRTOS_demo/zephyr/lib/posix/shell/lib/posix/shell/Kconfig.uname"

endif # SHELL

endmenu # "POSIX Shell Utilities"
```

## transform_projects/transform_zrtos/ZRTOS_copy/modules/hal_ambiq/Kconfig
```kconfig
# SPDX-License-Identifier: Apache-2.0
#
# Copyright (c) 2023 Antmicro <www.antmicro.com>
# Copyright (c) 2025, Ambiq Micro Inc. <www.ambiq.com>

rsource "/home/ljd/wsMA_prototyp/ZRTOS_demo/zephyr/modules/hal_ambiq/modules/hal_ambiq/Kconfig.hal"
rsource "/home/ljd/wsMA_prototyp/ZRTOS_demo/zephyr/modules/hal_ambiq/modules/hal_ambiq/Kconfig.components"
```

## transform_projects/transform_zrtos/ZRTOS_copy/modules/trusted-firmware-m/Kconfig
```kconfig
# Configuration for the TF-M Module

# Copyright (c) 2019, 2020 Linaro Limited
# Copyright (c) 2020, 2021 Nordic Semiconductor ASA
# SPDX-License-Identifier: Apache-2.0

rsource "/home/ljd/wsMA_prototyp/ZRTOS_demo/zephyr/modules/trusted-firmware-m/modules/trusted-firmware-m/Kconfig.tfm"
rsource "/home/ljd/wsMA_prototyp/ZRTOS_demo/zephyr/modules/trusted-firmware-m/modules/trusted-firmware-m/Kconfig.tfm.partitions"
rsource "/home/ljd/wsMA_prototyp/ZRTOS_demo/zephyr/modules/trusted-firmware-m/modules/trusted-firmware-m/Kconfig.tfm.crypto_modules"
```

## transform_projects/transform_zrtos/ZRTOS_copy/soc/aesc/Kconfig.soc
```kconfig
# Copyright (c) 2025 Aesc Silicon
# SPDX-License-Identifier: Apache-2.0

rsource "/home/ljd/wsMA_prototyp/ZRTOS_demo/zephyr/soc/aesc/soc/aesc/nitrogen/Kconfig.soc"
```

## transform_projects/transform_zrtos/ZRTOS_copy/soc/ambiq/Kconfig
```kconfig
# SPDX-License-Identifier: Apache-2.0
#
# Copyright (c) 2023 Antmicro <www.antmicro.com>

if SOC_FAMILY_AMBIQ

rsource "/home/ljd/wsMA_prototyp/ZRTOS_demo/zephyr/soc/ambiq/soc/ambiq/apollo2x/Kconfig"
rsource "/home/ljd/wsMA_prototyp/ZRTOS_demo/zephyr/soc/ambiq/soc/ambiq/apollo3x/Kconfig"
rsource "/home/ljd/wsMA_prototyp/ZRTOS_demo/zephyr/soc/ambiq/soc/ambiq/apollo4x/Kconfig"
rsource "/home/ljd/wsMA_prototyp/ZRTOS_demo/zephyr/soc/ambiq/soc/ambiq/apollo5x/Kconfig"

endif # SOC_FAMILY_AMBIQ
```

## transform_projects/transform_zrtos/ZRTOS_copy/soc/ambiq/Kconfig.defconfig
```kconfig
# SPDX-License-Identifier: Apache-2.0
#
# Copyright (c) 2023 Antmicro <www.antmicro.com>

if SOC_FAMILY_AMBIQ

rsource "/home/ljd/wsMA_prototyp/ZRTOS_demo/zephyr/soc/ambiq/soc/ambiq/apollo2x/Kconfig.defconfig"
rsource "/home/ljd/wsMA_prototyp/ZRTOS_demo/zephyr/soc/ambiq/soc/ambiq/apollo3x/Kconfig.defconfig"
rsource "/home/ljd/wsMA_prototyp/ZRTOS_demo/zephyr/soc/ambiq/soc/ambiq/apollo4x/Kconfig.defconfig"
rsource "/home/ljd/wsMA_prototyp/ZRTOS_demo/zephyr/soc/ambiq/soc/ambiq/apollo5x/Kconfig.defconfig"

config CORTEX_M_SYSTICK
	default n if AMBIQ_STIMER_TIMER

config SYS_CLOCK_TICKS_PER_SEC
	default 1024

endif # SOC_FAMILY_AMBIQ
```

## transform_projects/transform_zrtos/ZRTOS_copy/soc/arm/Kconfig.soc
```kconfig
# Copyright (c) 2024 Nordic Semiconductor ASA
# SPDX-License-Identifier: Apache-2.0

config SOC_FAMILY_ARM
	bool

config SOC_FAMILY_ARM64
	bool

config SOC_FAMILY
	default "arm" if SOC_FAMILY_ARM
	default "arm64" if SOC_FAMILY_ARM64

rsource "/home/ljd/wsMA_prototyp/ZRTOS_demo/zephyr/soc/arm/soc/arm/beetle/Kconfig.soc"
rsource "/home/ljd/wsMA_prototyp/ZRTOS_demo/zephyr/soc/arm/soc/arm/designstart/Kconfig.soc"
rsource "/home/ljd/wsMA_prototyp/ZRTOS_demo/zephyr/soc/arm/soc/arm/fvp_aem/Kconfig.soc"
rsource "/home/ljd/wsMA_prototyp/ZRTOS_demo/zephyr/soc/arm/soc/arm/fvp_aemv8r/Kconfig.soc"
rsource "/home/ljd/wsMA_prototyp/ZRTOS_demo/zephyr/soc/arm/soc/arm/mps2/Kconfig.soc"
rsource "/home/ljd/wsMA_prototyp/ZRTOS_demo/zephyr/soc/arm/soc/arm/mps3/Kconfig.soc"
rsource "/home/ljd/wsMA_prototyp/ZRTOS_demo/zephyr/soc/arm/soc/arm/mps4/Kconfig.soc"
rsource "/home/ljd/wsMA_prototyp/ZRTOS_demo/zephyr/soc/arm/soc/arm/musca/Kconfig.soc"
rsource "/home/ljd/wsMA_prototyp/ZRTOS_demo/zephyr/soc/arm/soc/arm/qemu_cortex_a53/Kconfig.soc"
rsource "/home/ljd/wsMA_prototyp/ZRTOS_demo/zephyr/soc/arm/soc/arm/qemu_virt_arm64/Kconfig.soc"
```

## transform_projects/transform_zrtos/ZRTOS_copy/soc/aspeed/Kconfig.soc
```kconfig
# SPDX-License-Identifier: Apache-2.0
#
# Copyright (c) 2021 ASPEED Technology Inc.

config SOC_FAMILY_ASPEED
	bool

config SOC_FAMILY
	default "aspeed" if SOC_FAMILY_ASPEED

rsource "/home/ljd/wsMA_prototyp/ZRTOS_demo/zephyr/soc/aspeed/soc/aspeed/ast10x0/Kconfig.soc"
```

## transform_projects/transform_zrtos/ZRTOS_copy/soc/aspeed/ast10x0/Kconfig.defconfig
```kconfig
# SPDX-License-Identifier: Apache-2.0
#
# Copyright (c) 2021 ASPEED Technology Inc.

if SOC_SERIES_AST10X0

rsource "/home/ljd/wsMA_prototyp/ZRTOS_demo/zephyr/soc/aspeed/ast10x0/soc/aspeed/ast10x0/Kconfig.defconfig.ast1030"

config ICACHE_LINE_SIZE
	default 32

config DCACHE_LINE_SIZE
	default 32

choice CACHE_TYPE
	default EXTERNAL_CACHE
endchoice

endif # SOC_SERIES_AST10X0
```

## transform_projects/transform_zrtos/ZRTOS_copy/soc/atmel/sam/Kconfig.defconfig
```kconfig
# Atmel SAM MCU family default configuration options

# Copyright (c) 2016 Piotr Mienkowski
# Copyright (c) 2024 Gerson Fernando Budke <nandojve@gmail.com>
# SPDX-License-Identifier: Apache-2.0

if SOC_FAMILY_ATMEL_SAM

rsource "/home/ljd/wsMA_prototyp/ZRTOS_demo/zephyr/soc/atmel/sam/soc/atmel/sam/sam3x/Kconfig.defconfig"
rsource "/home/ljd/wsMA_prototyp/ZRTOS_demo/zephyr/soc/atmel/sam/soc/atmel/sam/sam4e/Kconfig.defconfig"
rsource "/home/ljd/wsMA_prototyp/ZRTOS_demo/zephyr/soc/atmel/sam/soc/atmel/sam/sam4l/Kconfig.defconfig"
rsource "/home/ljd/wsMA_prototyp/ZRTOS_demo/zephyr/soc/atmel/sam/soc/atmel/sam/sam4s/Kconfig.defconfig"
rsource "/home/ljd/wsMA_prototyp/ZRTOS_demo/zephyr/soc/atmel/sam/soc/atmel/sam/samx7x/Kconfig.defconfig"

config CLOCK_CONTROL
	default y

config GPIO
	default y

config SYS_CLOCK_HW_CYCLES_PER_SEC
	default $(dt_node_int_prop_int,/cpus/cpu@0,clock-frequency)

config WATCHDOG
	default y

endif # SOC_FAMILY_ATMEL_SAM
```

## transform_projects/transform_zrtos/ZRTOS_copy/soc/atmel/sam/Kconfig.soc
```kconfig
# Copyright (c) 2024 Gerson Fernando Budke <nandojve@gmail.com>
# SPDX-License-Identifier: Apache-2.0

config SOC_FAMILY_ATMEL_SAM
	bool

config SOC_FAMILY
	default "atmel_sam" if SOC_FAMILY_ATMEL_SAM

rsource "/home/ljd/wsMA_prototyp/ZRTOS_demo/zephyr/soc/atmel/sam/soc/atmel/sam/sam3x/Kconfig.soc"
rsource "/home/ljd/wsMA_prototyp/ZRTOS_demo/zephyr/soc/atmel/sam/soc/atmel/sam/sam4e/Kconfig.soc"
rsource "/home/ljd/wsMA_prototyp/ZRTOS_demo/zephyr/soc/atmel/sam/soc/atmel/sam/sam4l/Kconfig.soc"
rsource "/home/ljd/wsMA_prototyp/ZRTOS_demo/zephyr/soc/atmel/sam/soc/atmel/sam/sam4s/Kconfig.soc"
rsource "/home/ljd/wsMA_prototyp/ZRTOS_demo/zephyr/soc/atmel/sam/soc/atmel/sam/samx7x/Kconfig.soc"
```

## transform_projects/transform_zrtos/ZRTOS_copy/soc/atmel/sam0/Kconfig
```kconfig
# Atmel SAM0 MCU family configuration options

# Copyright (c) 2017 Google LLC.
# Copyright (c) 2024 Gerson Fernando Budke <nandojve@gmail.com>
# SPDX-License-Identifier: Apache-2.0

config SOC_FAMILY_ATMEL_SAM0
	select ASF
	select HAS_SEGGER_RTT if ZEPHYR_SEGGER_MODULE

if SOC_FAMILY_ATMEL_SAM0

rsource "/home/ljd/wsMA_prototyp/ZRTOS_demo/zephyr/soc/atmel/sam0/soc/atmel/sam0/common/Kconfig.samd2x"
rsource "/home/ljd/wsMA_prototyp/ZRTOS_demo/zephyr/soc/atmel/sam0/soc/atmel/sam0/common/Kconfig.samd5x"
rsource "/home/ljd/wsMA_prototyp/ZRTOS_demo/zephyr/soc/atmel/sam0/soc/atmel/sam0/common/Kconfig.saml2x"
rsource "/home/ljd/wsMA_prototyp/ZRTOS_demo/zephyr/soc/atmel/sam0/soc/atmel/sam0/samc20/Kconfig"
rsource "/home/ljd/wsMA_prototyp/ZRTOS_demo/zephyr/soc/atmel/sam0/soc/atmel/sam0/samc21/Kconfig"
rsource "/home/ljd/wsMA_prototyp/ZRTOS_demo/zephyr/soc/atmel/sam0/soc/atmel/sam0/samd20/Kconfig"
rsource "/home/ljd/wsMA_prototyp/ZRTOS_demo/zephyr/soc/atmel/sam0/soc/atmel/sam0/samd21/Kconfig"
rsource "/home/ljd/wsMA_prototyp/ZRTOS_demo/zephyr/soc/atmel/sam0/soc/atmel/sam0/samd51/Kconfig"
rsource "/home/ljd/wsMA_prototyp/ZRTOS_demo/zephyr/soc/atmel/sam0/soc/atmel/sam0/same51/Kconfig"
rsource "/home/ljd/wsMA_prototyp/ZRTOS_demo/zephyr/soc/atmel/sam0/soc/atmel/sam0/same53/Kconfig"
rsource "/home/ljd/wsMA_prototyp/ZRTOS_demo/zephyr/soc/atmel/sam0/soc/atmel/sam0/same54/Kconfig"
rsource "/home/ljd/wsMA_prototyp/ZRTOS_demo/zephyr/soc/atmel/sam0/soc/atmel/sam0/saml21/Kconfig"
rsource "/home/ljd/wsMA_prototyp/ZRTOS_demo/zephyr/soc/atmel/sam0/soc/atmel/sam0/samr21/Kconfig"
rsource "/home/ljd/wsMA_prototyp/ZRTOS_demo/zephyr/soc/atmel/sam0/soc/atmel/sam0/samr34/Kconfig"
rsource "/home/ljd/wsMA_prototyp/ZRTOS_demo/zephyr/soc/atmel/sam0/soc/atmel/sam0/samr35/Kconfig"

endif # SOC_FAMILY_ATMEL_SAM0
```

## transform_projects/transform_zrtos/ZRTOS_copy/soc/bflb/Kconfig.soc
```kconfig
# Copyright (c) 2021-2025 ATL Electronics
#
# SPDX-License-Identifier: Apache-2.0

config SOC_FAMILY_BFLB
	bool

config SOC_FAMILY
	default "bflb" if SOC_FAMILY_BFLB

rsource "/home/ljd/wsMA_prototyp/ZRTOS_demo/zephyr/soc/bflb/soc/bflb/bl60x/Kconfig.soc"
rsource "/home/ljd/wsMA_prototyp/ZRTOS_demo/zephyr/soc/bflb/soc/bflb/bl61x/Kconfig.soc"
rsource "/home/ljd/wsMA_prototyp/ZRTOS_demo/zephyr/soc/bflb/soc/bflb/bl70x/Kconfig.soc"
```

## transform_projects/transform_zrtos/ZRTOS_copy/soc/brcm/bcmvk/Kconfig.soc
```kconfig
# SPDX-License-Identifier: Apache-2.0
#
# Copyright 2020 Broadcom.
#

config SOC_FAMILY_BCMVK
	bool

config SOC_FAMILY
	default "bcmvk" if SOC_FAMILY_BCMVK

rsource "/home/ljd/wsMA_prototyp/ZRTOS_demo/zephyr/soc/brcm/bcmvk/soc/brcm/bcmvk/valkyrie/Kconfig.soc"
rsource "/home/ljd/wsMA_prototyp/ZRTOS_demo/zephyr/soc/brcm/bcmvk/soc/brcm/bcmvk/viper/Kconfig.soc"
```

## transform_projects/transform_zrtos/ZRTOS_copy/soc/brcm/bcmvk/viper/Kconfig.defconfig
```kconfig
# Copyright 2020 Broadcom
# SPDX-License-Identifier: Apache-2.0

if SOC_SERIES_VIPER

rsource "/home/ljd/wsMA_prototyp/ZRTOS_demo/zephyr/soc/brcm/bcmvk/viper/soc/brcm/bcmvk/viper/Kconfig.defconfig.viper_bcm58402_a72"
rsource "/home/ljd/wsMA_prototyp/ZRTOS_demo/zephyr/soc/brcm/bcmvk/viper/soc/brcm/bcmvk/viper/Kconfig.defconfig.viper_bcm58402_m7"

endif # SOC_SERIES_VIPER
```

## transform_projects/transform_zrtos/ZRTOS_copy/soc/egis/Kconfig.soc
```kconfig
# Copyright (c) 2025 Egis Technology Inc.
# SPDX-License-Identifier: Apache-2.0

rsource "/home/ljd/wsMA_prototyp/ZRTOS_demo/zephyr/soc/egis/soc/egis/et171/Kconfig.soc"
```

## transform_projects/transform_zrtos/ZRTOS_copy/soc/espressif/Kconfig.soc
```kconfig
# Copyright (c) 2023 Espressif Systems (Shanghai) Co., Ltd.
# SPDX-License-Identifier: Apache-2.0

config SOC_FAMILY_ESPRESSIF_ESP32
	bool

config SOC_FAMILY
	default "espressif_esp32" if SOC_FAMILY_ESPRESSIF_ESP32

rsource "/home/ljd/wsMA_prototyp/ZRTOS_demo/zephyr/soc/espressif/soc/espressif/esp32/Kconfig.soc"
rsource "/home/ljd/wsMA_prototyp/ZRTOS_demo/zephyr/soc/espressif/soc/espressif/esp32c2/Kconfig.soc"
rsource "/home/ljd/wsMA_prototyp/ZRTOS_demo/zephyr/soc/espressif/soc/espressif/esp32c3/Kconfig.soc"
rsource "/home/ljd/wsMA_prototyp/ZRTOS_demo/zephyr/soc/espressif/soc/espressif/esp32c6/Kconfig.soc"
rsource "/home/ljd/wsMA_prototyp/ZRTOS_demo/zephyr/soc/espressif/soc/espressif/esp32h2/Kconfig.soc"
rsource "/home/ljd/wsMA_prototyp/ZRTOS_demo/zephyr/soc/espressif/soc/espressif/esp32s2/Kconfig.soc"
rsource "/home/ljd/wsMA_prototyp/ZRTOS_demo/zephyr/soc/espressif/soc/espressif/esp32s3/Kconfig.soc"
```

## transform_projects/transform_zrtos/ZRTOS_copy/soc/gaisler/leon3/Kconfig.soc
```kconfig
# Copyright (c) 2019-2020 Cobham Gaisler AB
# SPDX-License-Identifier: Apache-2.0

config SOC_LEON3
	bool

config SOC
	default "leon3" if SOC_LEON3

rsource "/home/ljd/wsMA_prototyp/ZRTOS_demo/zephyr/soc/gaisler/leon3/soc/gaisler/Kconfig.soc"
```

## transform_projects/transform_zrtos/ZRTOS_copy/soc/gd/gd32/Kconfig.soc
```kconfig
# Copyright (c) 2021, ATL Electronics
# SPDX-License-Identifier: Apache-2.0

config SOC_FAMILY_GD_GD32
	bool

config SOC_FAMILY
	default "gd_gd32" if SOC_FAMILY_GD_GD32

rsource "/home/ljd/wsMA_prototyp/ZRTOS_demo/zephyr/soc/gd/gd32/soc/gd/gd32/gd32a50x/Kconfig.soc"
rsource "/home/ljd/wsMA_prototyp/ZRTOS_demo/zephyr/soc/gd/gd32/soc/gd/gd32/gd32e10x/Kconfig.soc"
rsource "/home/ljd/wsMA_prototyp/ZRTOS_demo/zephyr/soc/gd/gd32/soc/gd/gd32/gd32e50x/Kconfig.soc"
rsource "/home/ljd/wsMA_prototyp/ZRTOS_demo/zephyr/soc/gd/gd32/soc/gd/gd32/gd32f3x0/Kconfig.soc"
rsource "/home/ljd/wsMA_prototyp/ZRTOS_demo/zephyr/soc/gd/gd32/soc/gd/gd32/gd32f403/Kconfig.soc"
rsource "/home/ljd/wsMA_prototyp/ZRTOS_demo/zephyr/soc/gd/gd32/soc/gd/gd32/gd32f4xx/Kconfig.soc"
rsource "/home/ljd/wsMA_prototyp/ZRTOS_demo/zephyr/soc/gd/gd32/soc/gd/gd32/gd32l23x/Kconfig.soc"
rsource "/home/ljd/wsMA_prototyp/ZRTOS_demo/zephyr/soc/gd/gd32/soc/gd/gd32/gd32vf103/Kconfig.soc"
```

## transform_projects/transform_zrtos/ZRTOS_copy/soc/gd/gd32/gd32a50x/Kconfig.defconfig.series
```kconfig
# Copyright (c) 2022 YuLong Yao <feilongphone@gmail.com>
# SPDX-License-Identifier: Apache-2.0

if SOC_SERIES_GD32A50X

rsource "/home/ljd/wsMA_prototyp/ZRTOS_demo/zephyr/soc/gd/gd32/gd32a50x/soc/gd/gd32/gd32a50x/Kconfig.defconfig.gd32a503"

endif # SOC_SERIES_GD32A50X
```
