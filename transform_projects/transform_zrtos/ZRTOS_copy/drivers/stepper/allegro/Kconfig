## transform_projects/transform_zrtos/ZRTOS_copy/soc/gd/gd32/gd32e10x/Kconfig.defconfig.series
```kconfig
# Copyright (c) 2021 YuLong Yao <feilongphone@gmail.com>
# SPDX-License-Identifier: Apache-2.0

if SOC_SERIES_GD32E10X

rsource "/home/ljd/wsMA_prototyp/ZRTOS_demo/zephyr/soc/gd/gd32/gd32e10x/soc/gd/gd32/gd32e10x/Kconfig.defconfig.gd32e103"

endif # SOC_SERIES_GD32E10X
```
