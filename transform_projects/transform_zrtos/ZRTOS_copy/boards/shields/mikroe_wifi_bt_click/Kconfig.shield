## transform_projects/transform_zrtos/ZRTOS_copy/drivers/comparator/Kconfig
```kconfig
# Copyright (c) 2024 Nordic Semiconductor ASA
# SPDX-License-Identifier: Apache-2.0

menuconfig COMPARATOR
	bool "Comparator drivers"
	help
	  Enable comparator driver configuration.

if COMPARATOR

module = COMPARATOR
module-str = comparator
source "subsys/logging/Kconfig.template.log_config"

config COMPARATOR_INIT_PRIORITY
	int "COMPARATOR init priority"
	default KERNEL_INIT_PRIORITY_DEVICE
	help
	  Comparator device driver initialization priority.

# zephyr-keep-sorted-start
rsource "/home/ljd/wsMA_prototyp/ZRTOS_demo/zephyr/drivers/comparator/drivers/comparator/Kconfig.fake_comp"
rsource "/home/ljd/wsMA_prototyp/ZRTOS_demo/zephyr/drivers/comparator/drivers/comparator/Kconfig.it51xxx_vcmp"
rsource "/home/ljd/wsMA_prototyp/ZRTOS_demo/zephyr/drivers/comparator/drivers/comparator/Kconfig.mchp"
rsource "/home/ljd/wsMA_prototyp/ZRTOS_demo/zephyr/drivers/comparator/drivers/comparator/Kconfig.mcux_acmp"
rsource "/home/ljd/wsMA_prototyp/ZRTOS_demo/zephyr/drivers/comparator/drivers/comparator/Kconfig.nrf_comp"
rsource "/home/ljd/wsMA_prototyp/ZRTOS_demo/zephyr/drivers/comparator/drivers/comparator/Kconfig.nrf_lpcomp"
rsource "/home/ljd/wsMA_prototyp/ZRTOS_demo/zephyr/drivers/comparator/drivers/comparator/Kconfig.nxp_cmp"
rsource "/home/ljd/wsMA_prototyp/ZRTOS_demo/zephyr/drivers/comparator/drivers/comparator/Kconfig.renesas_ra"
rsource "/home/ljd/wsMA_prototyp/ZRTOS_demo/zephyr/drivers/comparator/drivers/comparator/Kconfig.renesas_rx"
rsource "/home/ljd/wsMA_prototyp/ZRTOS_demo/zephyr/drivers/comparator/drivers/comparator/Kconfig.shell"
rsource "/home/ljd/wsMA_prototyp/ZRTOS_demo/zephyr/drivers/comparator/drivers/comparator/Kconfig.silabs_acmp"
rsource "/home/ljd/wsMA_prototyp/ZRTOS_demo/zephyr/drivers/comparator/drivers/comparator/Kconfig.stm32_comp"
# zephyr-keep-sorted-stop

endif # COMPARATOR
```

## transform_projects/transform_zrtos/ZRTOS_copy/drivers/disk/Kconfig
```kconfig
# Copyright (c) 2021 Nordic Semiconductor ASA
# SPDX-License-Identifier: Apache-2.0

menuconfig DISK_DRIVERS
	bool "Disk drivers"
	help
	  Disk Driver configuration

if DISK_DRIVERS

# zephyr-keep-sorted-start
source "drivers/disk/Kconfig.flash"
source "drivers/disk/Kconfig.loopback"
source "drivers/disk/Kconfig.mmc"
source "drivers/disk/Kconfig.ram"
source "drivers/disk/Kconfig.sdmmc"
# zephyr-keep-sorted-stop

rsource "/home/ljd/wsMA_prototyp/ZRTOS_demo/zephyr/drivers/disk/drivers/disk/nvme/Kconfig"

endif # DISK_DRIVERS
```

## transform_projects/transform_zrtos/ZRTOS_copy/drivers/ethernet/Kconfig.test
```kconfig
# Copyright (c) 2024 TOKITA Hiroshi
# SPDX-License-Identifier: Apache-2.0

config ETH_TEST
 bool
 default DT_HAS_VND_ETHERNET_ENABLED
	depends on DT_HAS_VND_ETHERNET_ENABLED
```

## transform_projects/transform_zrtos/ZRTOS_copy/drivers/hwinfo/Kconfig
```kconfig
# HW Info driver configuration options

# Copyright (c) 2019 Alexander Wachter
# SPDX-License-Identifier: Apache-2.0

menuconfig HWINFO
	bool "Hardware Information drivers"
	help
	  Enable hwinfo driver.

if HWINFO

module = HWINFO
module-str = HWINFO
source "subsys/logging/Kconfig.template.log_config"

config HWINFO_HAS_DRIVER
	bool
	help
	  This is an option enabled by individual drivers to signal that there is a hwinfo driver.

config HWINFO_SHELL
	bool "HWINFO Shell"
	depends on SHELL
	help
	  Enable hwinfo Shell for testing.

# zephyr-keep-sorted-start
rsource "/home/ljd/wsMA_prototyp/ZRTOS_demo/zephyr/drivers/hwinfo/drivers/hwinfo/Kconfig.ambiq"
rsource "/home/ljd/wsMA_prototyp/ZRTOS_demo/zephyr/drivers/hwinfo/drivers/hwinfo/Kconfig.andes"
rsource "/home/ljd/wsMA_prototyp/ZRTOS_demo/zephyr/drivers/hwinfo/drivers/hwinfo/Kconfig.cc13xx_cc26xx"
rsource "/home/ljd/wsMA_prototyp/ZRTOS_demo/zephyr/drivers/hwinfo/drivers/hwinfo/Kconfig.cc23x0"
rsource "/home/ljd/wsMA_prototyp/ZRTOS_demo/zephyr/drivers/hwinfo/drivers/hwinfo/Kconfig.esp32"
rsource "/home/ljd/wsMA_prototyp/ZRTOS_demo/zephyr/drivers/hwinfo/drivers/hwinfo/Kconfig.gecko"
rsource "/home/ljd/wsMA_prototyp/ZRTOS_demo/zephyr/drivers/hwinfo/drivers/hwinfo/Kconfig.imxrt"
rsource "/home/ljd/wsMA_prototyp/ZRTOS_demo/zephyr/drivers/hwinfo/drivers/hwinfo/Kconfig.litex"
rsource "/home/ljd/wsMA_prototyp/ZRTOS_demo/zephyr/drivers/hwinfo/drivers/hwinfo/Kconfig.max32"
rsource "/home/ljd/wsMA_prototyp/ZRTOS_demo/zephyr/drivers/hwinfo/drivers/hwinfo/Kconfig.mcux_mcx_cmc"
rsource "/home/ljd/wsMA_prototyp/ZRTOS_demo/zephyr/drivers/hwinfo/drivers/hwinfo/Kconfig.mcux_rcm"
rsource "/home/ljd/wsMA_prototyp/ZRTOS_demo/zephyr/drivers/hwinfo/drivers/hwinfo/Kconfig.mcux_rstctl"
rsource "/home/ljd/wsMA_prototyp/ZRTOS_demo/zephyr/drivers/hwinfo/drivers/hwinfo/Kconfig.mcux_sim"
rsource "/home/ljd/wsMA_prototyp/ZRTOS_demo/zephyr/drivers/hwinfo/drivers/hwinfo/Kconfig.mcux_src"
rsource "/home/ljd/wsMA_prototyp/ZRTOS_demo/zephyr/drivers/hwinfo/drivers/hwinfo/Kconfig.mcux_src_rev2"
rsource "/home/ljd/wsMA_prototyp/ZRTOS_demo/zephyr/drivers/hwinfo/drivers/hwinfo/Kconfig.mcux_syscon"
rsource "/home/ljd/wsMA_prototyp/ZRTOS_demo/zephyr/drivers/hwinfo/drivers/hwinfo/Kconfig.mspm0"
rsource "/home/ljd/wsMA_prototyp/ZRTOS_demo/zephyr/drivers/hwinfo/drivers/hwinfo/Kconfig.native"
rsource "/home/ljd/wsMA_prototyp/ZRTOS_demo/zephyr/drivers/hwinfo/drivers/hwinfo/Kconfig.nrf"
rsource "/home/ljd/wsMA_prototyp/ZRTOS_demo/zephyr/drivers/hwinfo/drivers/hwinfo/Kconfig.numaker"
rsource "/home/ljd/wsMA_prototyp/ZRTOS_demo/zephyr/drivers/hwinfo/drivers/hwinfo/Kconfig.numaker_rmc"
rsource "/home/ljd/wsMA_prototyp/ZRTOS_demo/zephyr/drivers/hwinfo/drivers/hwinfo/Kconfig.psoc6"
rsource "/home/ljd/wsMA_prototyp/ZRTOS_demo/zephyr/drivers/hwinfo/drivers/hwinfo/Kconfig.renesas_ra"
rsource "/home/ljd/wsMA_prototyp/ZRTOS_demo/zephyr/drivers/hwinfo/drivers/hwinfo/Kconfig.rpi_pico"
rsource "/home/ljd/wsMA_prototyp/ZRTOS_demo/zephyr/drivers/hwinfo/drivers/hwinfo/Kconfig.rw61x"
rsource "/home/ljd/wsMA_prototyp/ZRTOS_demo/zephyr/drivers/hwinfo/drivers/hwinfo/Kconfig.sam"
rsource "/home/ljd/wsMA_prototyp/ZRTOS_demo/zephyr/drivers/hwinfo/drivers/hwinfo/Kconfig.sam0"
rsource "/home/ljd/wsMA_prototyp/ZRTOS_demo/zephyr/drivers/hwinfo/drivers/hwinfo/Kconfig.sam4l"
rsource "/home/ljd/wsMA_prototyp/ZRTOS_demo/zephyr/drivers/hwinfo/drivers/hwinfo/Kconfig.sam_rstc"
rsource "/home/ljd/wsMA_prototyp/ZRTOS_demo/zephyr/drivers/hwinfo/drivers/hwinfo/Kconfig.silabs_series2"
rsource "/home/ljd/wsMA_prototyp/ZRTOS_demo/zephyr/drivers/hwinfo/drivers/hwinfo/Kconfig.smartbond"
rsource "/home/ljd/wsMA_prototyp/ZRTOS_demo/zephyr/drivers/hwinfo/drivers/hwinfo/Kconfig.stm32"
# zephyr-keep-sorted-stop

endif
```

## transform_projects/transform_zrtos/ZRTOS_copy/drivers/i2s/Kconfig.test
```kconfig
# Copyright (c) 2024 TOKITA Hiroshi
# SPDX-License-Identifier: Apache-2.0

config I2S_TEST
 bool
 default DT_HAS_VND_I2S_ENABLED
	depends on DT_HAS_VND_I2S_ENABLED
```

## transform_projects/transform_zrtos/ZRTOS_copy/drivers/mipi_dsi/Kconfig.test
```kconfig
# Copyright (c) 2024 TOKITA Hiroshi
# SPDX-License-Identifier: Apache-2.0

config MIPI_DSI_TEST
 bool
 default DT_HAS_VND_MIPI_DSI_ENABLED
	depends on DT_HAS_VND_MIPI_DSI_ENABLED
```

## transform_projects/transform_zrtos/ZRTOS_copy/drivers/reset/Kconfig
```kconfig
# Reset Controller driver configuration options

# Copyright (c) 2022 Andrei-Edward Popa <andrei.popa105@yahoo.com>
# SPDX-License-Identifier: Apache-2.0

#
# Reset Controller options
#
menuconfig RESET
	bool "Reset Controller drivers"
	help
	  Reset Controller drivers. Reset node represents a region containing
	  information about reset controller device. The typical use-case is
	  for some other node's drivers to acquire a reference to the reset
	  controller node together with some reset information.

if RESET

config RESET_INIT_PRIORITY
	int "Reset Controller driver init priority"
	default 35
	help
	  This option controls the priority of the reset controller device
	  initialization. Higher priority ensures that the device is
	  initialized earlier in the startup cycle. If unsure, leave at default
	  value

comment "Reset Controller Drivers"

# zephyr-keep-sorted-start
rsource "/home/ljd/wsMA_prototyp/ZRTOS_demo/zephyr/drivers/reset/drivers/reset/Kconfig.aspeed"
rsource "/home/ljd/wsMA_prototyp/ZRTOS_demo/zephyr/drivers/reset/drivers/reset/Kconfig.gd32"
rsource "/home/ljd/wsMA_prototyp/ZRTOS_demo/zephyr/drivers/reset/drivers/reset/Kconfig.intel_socfpga"
rsource "/home/ljd/wsMA_prototyp/ZRTOS_demo/zephyr/drivers/reset/drivers/reset/Kconfig.lpc_syscon"
rsource "/home/ljd/wsMA_prototyp/ZRTOS_demo/zephyr/drivers/reset/drivers/reset/Kconfig.mchp"
rsource "/home/ljd/wsMA_prototyp/ZRTOS_demo/zephyr/drivers/reset/drivers/reset/Kconfig.mchp_mss"
rsource "/home/ljd/wsMA_prototyp/ZRTOS_demo/zephyr/drivers/reset/drivers/reset/Kconfig.mmio"
rsource "/home/ljd/wsMA_prototyp/ZRTOS_demo/zephyr/drivers/reset/drivers/reset/Kconfig.npcx"
rsource "/home/ljd/wsMA_prototyp/ZRTOS_demo/zephyr/drivers/reset/drivers/reset/Kconfig.numaker"
rsource "/home/ljd/wsMA_prototyp/ZRTOS_demo/zephyr/drivers/reset/drivers/reset/Kconfig.nxp_mrcc"
rsource "/home/ljd/wsMA_prototyp/ZRTOS_demo/zephyr/drivers/reset/drivers/reset/Kconfig.nxp_rstctl"
rsource "/home/ljd/wsMA_prototyp/ZRTOS_demo/zephyr/drivers/reset/drivers/reset/Kconfig.rpi_pico"
rsource "/home/ljd/wsMA_prototyp/ZRTOS_demo/zephyr/drivers/reset/drivers/reset/Kconfig.sf32lb"
rsource "/home/ljd/wsMA_prototyp/ZRTOS_demo/zephyr/drivers/reset/drivers/reset/Kconfig.stm32"
# zephyr-keep-sorted-stop

endif # RESET
```

## transform_projects/transform_zrtos/ZRTOS_copy/drivers/stepper/adi_tmc/Kconfig
```kconfig
# SPDX-FileCopyrightText: Copyright (c) 2024 Carl Zeiss Meditec AG
# SPDX-License-Identifier: Apache-2.0

comment "ADI Trinamic Stepper Drivers"

rsource "/home/ljd/wsMA_prototyp/ZRTOS_demo/zephyr/drivers/stepper/adi_tmc/drivers/stepper/adi_tmc/bus/Kconfig"

rsource "/home/ljd/wsMA_prototyp/ZRTOS_demo/zephyr/drivers/stepper/adi_tmc/drivers/stepper/adi_tmc/tmc22xx/Kconfig.tmc22xx"
rsource "/home/ljd/wsMA_prototyp/ZRTOS_demo/zephyr/drivers/stepper/adi_tmc/drivers/stepper/adi_tmc/tmc50xx/Kconfig.tmc50xx"
rsource "/home/ljd/wsMA_prototyp/ZRTOS_demo/zephyr/drivers/stepper/adi_tmc/drivers/stepper/adi_tmc/tmc51xx/Kconfig.tmc51xx"
```
