## transform_projects/transform_zrtos/ZRTOS_copy/boards/shields/mikroe_wifi_bt_click/Kconfig.shield
```kconfig
# Copyright (c) 2022 Linaro Limited.
# SPDX-License-Identifier: Apache-2.0

config SHIELD_MIKROE_WIFI_BT_CLICK
 bool
 default $(shields_list_contains,mikroe_wifi_bt_click)

config SHIELD_MIKROE_WIFI_BT_CLICK_MIKROBUS
 bool
 default $(shields_list_contains,mikroe_wifi_bt_click_mikrobus)

config SHIELD_MIKROE_WIFI_BT_CLICK_ARDUINO
 bool
 default $(shields_list_contains,mikroe_wifi_bt_click_arduino)
```

## transform_projects/transform_zrtos/ZRTOS_copy/boards/shields/npm1100_ek/Kconfig.shield
```kconfig
# Copyright (c) 2023 Nordic Semiconductor ASA
# SPDX-License-Identifier: Apache-2.0

config SHIELD_NPM1100_EK
 bool
 default $(shields_list_contains,npm1100_ek)
```

## transform_projects/transform_zrtos/ZRTOS_copy/boards/shields/nrf7002ek/Kconfig.shield
```kconfig
# Copyright (c) 2024 Nordic Semiconductor ASA
# SPDX-License-Identifier: Apache-2.0

config SHIELD_NRF7002EK
 bool
 default $(shields_list_contains,nrf7002ek)

config SHIELD_NRF7002EK_NRF7001
 bool
 default $(shields_list_contains,nrf7002ek_nrf7001)

config SHIELD_NRF7002EK_NRF7000
 bool
 default $(shields_list_contains,nrf7002ek_nrf7000)

config SHIELD_NRF7002EK_COEX
 bool
 default $(shields_list_contains,nrf7002ek_coex)
```

## transform_projects/transform_zrtos/ZRTOS_copy/boards/shields/olimex_shield_midi/Kconfig.shield
```kconfig
# Copyright (c) 2025 Titouan Christophe
# SPDX-License-Identifier: Apache-2.0

config SHIELD_OLIMEX_SHIELD_MIDI
 bool
 default $(shields_list_contains,olimex_shield_midi)
```

## transform_projects/transform_zrtos/ZRTOS_copy/boards/shields/reyax_lora/Kconfig.shield
```kconfig
# Copyright (c) 2024 David Ullmann
# SPDX-License-Identifier: Apache-2.0

config SHIELD_REYAX_LORA
 bool
 default $(shields_list_contains,reyax_lora)
```

## transform_projects/transform_zrtos/ZRTOS_copy/boards/shields/rtklcdpar1s00001be/Kconfig.shield
```kconfig
# Copyright (c) 2025 Renesas Electronics Corporation
# SPDX-License-Identifier: Apache-2.0

config SHIELD_RTKLCDPAR1S00001BE
 bool
 default $(shields_list_contains,rtklcdpar1s00001be)
```

## transform_projects/transform_zrtos/ZRTOS_copy/boards/shields/seeed_w5500/Kconfig.shield
```kconfig
# Copyright (c) 2024 Marcin Niestroj
# SPDX-License-Identifier: Apache-2.0

config SHIELD_SEEED_W5500
 bool
 default $(shields_list_contains,seeed_w5500)
```

## transform_projects/transform_zrtos/ZRTOS_copy/boards/shields/semtech_sx1262mb2das/Kconfig.shield
```kconfig
# Copyright (c) 2022 Konstantinos Papadopoulos <kostas.papadopulos@gmail.com>
# SPDX-License-Identifier: Apache-2.0

config SHIELD_SEMTECH_SX1262MB2DAS
 bool
 default $(shields_list_contains,semtech_sx1262mb2das)
```

## transform_projects/transform_zrtos/ZRTOS_copy/boards/shields/sparkfun_carrier_asset_tracker/Kconfig.shield
```kconfig
# Copyright (c) 2024 Jerónimo Agulló <jeronimoagullo97@gmail.com>
# SPDX-License-Identifier: Apache-2.0

config SHIELD_SPARKFUN_CARRIER_ASSET_TRACKER
 bool
 default $(shields_list_contains,sparkfun_carrier_asset_tracker)
```

## transform_projects/transform_zrtos/ZRTOS_copy/boards/shields/sparkfun_sara_r4/Kconfig.shield
```kconfig
# Copyright (c) 2019 Linaro Limited
# SPDX-License-Identifier: Apache-2.0

config SHIELD_SPARKFUN_SARA_R4
 bool
 default $(shields_list_contains,sparkfun_sara_r4)
```

## transform_projects/transform_zrtos/ZRTOS_copy/boards/shields/tcan4550evm/Kconfig.shield
```kconfig
# Copyright (c) 2023 Vestas Wind Systems A/S
# SPDX-License-Identifier: Apache-2.0

config SHIELD_TCAN4550EVM
 bool
 default $(shields_list_contains,tcan4550evm)
```

## transform_projects/transform_zrtos/ZRTOS_copy/boards/shields/waveshare_epaper/Kconfig.shield
```kconfig
# Copyright (c) 2019 Linaro Limited
# SPDX-License-Identifier: Apache-2.0

config SHIELD_WAVESHARE_EPAPER_GDEH029A1
 bool
 default $(shields_list_contains,waveshare_epaper_gdeh029a1)

config SHIELD_WAVESHARE_EPAPER_GDEH0213B1
 bool
 default $(shields_list_contains,waveshare_epaper_gdeh0213b1)

config SHIELD_WAVESHARE_EPAPER_GDEH0213B72
 bool
 default $(shields_list_contains,waveshare_epaper_gdeh0213b72)

config SHIELD_WAVESHARE_EPAPER_GDEW075T7
 bool
 default $(shields_list_contains,waveshare_epaper_gdew075t7)

config SHIELD_WAVESHARE_EPAPER_GDEH0154A07
 bool
 default $(shields_list_contains,waveshare_epaper_gdeh0154a07)

config SHIELD_WAVESHARE_EPAPER_GDEW042T2
 bool
 default $(shields_list_contains,waveshare_epaper_gdew042t2)

config SHIELD_WAVESHARE_EPAPER_GDEW042T2_P
 bool
 default $(shields_list_contains,waveshare_epaper_gdew042t2-p)

config SHIELD_WAVESHARE_EPAPER_GDEY0213B74
 bool
 default $(shields_list_contains,waveshare_epaper_gdey0213b74)
```

## transform_projects/transform_zrtos/ZRTOS_copy/boards/shields/waveshare_pico_lcd_1_14/Kconfig.shield
```kconfig
# Copyright (c) 2025 TOKITA Hiroshi
# SPDX-License-Identifier: Apache-2.0

config SHIELD_WAVESHARE_PICO_LCD_1_14
 bool
 default $(shields_list_contains,waveshare_pico_lcd_1_14)

config SHIELD_WAVESHARE_PICO_LCD_1_14_DISPLAY
 bool
 default $(shields_list_contains,waveshare_pico_lcd_1_14_display)

config SHIELD_WAVESHARE_PICO_LCD_1_14_BUTTONS
 bool
 default $(shields_list_contains,waveshare_pico_lcd_1_14_buttons)
```

## transform_projects/transform_zrtos/ZRTOS_copy/boards/shields/x_nucleo_bnrg2a1/Kconfig.shield
```kconfig
# Copyright (c) 2024 STMicroelectronics
# SPDX-License-Identifier: Apache-2.0

config SHIELD_X_NUCLEO_BNRG2A1
 bool
 default $(shields_list_contains,x_nucleo_bnrg2a1)
```

## transform_projects/transform_zrtos/ZRTOS_copy/build/Kconfig/Kconfig.modules
```kconfig
menu "acpica (/home/ljd/wsMA_prototyp/ZRTOS_demo/modules/lib/acpica)"
osource "/home/ljd/wsMA_prototyp/ZRTOS_demo/zephyr/build/Kconfig/modules/acpica/Kconfig"
config ZEPHYR_ACPICA_MODULE
	bool
	default y
endmenu
menu "cmsis (/home/ljd/wsMA_prototyp/ZRTOS_demo/modules/hal/cmsis)"
osource "/home/ljd/wsMA_prototyp/ZRTOS_demo/zephyr/build/Kconfig/modules/cmsis/Kconfig"
config ZEPHYR_CMSIS_MODULE
	bool
	default y
endmenu
menu "cmsis-dsp (/home/ljd/wsMA_prototyp/ZRTOS_demo/modules/lib/cmsis-dsp)"
osource "/home/ljd/wsMA_prototyp/ZRTOS_demo/zephyr/build/Kconfig/modules/cmsis-dsp/Kconfig"
config ZEPHYR_CMSIS_DSP_MODULE
	bool
	default y
endmenu
menu "cmsis-nn (/home/ljd/wsMA_prototyp/ZRTOS_demo/modules/lib/cmsis-nn)"
osource "/home/ljd/wsMA_prototyp/ZRTOS_demo/zephyr/build/Kconfig/modules/cmsis-nn/Kconfig"
config ZEPHYR_CMSIS_NN_MODULE
	bool
	default y
endmenu
menu "cmsis_6 (/home/ljd/wsMA_prototyp/ZRTOS_demo/modules/hal/cmsis_6)"
osource "/home/ljd/wsMA_prototyp/ZRTOS_demo/zephyr/build/Kconfig/modules/cmsis_6/Kconfig"
config ZEPHYR_CMSIS_6_MODULE
	bool
	default y
endmenu
menu "fatfs (/home/ljd/wsMA_prototyp/ZRTOS_demo/modules/fs/fatfs)"
osource "/home/ljd/wsMA_prototyp/ZRTOS_demo/zephyr/build/Kconfig/modules/fatfs/Kconfig"
config ZEPHYR_FATFS_MODULE
	bool
	default y
endmenu
config ZEPHYR_ADI_MODULE
	bool
	default y
menu "hal_afbr (/home/ljd/wsMA_prototyp/ZRTOS_demo/modules/hal/afbr)"
osource "/home/ljd/wsMA_prototyp/ZRTOS_demo/zephyr/build/Kconfig/modules/hal_afbr/Kconfig"
config ZEPHYR_HAL_AFBR_MODULE
	bool
	default y

config ZEPHYR_HAL_AFBR_MODULE_BLOBS
	bool
endmenu
menu "hal_ambiq (/home/ljd/wsMA_prototyp/ZRTOS_demo/modules/hal/ambiq)"
#osource "$(ZEPHYR_HAL_AMBIQ_KCONFIG)"
config ZEPHYR_HAL_AMBIQ_MODULE
	bool
	default y
endmenu
config ZEPHYR_ATMEL_MODULE
	bool
	default y
menu "hal_bouffalolab (/home/ljd/wsMA_prototyp/ZRTOS_demo/modules/hal/bouffalolab)"
osource "/home/ljd/wsMA_prototyp/ZRTOS_demo/zephyr/build/Kconfig/modules/hal_bouffalolab/Kconfig"
config ZEPHYR_HAL_BOUFFALOLAB_MODULE
	bool
	default y
endmenu
menu "hal_espressif (/home/ljd/wsMA_prototyp/ZRTOS_demo/modules/hal/espressif)"
osource "/home/ljd/wsMA_prototyp/ZRTOS_demo/modules/hal/espressif/zephyr/Kconfig"
config ZEPHYR_HAL_ESPRESSIF_MODULE
	bool
	default y

config ZEPHYR_HAL_ESPRESSIF_MODULE_BLOBS
	bool
endmenu
menu "hal_ethos_u (/home/ljd/wsMA_prototyp/ZRTOS_demo/modules/hal/ethos_u)"
osource "/home/ljd/wsMA_prototyp/ZRTOS_demo/zephyr/build/Kconfig/modules/hal_ethos_u/Kconfig"
config ZEPHYR_HAL_ETHOS_U_MODULE
	bool
	default y
endmenu
menu "hal_gigadevice (/home/ljd/wsMA_prototyp/ZRTOS_demo/modules/hal/gigadevice)"
osource "/home/ljd/wsMA_prototyp/ZRTOS_demo/zephyr/build/Kconfig/modules/hal_gigadevice/Kconfig"
config ZEPHYR_HAL_GIGADEVICE_MODULE
	bool
	default y
endmenu
menu "hal_infineon (/home/ljd/wsMA_prototyp/ZRTOS_demo/modules/hal/infineon)"
osource "/home/ljd/wsMA_prototyp/ZRTOS_demo/zephyr/build/Kconfig/modules/hal_infineon/Kconfig"
config ZEPHYR_HAL_INFINEON_MODULE
	bool
	default y

config ZEPHYR_HAL_INFINEON_MODULE_BLOBS
	bool
endmenu
menu "hal_intel (/home/ljd/wsMA_prototyp/ZRTOS_demo/modules/hal/intel)"
osource "/home/ljd/wsMA_prototyp/ZRTOS_demo/modules/hal/intel/zephyr/Kconfig"
config ZEPHYR_HAL_INTEL_MODULE
	bool
	default y
endmenu
config ZEPHYR_MICROCHIP_MODULE
	bool
	default y
menu "hal_nordic (/home/ljd/wsMA_prototyp/ZRTOS_demo/modules/hal/nordic)"
osource "/home/ljd/wsMA_prototyp/ZRTOS_demo/zephyr/build/Kconfig/modules/hal_nordic/Kconfig"
config ZEPHYR_HAL_NORDIC_MODULE
	bool
	default y

config ZEPHYR_HAL_NORDIC_MODULE_BLOBS
	bool
endmenu
config ZEPHYR_NUVOTON_MODULE
	bool
	default y
menu "hal_nxp (/home/ljd/wsMA_prototyp/ZRTOS_demo/modules/hal/nxp)"
osource "/home/ljd/wsMA_prototyp/ZRTOS_demo/zephyr/build/Kconfig/modules/hal_nxp/Kconfig"
config ZEPHYR_HAL_NXP_MODULE
	bool
	default y

config ZEPHYR_HAL_NXP_MODULE_BLOBS
	bool
endmenu
config ZEPHYR_OPENISA_MODULE
	bool
	default y
config ZEPHYR_QUICKLOGIC_MODULE
	bool
	default y
config ZEPHYR_HAL_RENESAS_MODULE
	bool
	default y

config ZEPHYR_HAL_RENESAS_MODULE_BLOBS
	bool
menu "hal_rpi_pico (/home/ljd/wsMA_prototyp/ZRTOS_demo/modules/hal/rpi_pico)"
osource "/home/ljd/wsMA_prototyp/ZRTOS_demo/zephyr/build/Kconfig/modules/hal_rpi_pico/Kconfig"
config ZEPHYR_HAL_RPI_PICO_MODULE
	bool
	default y
endmenu
menu "hal_sifli (/home/ljd/wsMA_prototyp/ZRTOS_demo/modules/hal/sifli)"
osource "/home/ljd/wsMA_prototyp/ZRTOS_demo/zephyr/build/Kconfig/modules/hal_sifli/Kconfig"
config ZEPHYR_HAL_SIFLI_MODULE
	bool
	default y
endmenu
menu "hal_silabs (/home/ljd/wsMA_prototyp/ZRTOS_demo/modules/hal/silabs)"
osource "/home/ljd/wsMA_prototyp/ZRTOS_demo/zephyr/build/Kconfig/modules/hal_silabs/Kconfig"
config ZEPHYR_HAL_SILABS_MODULE
	bool
	default y

config ZEPHYR_HAL_SILABS_MODULE_BLOBS
	bool
endmenu
menu "hal_st (/home/ljd/wsMA_prototyp/ZRTOS_demo/modules/hal/st)"
osource "/home/ljd/wsMA_prototyp/ZRTOS_demo/zephyr/build/Kconfig/modules/hal_st/Kconfig"
config ZEPHYR_HAL_ST_MODULE
	bool
	default y
endmenu
config ZEPHYR_HAL_STM32_MODULE
	bool
	default y

config ZEPHYR_HAL_STM32_MODULE_BLOBS
	bool
menu "hal_tdk (/home/ljd/wsMA_prototyp/ZRTOS_demo/modules/hal/tdk)"
osource "/home/ljd/wsMA_prototyp/ZRTOS_demo/zephyr/build/Kconfig/modules/hal_tdk/Kconfig"
config ZEPHYR_HAL_TDK_MODULE
	bool
	default y
endmenu
menu "hal_telink (/home/ljd/wsMA_prototyp/ZRTOS_demo/modules/hal/telink)"
#osource "/home/ljd/wsMA_prototyp/ZRTOS_demo/modules/hal/telink/Kconfig"
config ZEPHYR_HAL_TELINK_MODULE
	bool
	default y
endmenu
config ZEPHYR_TI_MODULE
	bool
	default y
menu "hal_wch (/home/ljd/wsMA_prototyp/ZRTOS_demo/modules/hal/wch)"
#osource "$(ZEPHYR_HAL_WCH_KCONFIG)"
config ZEPHYR_HAL_WCH_MODULE
	bool
	default y
endmenu
config ZEPHYR_HAL_WURTHELEKTRONIK_MODULE
	bool
	default y
config ZEPHYR_XTENSA_MODULE
	bool
	default y
menu "hostap (/home/ljd/wsMA_prototyp/ZRTOS_demo/modules/lib/hostap)"
osource "/home/ljd/wsMA_prototyp/ZRTOS_demo/zephyr/build/Kconfig/modules/hostap/Kconfig"
config ZEPHYR_HOSTAP_MODULE
	bool
	default y
endmenu
menu "liblc3 (/home/ljd/wsMA_prototyp/ZRTOS_demo/modules/lib/liblc3)"
osource "/home/ljd/wsMA_prototyp/ZRTOS_demo/zephyr/build/Kconfig/modules/liblc3/Kconfig"
config ZEPHYR_LIBLC3_MODULE
	bool
	default y
endmenu
config ZEPHYR_LIBMCTP_MODULE
	bool
	default y
config ZEPHYR_LIBMETAL_MODULE
	bool
	default y
menu "libsbc (/home/ljd/wsMA_prototyp/ZRTOS_demo/modules/lib/libsbc)"
osource "/home/ljd/wsMA_prototyp/ZRTOS_demo/zephyr/build/Kconfig/modules/libsbc/Kconfig"
config ZEPHYR_LIBSBC_MODULE
	bool
	default y
endmenu
menu "littlefs (/home/ljd/wsMA_prototyp/ZRTOS_demo/modules/fs/littlefs)"
osource "/home/ljd/wsMA_prototyp/ZRTOS_demo/zephyr/build/Kconfig/modules/littlefs/Kconfig"
config ZEPHYR_LITTLEFS_MODULE
	bool
	default y
endmenu
menu "lora-basics-modem (/home/ljd/wsMA_prototyp/ZRTOS_demo/modules/lib/lora-basics-modem)"
osource "/home/ljd/wsMA_prototyp/ZRTOS_demo/zephyr/build/Kconfig/modules/lora-basics-modem/Kconfig"
config ZEPHYR_LORA_BASICS_MODEM_MODULE
	bool
	default y
endmenu
menu "loramac-node (/home/ljd/wsMA_prototyp/ZRTOS_demo/modules/lib/loramac-node)"
osource "/home/ljd/wsMA_prototyp/ZRTOS_demo/zephyr/build/Kconfig/modules/loramac-node/Kconfig"
config ZEPHYR_LORAMAC_NODE_MODULE
	bool
	default y
endmenu
menu "lvgl (/home/ljd/wsMA_prototyp/ZRTOS_demo/modules/lib/gui/lvgl)"
#osource "/home/ljd/wsMA_prototyp/ZRTOS_demo/modules/lib/gui/lvgl/zephyr/Kconfig"
config ZEPHYR_LVGL_MODULE
	bool
	default y
endmenu
menu "mbedtls (/home/ljd/wsMA_prototyp/ZRTOS_demo/modules/crypto/mbedtls)"
osource "/home/ljd/wsMA_prototyp/ZRTOS_demo/zephyr/build/Kconfig/modules/mbedtls/Kconfig"
config ZEPHYR_MBEDTLS_MODULE
	bool
	default y
endmenu
config ZEPHYR_MCUBOOT_MODULE
	bool
	default y
config ZEPHYR_MIPI_SYS_T_MODULE
	bool
	default y
menu "nanopb (/home/ljd/wsMA_prototyp/ZRTOS_demo/modules/lib/nanopb)"
osource "/home/ljd/wsMA_prototyp/ZRTOS_demo/zephyr/build/Kconfig/modules/nanopb/Kconfig"
config ZEPHYR_NANOPB_MODULE
	bool
	default y
endmenu
menu "nrf_wifi (/home/ljd/wsMA_prototyp/ZRTOS_demo/modules/lib/nrf_wifi)"
osource "/home/ljd/wsMA_prototyp/ZRTOS_demo/zephyr/build/Kconfig/modules/nrf_wifi/Kconfig"
config ZEPHYR_NRF_WIFI_MODULE
	bool
	default y

config ZEPHYR_NRF_WIFI_MODULE_BLOBS
	bool
endmenu
config ZEPHYR_OPEN_AMP_MODULE
	bool
	default y
menu "openthread (/home/ljd/wsMA_prototyp/ZRTOS_demo/modules/lib/openthread)"
osource "/home/ljd/wsMA_prototyp/ZRTOS_demo/zephyr/build/Kconfig/modules/openthread/Kconfig"
config ZEPHYR_OPENTHREAD_MODULE
	bool
	default y
endmenu
menu "percepio (/home/ljd/wsMA_prototyp/ZRTOS_demo/modules/debug/percepio)"
osource "/home/ljd/wsMA_prototyp/ZRTOS_demo/modules/debug/percepio/zephyr/Kconfig"
config ZEPHYR_PERCEPIO_MODULE
	bool
	default y
endmenu
menu "picolibc (/home/ljd/wsMA_prototyp/ZRTOS_demo/modules/lib/picolibc)"
osource "/home/ljd/wsMA_prototyp/ZRTOS_demo/modules/lib/picolibc/zephyr/Kconfig"
config ZEPHYR_PICOLIBC_MODULE
	bool
	default y
endmenu
menu "segger (/home/ljd/wsMA_prototyp/ZRTOS_demo/modules/debug/segger)"
osource "/home/ljd/wsMA_prototyp/ZRTOS_demo/zephyr/build/Kconfig/modules/segger/Kconfig"
config ZEPHYR_SEGGER_MODULE
	bool
	default y
endmenu
menu "trusted-firmware-a (/home/ljd/wsMA_prototyp/ZRTOS_demo/modules/tee/tf-a/trusted-firmware-a)"
osource "/home/ljd/wsMA_prototyp/ZRTOS_demo/zephyr/build/Kconfig/modules/trusted-firmware-a/Kconfig"
config ZEPHYR_TRUSTED_FIRMWARE_A_MODULE
	bool
	default y
endmenu
menu "trusted-firmware-m (/home/ljd/wsMA_prototyp/ZRTOS_demo/modules/tee/tf-m/trusted-firmware-m)"
#osource "$(ZEPHYR_TRUSTED_FIRMWARE_M_KCONFIG)"
config ZEPHYR_TRUSTED_FIRMWARE_M_MODULE
	bool
	default y
endmenu
menu "uoscore-uedhoc (/home/ljd/wsMA_prototyp/ZRTOS_demo/modules/lib/uoscore-uedhoc)"
osource "/home/ljd/wsMA_prototyp/ZRTOS_demo/zephyr/build/Kconfig/modules/uoscore-uedhoc/Kconfig"
config ZEPHYR_UOSCORE_UEDHOC_MODULE
	bool
	default y
endmenu
menu "zcbor (/home/ljd/wsMA_prototyp/ZRTOS_demo/modules/lib/zcbor)"
osource "/home/ljd/wsMA_prototyp/ZRTOS_demo/zephyr/build/Kconfig/modules/zcbor/Kconfig"
config ZEPHYR_ZCBOR_MODULE
	bool
	default y
endmenu
config ZEPHYR_NRF_HW_MODELS_MODULE
	bool
	default y
```
