## transform_projects/transform_zrtos/ZRTOS_copy/soc/gd/gd32/gd32e50x/Kconfig.defconfig.series
```kconfig
# Copyright (c) 2022, Teslabs Engineering S.L.
# SPDX-License-Identifier: Apache-2.0

if SOC_SERIES_GD32E50X

rsource "/home/ljd/wsMA_prototyp/ZRTOS_demo/zephyr/soc/gd/gd32/gd32e50x/soc/gd/gd32/gd32e50x/Kconfig.defconfig.gd32e507"

endif # SOC_SERIES_GD32E50X
```

## transform_projects/transform_zrtos/ZRTOS_copy/soc/gd/gd32/gd32f403/Kconfig.defconfig.series
```kconfig
# Copyright (c) 2021, ATL Electronics
# SPDX-License-Identifier: Apache-2.0

if SOC_SERIES_GD32F403

rsource "/home/ljd/wsMA_prototyp/ZRTOS_demo/zephyr/soc/gd/gd32/gd32f403/soc/gd/gd32/gd32f403/Kconfig.defconfig.gd32f403"

endif # SOC_SERIES_GD32F403
```

## transform_projects/transform_zrtos/ZRTOS_copy/soc/infineon/cat1b/Kconfig
```kconfig
# Copyright (c) 2024 Cypress Semiconductor Corporation (an Infineon company) or
# an affiliate of Cypress Semiconductor Corporation
# SPDX-License-Identifier: Apache-2.0

if SOC_FAMILY_INFINEON_CAT1B

rsource "/home/ljd/wsMA_prototyp/ZRTOS_demo/zephyr/soc/infineon/cat1b/soc/infineon/cat1b/cyw20829/Kconfig"
rsource "/home/ljd/wsMA_prototyp/ZRTOS_demo/zephyr/soc/infineon/cat1b/soc/infineon/cat1b/psc3/Kconfig"

endif # SOC_FAMILY_INFINEON_CAT1B
```

## transform_projects/transform_zrtos/ZRTOS_copy/soc/infineon/cat1b/Kconfig.defconfig
```kconfig
# PSOC CAT1B Configuration

# Copyright (c) 2024 Cypress Semiconductor Corporation.
# SPDX-License-Identifier: Apache-2.0

if SOC_FAMILY_INFINEON_CAT1B

rsource "/home/ljd/wsMA_prototyp/ZRTOS_demo/zephyr/soc/infineon/cat1b/soc/infineon/cat1b/cyw20829/Kconfig.defconfig"
rsource "/home/ljd/wsMA_prototyp/ZRTOS_demo/zephyr/soc/infineon/cat1b/soc/infineon/cat1b/psc3/Kconfig.defconfig"

endif # SOC_FAMILY_INFINEON_CAT1B
```

## transform_projects/transform_zrtos/ZRTOS_copy/soc/infineon/cat1b/Kconfig.soc
```kconfig
# Copyright (c) 2024 Cypress Semiconductor Corporation (an Infineon company) or
# an affiliate of Cypress Semiconductor Corporation
# SPDX-License-Identifier: Apache-2.0

# Family definitions
config SOC_FAMILY_INFINEON_CAT1
	bool

config SOC_FAMILY_INFINEON_CAT1B
	bool
	select SOC_FAMILY_INFINEON_CAT1

# MPNs definitions
rsource "/home/ljd/wsMA_prototyp/ZRTOS_demo/zephyr/soc/infineon/cat1b/soc/infineon/cat1b/cyw20829/Kconfig.soc"
rsource "/home/ljd/wsMA_prototyp/ZRTOS_demo/zephyr/soc/infineon/cat1b/soc/infineon/cat1b/psc3/Kconfig.soc"
```

## transform_projects/transform_zrtos/ZRTOS_copy/soc/infineon/cat3/Kconfig.defconfig
```kconfig
# SPDX-License-Identifier: Apache-2.0
#
# Copyright (c) 2020 Linumiz
# Author: Parthiban Nallathambi <parthiban@linumiz.com>

if SOC_FAMILY_INFINEON_XMC

rsource "/home/ljd/wsMA_prototyp/ZRTOS_demo/zephyr/soc/infineon/cat3/soc/infineon/cat3/xmc4xxx/Kconfig.defconfig"

endif # SOC_FAMILY_INFINEON_XMC
```

## transform_projects/transform_zrtos/ZRTOS_copy/soc/intel/intel_adsp/Kconfig.soc
```kconfig
# Intel CAVS SoC series selection
#
# Copyright (c) 2020-2024 Intel Corporation
# SPDX-License-Identifier: Apache-2.0

config SOC_FAMILY_INTEL_ADSP
	bool

config SOC_FAMILY
	default "intel_adsp" if SOC_FAMILY_INTEL_ADSP

rsource "/home/ljd/wsMA_prototyp/ZRTOS_demo/zephyr/soc/intel/intel_adsp/soc/intel/intel_adsp/ace/Kconfig.soc"
rsource "/home/ljd/wsMA_prototyp/ZRTOS_demo/zephyr/soc/intel/intel_adsp/soc/intel/intel_adsp/cavs/Kconfig.soc"
```

## transform_projects/transform_zrtos/ZRTOS_copy/soc/intel/intel_niosv/Kconfig
```kconfig
# Copyright (c) 2024 Nordic Semiconductor ASA
# Copyright (c) 2023-2024 Intel Corporation
#
# SPDX-License-Identifier: Apache-2.0

if SOC_FAMILY_INTEL_NIOSV

rsource "/home/ljd/wsMA_prototyp/ZRTOS_demo/zephyr/soc/intel/intel_niosv/soc/intel/intel_niosv/niosv/Kconfig"

endif # SOC_FAMILY_INTEL_NIOSV
```

## transform_projects/transform_zrtos/ZRTOS_copy/soc/intel/intel_socfpga/agilex5/Kconfig.defconfig.series
```kconfig
# Copyright (c) 2022-2024 Intel Corporation
# SPDX-License-Identifier: Apache-2.0

if SOC_SERIES_AGILEX5

rsource "/home/ljd/wsMA_prototyp/ZRTOS_demo/zephyr/soc/intel/intel_socfpga/agilex5/soc/intel/intel_socfpga/agilex5/Kconfig.defconfig.agilex5"

endif # SOC_SERIES_AGILEX5
```

## transform_projects/transform_zrtos/ZRTOS_copy/soc/intel/intel_socfpga_std/Kconfig
```kconfig
# Copyright (c) 2022-2024 Intel Corporation
# SPDX-License-Identifier: Apache-2.0

if SOC_FAMILY_INTEL_SOCFPGA_STD

rsource "/home/ljd/wsMA_prototyp/ZRTOS_demo/zephyr/soc/intel/intel_socfpga_std/soc/intel/intel_socfpga_std/cyclonev/Kconfig"

endif # SOC_FAMILY_INTEL_SOCFPGA_STD
```

## transform_projects/transform_zrtos/ZRTOS_copy/soc/ite/ec/Kconfig.defconfig
```kconfig
# Copyright (c) 2020 ITE Corporation. All Rights Reserved.
# SPDX-License-Identifier: Apache-2.0

if SOC_FAMILY_ITE_EC

rsource "/home/ljd/wsMA_prototyp/ZRTOS_demo/zephyr/soc/ite/ec/soc/ite/ec/it51xxx/Kconfig.defconfig.series"
rsource "/home/ljd/wsMA_prototyp/ZRTOS_demo/zephyr/soc/ite/ec/soc/ite/ec/it8xxx2/Kconfig.defconfig.series"

choice PM_POLICY
	default PM_POLICY_CUSTOM if SOC_FAMILY_ITE_EC
endchoice

endif # SOC_FAMILY_ITE_EC
```

## transform_projects/transform_zrtos/ZRTOS_copy/soc/microchip/mec/Kconfig.soc
```kconfig
# Microchip MEC172x, MEC1501 MCU line

# Copyright (c) 2018 Intel Corporation
# SPDX-License-Identifier: Apache-2.0

config SOC_FAMILY_MICROCHIP_MEC
	bool

config SOC_FAMILY
	default "microchip_mec" if SOC_FAMILY_MICROCHIP_MEC

rsource "/home/ljd/wsMA_prototyp/ZRTOS_demo/zephyr/soc/microchip/mec/soc/microchip/mec/mec15xx/Kconfig.soc"
rsource "/home/ljd/wsMA_prototyp/ZRTOS_demo/zephyr/soc/microchip/mec/soc/microchip/mec/mec172x/Kconfig.soc"
rsource "/home/ljd/wsMA_prototyp/ZRTOS_demo/zephyr/soc/microchip/mec/soc/microchip/mec/mec174x/Kconfig.soc"
rsource "/home/ljd/wsMA_prototyp/ZRTOS_demo/zephyr/soc/microchip/mec/soc/microchip/mec/mec175x/Kconfig.soc"
rsource "/home/ljd/wsMA_prototyp/ZRTOS_demo/zephyr/soc/microchip/mec/soc/microchip/mec/mech172x/Kconfig.soc"
```

## transform_projects/transform_zrtos/ZRTOS_copy/soc/microchip/miv/Kconfig
```kconfig
# Copyright (c) 2024 Nordic Semiconductor ASA
# SPDX-License-Identifier: Apache-2.0

if SOC_FAMILY_MICROCHIP_MIV

rsource "/home/ljd/wsMA_prototyp/ZRTOS_demo/zephyr/soc/microchip/miv/soc/microchip/miv/miv/Kconfig"
rsource "/home/ljd/wsMA_prototyp/ZRTOS_demo/zephyr/soc/microchip/miv/soc/microchip/miv/polarfire/Kconfig"

endif # SOC_FAMILY_MICROCHIP_MIV
```

## transform_projects/transform_zrtos/ZRTOS_copy/soc/microchip/miv/Kconfig.defconfig
```kconfig
# Copyright (c) 2024 Nordic Semiconductor ASA
# SPDX-License-Identifier: Apache-2.0

if SOC_FAMILY_MICROCHIP_MIV

rsource "/home/ljd/wsMA_prototyp/ZRTOS_demo/zephyr/soc/microchip/miv/soc/microchip/miv/miv/Kconfig.defconfig"
rsource "/home/ljd/wsMA_prototyp/ZRTOS_demo/zephyr/soc/microchip/miv/soc/microchip/miv/polarfire/Kconfig.defconfig"

endif # SOC_FAMILY_MICROCHIP_MIV
```

## transform_projects/transform_zrtos/ZRTOS_copy/soc/microchip/pic32c/pic32cx_sg/Kconfig.soc
```kconfig
# Copyright (c) 2025 Microchip Technology Inc.
# SPDX-License-Identifier: Apache-2.0

config SOC_FAMILY_MICROCHIP_PIC32CX_SG
	bool

config SOC_FAMILY
	default "microchip_pic32cx_sg" if SOC_FAMILY_MICROCHIP_PIC32CX_SG

rsource "/home/ljd/wsMA_prototyp/ZRTOS_demo/zephyr/soc/microchip/pic32c/pic32cx_sg/soc/microchip/pic32c/pic32cx_sg/pic32cx_sg41/Kconfig.soc"
rsource "/home/ljd/wsMA_prototyp/ZRTOS_demo/zephyr/soc/microchip/pic32c/pic32cx_sg/soc/microchip/pic32c/pic32cx_sg/pic32cx_sg60/Kconfig.soc"
rsource "/home/ljd/wsMA_prototyp/ZRTOS_demo/zephyr/soc/microchip/pic32c/pic32cx_sg/soc/microchip/pic32c/pic32cx_sg/pic32cx_sg61/Kconfig.soc"
```

## transform_projects/transform_zrtos/ZRTOS_copy/soc/microchip/sam/sam_d5x_e5x/Kconfig.soc
```kconfig
# Copyright (c) 2025 Microchip Technology Inc.
# SPDX-License-Identifier: Apache-2.0

config SOC_FAMILY_MICROCHIP_SAM_D5X_E5X
	bool

config SOC_FAMILY
	default "microchip_sam_d5x_e5x" if SOC_FAMILY_MICROCHIP_SAM_D5X_E5X

# List of Peripheral IPs available in SOC_FAMILY_MICROCHIP_SAM_D5X_E5X family
if SOC_FAMILY_MICROCHIP_SAM_D5X_E5X

config PINCTRL_MCHP_PORT_U2210_2_2_0
	bool
	default y
	help
	  Enable PORT pinctrl peripheral IP version 2.2.0 (U2210).

config UART_MCHP_SERCOM_U2201_5_0_0
	bool
	default y
	help
	  Enable SERCOM UART peripheral IP version 5.0.0 (U2201).

endif # SOC_FAMILY_MICROCHIP_SAM_D5X_E5X

rsource "/home/ljd/wsMA_prototyp/ZRTOS_demo/zephyr/soc/microchip/sam/sam_d5x_e5x/soc/microchip/sam/sam_d5x_e5x/atsamd51/Kconfig.soc"
rsource "/home/ljd/wsMA_prototyp/ZRTOS_demo/zephyr/soc/microchip/sam/sam_d5x_e5x/soc/microchip/sam/sam_d5x_e5x/atsame51/Kconfig.soc"
rsource "/home/ljd/wsMA_prototyp/ZRTOS_demo/zephyr/soc/microchip/sam/sam_d5x_e5x/soc/microchip/sam/sam_d5x_e5x/atsame53/Kconfig.soc"
rsource "/home/ljd/wsMA_prototyp/ZRTOS_demo/zephyr/soc/microchip/sam/sam_d5x_e5x/soc/microchip/sam/sam_d5x_e5x/atsame54/Kconfig.soc"
```

## transform_projects/transform_zrtos/ZRTOS_copy/soc/nordic/common/Kconfig.defconfig
```kconfig
# Copyright (c) 2024 Nordic Semiconductor ASA
# SPDX-License-Identifier: Apache-2.0

if RISCV_CORE_NORDIC_VPR

rsource "/home/ljd/wsMA_prototyp/ZRTOS_demo/zephyr/soc/nordic/common/soc/nordic/common/vpr/Kconfig.defconfig"

endif # RISCV_CORE_NORDIC_VPR

config PM_DEVICE_RUNTIME_DEFAULT_ENABLE
	default y if PM_DEVICE_RUNTIME
```

## transform_projects/transform_zrtos/ZRTOS_copy/soc/nuvoton/npcm/Kconfig
```kconfig
# Copyright (c) 2024 Nuvoton Technology Corporation.
#
# SPDX-License-Identifier: Apache-2.0

if SOC_FAMILY_NPCM

rsource "/home/ljd/wsMA_prototyp/ZRTOS_demo/zephyr/soc/nuvoton/npcm/soc/nuvoton/npcm/npcm4/Kconfig"

endif # SOC_FAMILY_NPCM
```

## transform_projects/transform_zrtos/ZRTOS_copy/soc/nuvoton/npcx/Kconfig.defconfig
```kconfig
# SPDX-License-Identifier: Apache-2.0

# Copyright (c) 2020 Nuvoton Technology Corporation.
# SPDX-License-Identifier: Apache-2.0

if SOC_FAMILY_NPCX

rsource "/home/ljd/wsMA_prototyp/ZRTOS_demo/zephyr/soc/nuvoton/npcx/soc/nuvoton/npcx/npck3/Kconfig.defconfig"
rsource "/home/ljd/wsMA_prototyp/ZRTOS_demo/zephyr/soc/nuvoton/npcx/soc/nuvoton/npcx/npcx4/Kconfig.defconfig"
rsource "/home/ljd/wsMA_prototyp/ZRTOS_demo/zephyr/soc/nuvoton/npcx/soc/nuvoton/npcx/npcx7/Kconfig.defconfig"
rsource "/home/ljd/wsMA_prototyp/ZRTOS_demo/zephyr/soc/nuvoton/npcx/soc/nuvoton/npcx/npcx9/Kconfig.defconfig"

endif # SOC_FAMILY_NPCX
```

## transform_projects/transform_zrtos/ZRTOS_copy/soc/nuvoton/numaker/m2l31x/Kconfig.defconfig
```kconfig
# Copyright (c) 2024 Nuvoton Technology Corporation.
#
# SPDX-License-Identifier: Apache-2.0

if SOC_SERIES_M2L31X

rsource "/home/ljd/wsMA_prototyp/ZRTOS_demo/zephyr/soc/nuvoton/numaker/m2l31x/soc/nuvoton/numaker/m2l31x/Kconfig.defconfig.m2l31xxx"

endif # SOC_SERIES_M2L31X
```

## transform_projects/transform_zrtos/ZRTOS_copy/soc/nuvoton/numicro/Kconfig.soc
```kconfig
# SPDX-License-Identifier: Apache-2.0
#
# Copyright (c) 2020 Linumiz
# Author: Saravanan Sekar <saravanan@linumiz.com>

config SOC_FAMILY_NUMICRO
	bool

config SOC_FAMILY
	default "numicro" if SOC_FAMILY_NUMICRO

rsource "/home/ljd/wsMA_prototyp/ZRTOS_demo/zephyr/soc/nuvoton/numicro/soc/nuvoton/numicro/m48x/Kconfig.soc"
```

## transform_projects/transform_zrtos/ZRTOS_copy/soc/nuvoton/numicro/m48x/Kconfig.defconfig
```kconfig
# SPDX-License-Identifier: Apache-2.0
#
# Copyright (c) 2020 Linumiz
# Author: Saravanan Sekar <saravanan@linumiz.com>

if SOC_SERIES_M48X

rsource "/home/ljd/wsMA_prototyp/ZRTOS_demo/zephyr/soc/nuvoton/numicro/m48x/soc/nuvoton/numicro/m48x/Kconfig.defconfig.m487"

endif # SOC_SERIES_M48X
```

## transform_projects/transform_zrtos/ZRTOS_copy/soc/nxp/imx/Kconfig
```kconfig
# Copyright 2024 NXP
# SPDX-License-Identifier: Apache-2.0

config SOC_FAMILY_NXP_IMX
	select HAS_SEGGER_RTT if ZEPHYR_SEGGER_MODULE

if SOC_FAMILY_NXP_IMX

# Source series Kconfig files first, so SOCs
# can override the defaults given here
rsource "/home/ljd/wsMA_prototyp/ZRTOS_demo/zephyr/soc/nxp/imx/soc/nxp/imx/imx6sx/Kconfig"
rsource "/home/ljd/wsMA_prototyp/ZRTOS_demo/zephyr/soc/nxp/imx/soc/nxp/imx/imx7d/Kconfig"
rsource "/home/ljd/wsMA_prototyp/ZRTOS_demo/zephyr/soc/nxp/imx/soc/nxp/imx/imx8/Kconfig"
rsource "/home/ljd/wsMA_prototyp/ZRTOS_demo/zephyr/soc/nxp/imx/soc/nxp/imx/imx8m/Kconfig"
rsource "/home/ljd/wsMA_prototyp/ZRTOS_demo/zephyr/soc/nxp/imx/soc/nxp/imx/imx8ulp/Kconfig"
rsource "/home/ljd/wsMA_prototyp/ZRTOS_demo/zephyr/soc/nxp/imx/soc/nxp/imx/imx8x/Kconfig"

endif # SOC_FAMILY_NXP_IMX
```

## transform_projects/transform_zrtos/ZRTOS_copy/soc/nxp/imx/imx7d/Kconfig.defconfig
```kconfig
# iMX7 core series

# Copyright 2017,2024 NXP
# SPDX-License-Identifier: Apache-2.0

if SOC_SERIES_IMX7D

config NUM_IRQS
	# must be >= the highest interrupt number used
	default 127

rsource "/home/ljd/wsMA_prototyp/ZRTOS_demo/zephyr/soc/nxp/imx/imx7d/soc/nxp/imx/imx7d/Kconfig.defconfig.mcimx7d_m4"

endif # SOC_SERIES_IMX7D
```

## transform_projects/transform_zrtos/ZRTOS_copy/soc/nxp/imx/imx9/Kconfig
```kconfig
# Copyright 2024 NXP
# SPDX-License-Identifier: Apache-2.0

if SOC_SERIES_IMX9
rsource "/home/ljd/wsMA_prototyp/ZRTOS_demo/zephyr/soc/nxp/imx/imx9/soc/nxp/imx/imx9/imx91/Kconfig"
rsource "/home/ljd/wsMA_prototyp/ZRTOS_demo/zephyr/soc/nxp/imx/imx9/soc/nxp/imx/imx9/imx93/Kconfig"
rsource "/home/ljd/wsMA_prototyp/ZRTOS_demo/zephyr/soc/nxp/imx/imx9/soc/nxp/imx/imx9/imx943/Kconfig"
rsource "/home/ljd/wsMA_prototyp/ZRTOS_demo/zephyr/soc/nxp/imx/imx9/soc/nxp/imx/imx9/imx95/Kconfig"
endif
```
