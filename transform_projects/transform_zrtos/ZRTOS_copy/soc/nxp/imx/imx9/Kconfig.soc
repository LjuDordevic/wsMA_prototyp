## transform_projects/transform_zrtos/ZRTOS_copy/soc/nxp/imx/imx9/Kconfig.soc
```kconfig
# Copyright 2024 NXP
# SPDX-License-Identifier: Apache-2.0

config SOC_SERIES_IMX9
	bool
	select SOC_FAMILY_NXP_IMX

config SOC_SERIES
	default "imx9" if SOC_SERIES_IMX9

rsource "/home/ljd/wsMA_prototyp/ZRTOS_demo/zephyr/soc/nxp/imx/imx9/soc/nxp/imx/imx9/imx91/Kconfig.soc"
rsource "/home/ljd/wsMA_prototyp/ZRTOS_demo/zephyr/soc/nxp/imx/imx9/soc/nxp/imx/imx9/imx93/Kconfig.soc"
rsource "/home/ljd/wsMA_prototyp/ZRTOS_demo/zephyr/soc/nxp/imx/imx9/soc/nxp/imx/imx9/imx943/Kconfig.soc"
rsource "/home/ljd/wsMA_prototyp/ZRTOS_demo/zephyr/soc/nxp/imx/imx9/soc/nxp/imx/imx9/imx95/Kconfig.soc"
```

## transform_projects/transform_zrtos/ZRTOS_copy/soc/nxp/imx/imx9/imx91/Kconfig.defconfig
```kconfig
# Copyright 2025 NXP
# SPDX-License-Identifier: Apache-2.0

if SOC_SERIES_IMX9

rsource "/home/ljd/wsMA_prototyp/ZRTOS_demo/zephyr/soc/nxp/imx/imx9/imx91/soc/nxp/imx/imx9/imx91/Kconfig.defconfig.mimx91"

endif # SOC_SERIES_IMX9
```

## transform_projects/transform_zrtos/ZRTOS_copy/soc/nxp/imx/imx9/imx93/Kconfig.defconfig
```kconfig
# Copyright 2022,2024 NXP
# SPDX-License-Identifier: Apache-2.0

if SOC_SERIES_IMX9

rsource "/home/ljd/wsMA_prototyp/ZRTOS_demo/zephyr/soc/nxp/imx/imx9/imx93/soc/nxp/imx/imx9/imx93/Kconfig.defconfig.mimx93.a55"
rsource "/home/ljd/wsMA_prototyp/ZRTOS_demo/zephyr/soc/nxp/imx/imx9/imx93/soc/nxp/imx/imx9/imx93/Kconfig.defconfig.mimx93.m33"

endif # SOC_SERIES_IMX9
```

## transform_projects/transform_zrtos/ZRTOS_copy/soc/nxp/imx/imx9/imx943/Kconfig.defconfig
```kconfig
# Copyright 2025 NXP
# SPDX-License-Identifier: Apache-2.0

if SOC_SERIES_IMX9

rsource "/home/ljd/wsMA_prototyp/ZRTOS_demo/zephyr/soc/nxp/imx/imx9/imx943/soc/nxp/imx/imx9/imx943/Kconfig.defconfig.mimx94398.a55"
rsource "/home/ljd/wsMA_prototyp/ZRTOS_demo/zephyr/soc/nxp/imx/imx9/imx943/soc/nxp/imx/imx9/imx943/Kconfig.defconfig.mimx94398.m33"
rsource "/home/ljd/wsMA_prototyp/ZRTOS_demo/zephyr/soc/nxp/imx/imx9/imx943/soc/nxp/imx/imx9/imx943/Kconfig.defconfig.mimx94398.m7_0"
rsource "/home/ljd/wsMA_prototyp/ZRTOS_demo/zephyr/soc/nxp/imx/imx9/imx943/soc/nxp/imx/imx9/imx943/Kconfig.defconfig.mimx94398.m7_1"

endif # SOC_SERIES_IMX9
```

## transform_projects/transform_zrtos/ZRTOS_copy/soc/nxp/kinetis/Kconfig.defconfig
```kconfig
# Copyright 2024 NXP
# SPDX-License-Identifier: Apache-2.0

if SOC_FAMILY_KINETIS

rsource "/home/ljd/wsMA_prototyp/ZRTOS_demo/zephyr/soc/nxp/kinetis/soc/nxp/kinetis/k2x/Kconfig.defconfig"
rsource "/home/ljd/wsMA_prototyp/ZRTOS_demo/zephyr/soc/nxp/kinetis/soc/nxp/kinetis/k32lx/Kconfig.defconfig"
rsource "/home/ljd/wsMA_prototyp/ZRTOS_demo/zephyr/soc/nxp/kinetis/soc/nxp/kinetis/k6x/Kconfig.defconfig"
rsource "/home/ljd/wsMA_prototyp/ZRTOS_demo/zephyr/soc/nxp/kinetis/soc/nxp/kinetis/k8x/Kconfig.defconfig"
rsource "/home/ljd/wsMA_prototyp/ZRTOS_demo/zephyr/soc/nxp/kinetis/soc/nxp/kinetis/ke1xf/Kconfig.defconfig"
rsource "/home/ljd/wsMA_prototyp/ZRTOS_demo/zephyr/soc/nxp/kinetis/soc/nxp/kinetis/ke1xz/Kconfig.defconfig"
rsource "/home/ljd/wsMA_prototyp/ZRTOS_demo/zephyr/soc/nxp/kinetis/soc/nxp/kinetis/kl2x/Kconfig.defconfig"
rsource "/home/ljd/wsMA_prototyp/ZRTOS_demo/zephyr/soc/nxp/kinetis/soc/nxp/kinetis/kv5x/Kconfig.defconfig"
rsource "/home/ljd/wsMA_prototyp/ZRTOS_demo/zephyr/soc/nxp/kinetis/soc/nxp/kinetis/kwx/Kconfig.defconfig"

config WDT_DISABLE_AT_BOOT
	default y

endif # SOC_FAMILY_KINETIS
```

## transform_projects/transform_zrtos/ZRTOS_copy/soc/nxp/lpc/Kconfig
```kconfig
# Copyright 2017,2024 NXP
# SPDX-License-Identifier: Apache-2.0

config SOC_FAMILY_LPC
	select HAS_SEGGER_RTT if ZEPHYR_SEGGER_MODULE
	select CLOCK_CONTROL
	select ARM

if SOC_FAMILY_LPC
rsource "/home/ljd/wsMA_prototyp/ZRTOS_demo/zephyr/soc/nxp/lpc/soc/nxp/lpc/lpc11u6x/Kconfig"
rsource "/home/ljd/wsMA_prototyp/ZRTOS_demo/zephyr/soc/nxp/lpc/soc/nxp/lpc/lpc51u68/Kconfig"
rsource "/home/ljd/wsMA_prototyp/ZRTOS_demo/zephyr/soc/nxp/lpc/soc/nxp/lpc/lpc54xxx/Kconfig"
rsource "/home/ljd/wsMA_prototyp/ZRTOS_demo/zephyr/soc/nxp/lpc/soc/nxp/lpc/lpc55xxx/Kconfig"

endif # SOC_FAMILY_LPC
```

## transform_projects/transform_zrtos/ZRTOS_copy/soc/nxp/lpc/Kconfig.soc
```kconfig
# Copyright 2017,2024 NXP
# SPDX-License-Identifier: Apache-2.0

config SOC_FAMILY_LPC
	bool

config SOC_FAMILY
	default "lpc" if SOC_FAMILY_LPC

rsource "/home/ljd/wsMA_prototyp/ZRTOS_demo/zephyr/soc/nxp/lpc/soc/nxp/lpc/lpc11u6x/Kconfig.soc"
rsource "/home/ljd/wsMA_prototyp/ZRTOS_demo/zephyr/soc/nxp/lpc/soc/nxp/lpc/lpc51u68/Kconfig.soc"
rsource "/home/ljd/wsMA_prototyp/ZRTOS_demo/zephyr/soc/nxp/lpc/soc/nxp/lpc/lpc54xxx/Kconfig.soc"
rsource "/home/ljd/wsMA_prototyp/ZRTOS_demo/zephyr/soc/nxp/lpc/soc/nxp/lpc/lpc55xxx/Kconfig.soc"
```

## transform_projects/transform_zrtos/ZRTOS_copy/soc/nxp/mcx/Kconfig.soc
```kconfig
# Copyright 2024-2025 NXP
# SPDX-License-Identifier: Apache-2.0

rsource "/home/ljd/wsMA_prototyp/ZRTOS_demo/zephyr/soc/nxp/mcx/soc/nxp/mcx/mcxa/Kconfig.soc"
rsource "/home/ljd/wsMA_prototyp/ZRTOS_demo/zephyr/soc/nxp/mcx/soc/nxp/mcx/mcxc/Kconfig.soc"
rsource "/home/ljd/wsMA_prototyp/ZRTOS_demo/zephyr/soc/nxp/mcx/soc/nxp/mcx/mcxe/Kconfig.soc"
rsource "/home/ljd/wsMA_prototyp/ZRTOS_demo/zephyr/soc/nxp/mcx/soc/nxp/mcx/mcxn/Kconfig.soc"
rsource "/home/ljd/wsMA_prototyp/ZRTOS_demo/zephyr/soc/nxp/mcx/soc/nxp/mcx/mcxw/Kconfig.soc"
```

## transform_projects/transform_zrtos/ZRTOS_copy/soc/nxp/mcx/mcxe/Kconfig.defconfig
```kconfig
# Copyright 2025 NXP
# SPDX-License-Identifier: Apache-2.0

if SOC_FAMILY_MCXE

rsource "/home/ljd/wsMA_prototyp/ZRTOS_demo/zephyr/soc/nxp/mcx/mcxe/soc/nxp/mcx/mcxe/mcxe24x/Kconfig.defconfig"
rsource "/home/ljd/wsMA_prototyp/ZRTOS_demo/zephyr/soc/nxp/mcx/mcxe/soc/nxp/mcx/mcxe/mcxe31x/Kconfig.defconfig"

endif # SOC_FAMILY_MCXE
```

## transform_projects/transform_zrtos/ZRTOS_copy/soc/nxp/mcx/mcxw/Kconfig.defconfig
```kconfig
# Copyright 2023-2025 NXP
# SPDX-License-Identifier: Apache-2.0

rsource "/home/ljd/wsMA_prototyp/ZRTOS_demo/zephyr/soc/nxp/mcx/mcxw/soc/nxp/mcx/mcxw/mcxw2xx/Kconfig.defconfig"
rsource "/home/ljd/wsMA_prototyp/ZRTOS_demo/zephyr/soc/nxp/mcx/mcxw/soc/nxp/mcx/mcxw/mcxw7xx/Kconfig.defconfig"

if SOC_FAMILY_MCXW

config CORTEX_M_SYSTICK
	default n if MCUX_LPTMR_TIMER

endif # SOC_FAMILY_MCXW
```

## transform_projects/transform_zrtos/ZRTOS_copy/soc/nxp/s32/Kconfig
```kconfig
# Copyright 2022-2024 NXP
# SPDX-License-Identifier: Apache-2.0

if SOC_FAMILY_NXP_S32

rsource "/home/ljd/wsMA_prototyp/ZRTOS_demo/zephyr/soc/nxp/s32/soc/nxp/s32/s32k1/Kconfig"
rsource "/home/ljd/wsMA_prototyp/ZRTOS_demo/zephyr/soc/nxp/s32/soc/nxp/s32/s32k3/Kconfig"
rsource "/home/ljd/wsMA_prototyp/ZRTOS_demo/zephyr/soc/nxp/s32/soc/nxp/s32/s32ze/Kconfig"

endif # SOC_FAMILY_NXP_S32
```

## transform_projects/transform_zrtos/ZRTOS_copy/soc/nxp/s32/Kconfig.defconfig
```kconfig
# Copyright 2022,2024 NXP
# SPDX-License-Identifier: Apache-2.0

if SOC_FAMILY_NXP_S32

rsource "/home/ljd/wsMA_prototyp/ZRTOS_demo/zephyr/soc/nxp/s32/soc/nxp/s32/s32k1/Kconfig.defconfig"
rsource "/home/ljd/wsMA_prototyp/ZRTOS_demo/zephyr/soc/nxp/s32/soc/nxp/s32/s32k3/Kconfig.defconfig"
rsource "/home/ljd/wsMA_prototyp/ZRTOS_demo/zephyr/soc/nxp/s32/soc/nxp/s32/s32ze/Kconfig.defconfig"

endif # SOC_FAMILY_NXP_S32
```

## transform_projects/transform_zrtos/ZRTOS_copy/soc/nxp/s32/Kconfig.soc
```kconfig
# Copyright 2022,2024 NXP
# SPDX-License-Identifier: Apache-2.0

config SOC_FAMILY_NXP_S32
	bool

config SOC_FAMILY
	default "nxp_s32" if SOC_FAMILY_NXP_S32

rsource "/home/ljd/wsMA_prototyp/ZRTOS_demo/zephyr/soc/nxp/s32/soc/nxp/s32/s32k1/Kconfig.soc"
rsource "/home/ljd/wsMA_prototyp/ZRTOS_demo/zephyr/soc/nxp/s32/soc/nxp/s32/s32k3/Kconfig.soc"
rsource "/home/ljd/wsMA_prototyp/ZRTOS_demo/zephyr/soc/nxp/s32/soc/nxp/s32/s32ze/Kconfig.soc"
```

## transform_projects/transform_zrtos/ZRTOS_copy/soc/openhwgroup/cva6/Kconfig
```kconfig
# Copyright (c) 2024 CISPA Helmholtz Center for Information Security gGmbH
# SPDX-License-Identifier: Apache-2.0

if SOC_FAMILY_OPENHWGROUP_CVA6

rsource "/home/ljd/wsMA_prototyp/ZRTOS_demo/zephyr/soc/openhwgroup/cva6/soc/openhwgroup/cva6/cv32a6/Kconfig"
rsource "/home/ljd/wsMA_prototyp/ZRTOS_demo/zephyr/soc/openhwgroup/cva6/soc/openhwgroup/cva6/cv64a6/Kconfig"

endif # SOC_FAMILY_OPENHWGROUP_CVA6
```

## transform_projects/transform_zrtos/ZRTOS_copy/soc/qemu/virt_riscv/Kconfig.soc
```kconfig
# Copyright (c) 2024 Antmicro <www.antmicro.com>
# SPDX-License-Identifier: Apache-2.0

config SOC_FAMILY_QEMU_VIRT_RISCV
	bool

config SOC_FAMILY
	default "qemu_virt_riscv" if SOC_FAMILY_QEMU_VIRT_RISCV

rsource "/home/ljd/wsMA_prototyp/ZRTOS_demo/zephyr/soc/qemu/virt_riscv/soc/qemu/virt_riscv/qemu_virt_riscv32/Kconfig.soc"
rsource "/home/ljd/wsMA_prototyp/ZRTOS_demo/zephyr/soc/qemu/virt_riscv/soc/qemu/virt_riscv/qemu_virt_riscv32e/Kconfig.soc"
rsource "/home/ljd/wsMA_prototyp/ZRTOS_demo/zephyr/soc/qemu/virt_riscv/soc/qemu/virt_riscv/qemu_virt_riscv64/Kconfig.soc"
```

## transform_projects/transform_zrtos/ZRTOS_copy/soc/realtek/ec/rts5912/Kconfig.defconfig.series
```kconfig
# SPDX-License-Identifier: Apache-2.0
#
# Copyright (c) 2024 Realtek Semiconductor Corporation, SIBG-SD7
#

if SOC_SERIES_RTS5912

config NUM_IRQS
	default 240

rsource "/home/ljd/wsMA_prototyp/ZRTOS_demo/zephyr/soc/realtek/ec/rts5912/soc/realtek/ec/rts5912/Kconfig.defconfig.rts5912"

endif # SOC_SERIES_RTS5912
```

## transform_projects/transform_zrtos/ZRTOS_copy/soc/renesas/rcar/Kconfig
```kconfig
# Renesas R-Car SoC line
# Copyright (c) 2021 IoT.bzh
# SPDX-License-Identifier: Apache-2.0

if SOC_FAMILY_RENESAS_RCAR

rsource "/home/ljd/wsMA_prototyp/ZRTOS_demo/zephyr/soc/renesas/rcar/soc/renesas/rcar/rcar_gen3/Kconfig"
rsource "/home/ljd/wsMA_prototyp/ZRTOS_demo/zephyr/soc/renesas/rcar/soc/renesas/rcar/rcar_gen4/Kconfig"

endif # SOC_FAMILY_RENESAS_RCAR
```

## transform_projects/transform_zrtos/ZRTOS_copy/soc/renesas/rcar/Kconfig.defconfig
```kconfig
# Copyright (c) 2021 IoT.bzh
# SPDX-License-Identifier: Apache-2.0

if SOC_FAMILY_RENESAS_RCAR

rsource "/home/ljd/wsMA_prototyp/ZRTOS_demo/zephyr/soc/renesas/rcar/soc/renesas/rcar/rcar_gen3/Kconfig.defconfig"

endif # SOC_FAMILY_RENESAS_RCAR
```

## transform_projects/transform_zrtos/ZRTOS_copy/soc/renesas/rcar/Kconfig.soc
```kconfig
# Renesas R-Car SoC line
# Copyright (c) 2021 IoT.bzh
# SPDX-License-Identifier: Apache-2.0

config SOC_FAMILY_RENESAS_RCAR
	bool

config SOC_FAMILY
	default "renesas_rcar" if SOC_FAMILY_RENESAS_RCAR

rsource "/home/ljd/wsMA_prototyp/ZRTOS_demo/zephyr/soc/renesas/rcar/soc/renesas/rcar/rcar_gen3/Kconfig.soc"
rsource "/home/ljd/wsMA_prototyp/ZRTOS_demo/zephyr/soc/renesas/rcar/soc/renesas/rcar/rcar_gen4/Kconfig.soc"
```

## transform_projects/transform_zrtos/ZRTOS_copy/soc/renesas/rcar/rcar_gen4/Kconfig.defconfig
```kconfig
# Renesas R-Car Gen4 SoC line

# Copyright (c) 2023 IoT.bzh
# SPDX-License-Identifier: Apache-2.0

if SOC_SERIES_RCAR_GEN4

rsource "/home/ljd/wsMA_prototyp/ZRTOS_demo/zephyr/soc/renesas/rcar/rcar_gen4/soc/renesas/rcar/rcar_gen4/Kconfig.defconfig.r8a779f0"

endif # SOC_SERIES_RCAR_GEN4
```

## transform_projects/transform_zrtos/ZRTOS_copy/soc/renesas/rz/rzv2h/Kconfig.defconfig
```kconfig
# Copyright (c) 2025 Renesas Electronics Corporation
# SPDX-License-Identifier: Apache-2.0

if SOC_SERIES_RZV2H

rsource "/home/ljd/wsMA_prototyp/ZRTOS_demo/zephyr/soc/renesas/rz/rzv2h/soc/renesas/rz/rzv2h/Kconfig.defconfig.rzv2h_cm33"
rsource "/home/ljd/wsMA_prototyp/ZRTOS_demo/zephyr/soc/renesas/rz/rzv2h/soc/renesas/rz/rzv2h/Kconfig.defconfig.rzv2h_cr8"

endif # SOC_SERIES_RZV2H
```

## transform_projects/transform_zrtos/ZRTOS_copy/soc/renesas/smartbond/Kconfig.soc
```kconfig
# Copyright (c) 2022 Renesas Electronics Corporation
# SPDX-License-Identifier: Apache-2.0

config SOC_FAMILY_RENESAS_SMARTBOND
	bool

config SOC_FAMILY
	default "renesas_smartbond" if SOC_FAMILY_RENESAS_SMARTBOND

rsource "/home/ljd/wsMA_prototyp/ZRTOS_demo/zephyr/soc/renesas/smartbond/soc/renesas/smartbond/da1469x/Kconfig.soc"
```

## transform_projects/transform_zrtos/ZRTOS_copy/soc/rockchip/Kconfig
```kconfig
#
# Copyright 2021 Huawei France Technologies SASU
#
# SPDX-License-Identifier: Apache-2.0
#

if SOC_FAMILY_ROCKCHIP

rsource "/home/ljd/wsMA_prototyp/ZRTOS_demo/zephyr/soc/rockchip/soc/rockchip/rk3399/Kconfig"

endif # SOC_FAMILY_ROCKCHIP
```

## transform_projects/transform_zrtos/ZRTOS_copy/soc/rockchip/rk35/Kconfig
```kconfig
#
# Copyright 2021 Huawei France Technologies SASU
#
# SPDX-License-Identifier: Apache-2.0
#

if SOC_FAMILY_ROCKCHIP

rsource "/home/ljd/wsMA_prototyp/ZRTOS_demo/zephyr/soc/rockchip/rk35/soc/rockchip/rk35/rk3568/Kconfig"
rsource "/home/ljd/wsMA_prototyp/ZRTOS_demo/zephyr/soc/rockchip/rk35/soc/rockchip/rk35/rk3588/Kconfig"
rsource "/home/ljd/wsMA_prototyp/ZRTOS_demo/zephyr/soc/rockchip/rk35/soc/rockchip/rk35/rk3588s/Kconfig"

endif # SOC_FAMILY_ROCKCHIP
```

## transform_projects/transform_zrtos/ZRTOS_copy/soc/rockchip/rk35/rk3568/Kconfig.defconfig
```kconfig
# Copyright 2022 HNU-ESNL
# Copyright 2022 openEuler SIG-Zephyr
# SPDX-License-Identifier: Apache-2.0

if SOC_RK3568

rsource "/home/ljd/wsMA_prototyp/ZRTOS_demo/zephyr/soc/rockchip/rk35/rk3568/soc/rockchip/rk35/rk3568/Kconfig.defconfig.rk3568"

endif # SOC_SERIES_RK3568
```
