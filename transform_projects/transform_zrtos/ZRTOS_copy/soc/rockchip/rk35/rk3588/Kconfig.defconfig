## transform_projects/transform_zrtos/ZRTOS_copy/soc/rockchip/rk35/rk3588/Kconfig.defconfig
```kconfig
# Copyright (c) 2025 Syswonder
# SPDX-License-Identifier: Apache-2.0

if SOC_RK3588

rsource "/home/ljd/wsMA_prototyp/ZRTOS_demo/zephyr/soc/rockchip/rk35/rk3588/soc/rockchip/rk35/rk3588/Kconfig.defconfig.rk3588"

endif # SOC_SERIES_RK3588
```

## transform_projects/transform_zrtos/ZRTOS_copy/soc/sensry/Kconfig
```kconfig
# SPDX-License-Identifier: Apache-2.0
# Copyright (c) 2024 sensry.io

if SOC_FAMILY_GANYMED

rsource "/home/ljd/wsMA_prototyp/ZRTOS_demo/zephyr/soc/sensry/soc/sensry/ganymed/Kconfig"

endif # SOC_FAMILY_GANYMED
```

## transform_projects/transform_zrtos/ZRTOS_copy/soc/sensry/ganymed/Kconfig
```kconfig
# SPDX-License-Identifier: Apache-2.0
# Copyright (c) 2024 sensry.io

config SOC_FAMILY_GANYMED
	select BUILD_OUTPUT_BIN

if SOC_SERIES_SY1XX

rsource "/home/ljd/wsMA_prototyp/ZRTOS_demo/zephyr/soc/sensry/ganymed/soc/sensry/ganymed/sy1xx/Kconfig"

endif # SOC_SERIES_SY1XX
```

## transform_projects/transform_zrtos/ZRTOS_copy/soc/sensry/ganymed/Kconfig.defconfig
```kconfig
# SPDX-License-Identifier: Apache-2.0
# Copyright (c) 2024 sensry.io

if SOC_SERIES_SY1XX

rsource "/home/ljd/wsMA_prototyp/ZRTOS_demo/zephyr/soc/sensry/ganymed/soc/sensry/ganymed/sy1xx/Kconfig.defconfig"

endif
```

## transform_projects/transform_zrtos/ZRTOS_copy/soc/sifive/sifive_freedom/Kconfig.soc
```kconfig
# Copyright (c) 2024 Nordic Semiconductor ASA
# Copyright (c) 2024 Antmicro <www.antmicro.com>
# SPDX-License-Identifier: Apache-2.0

config SOC_FAMILY_SIFIVE_FREEDOM
	bool

config SOC_FAMILY
	default "sifive_freedom" if SOC_FAMILY_SIFIVE_FREEDOM

rsource "/home/ljd/wsMA_prototyp/ZRTOS_demo/zephyr/soc/sifive/sifive_freedom/soc/sifive/sifive_freedom/fe300/Kconfig.soc"
rsource "/home/ljd/wsMA_prototyp/ZRTOS_demo/zephyr/soc/sifive/sifive_freedom/soc/sifive/sifive_freedom/fu500/Kconfig.soc"
rsource "/home/ljd/wsMA_prototyp/ZRTOS_demo/zephyr/soc/sifive/sifive_freedom/soc/sifive/sifive_freedom/fu700/Kconfig.soc"
```

## transform_projects/transform_zrtos/ZRTOS_copy/soc/sifli/sf32/Kconfig
```kconfig
# Copyright (c) 2025 Core Devices LLC
# SPDX-License-Identifier: Apache-2.0

config SOC_FAMILY_SF32
	select HAS_SIFLI_HAL

if SOC_FAMILY_SF32

rsource "/home/ljd/wsMA_prototyp/ZRTOS_demo/zephyr/soc/sifli/sf32/soc/sifli/sf32/sf32lb52x/Kconfig"

endif # SOC_FAMILY_SF32
```

## transform_projects/transform_zrtos/ZRTOS_copy/soc/sifli/sf32/Kconfig.soc
```kconfig
# Copyright (c) 2025 Core Devices LLC
# SPDX-License-Identifier: Apache-2.0

config SOC_FAMILY_SF32
	bool

config SOC_FAMILY
	default "sf32" if SOC_FAMILY_SF32

rsource "/home/ljd/wsMA_prototyp/ZRTOS_demo/zephyr/soc/sifli/sf32/soc/sifli/sf32/sf32lb52x/Kconfig.soc"
```

## transform_projects/transform_zrtos/ZRTOS_copy/soc/silabs/Kconfig.defconfig
```kconfig
# SPDX-License-Identifier: Apache-2.0
# Copyright (c) 2017 Christian Taedcke

rsource "/home/ljd/wsMA_prototyp/ZRTOS_demo/zephyr/soc/silabs/soc/silabs/silabs_s2/Kconfig.defconfig"
rsource "/home/ljd/wsMA_prototyp/ZRTOS_demo/zephyr/soc/silabs/soc/silabs/silabs_siwx91x/Kconfig.defconfig"

if SOC_FAMILY_SILABS_S0 || SOC_FAMILY_SILABS_S1

config SOC_GECKO_EMU
	default y
	select SOC_GECKO_CORE
	depends on PM

config CORTEX_M_SYSTICK
	default n if GECKO_BURTC_TIMER

endif
```

## transform_projects/transform_zrtos/ZRTOS_copy/soc/silabs/silabs_s0/Kconfig.defconfig
```kconfig
# Copyright (c) 2024 Silicon Laboratories Inc.
# SPDX-License-Identifier: Apache-2.0

rsource "/home/ljd/wsMA_prototyp/ZRTOS_demo/zephyr/soc/silabs/silabs_s0/soc/silabs/silabs_s0/efm32hg/Kconfig.defconfig"
rsource "/home/ljd/wsMA_prototyp/ZRTOS_demo/zephyr/soc/silabs/silabs_s0/soc/silabs/silabs_s0/efm32tg/Kconfig.defconfig"
rsource "/home/ljd/wsMA_prototyp/ZRTOS_demo/zephyr/soc/silabs/silabs_s0/soc/silabs/silabs_s0/efm32wg/Kconfig.defconfig"
```

## transform_projects/transform_zrtos/ZRTOS_copy/soc/silabs/silabs_s0/Kconfig.soc
```kconfig
# Copyright (c) 2017 Christian Taedcke
# SPDX-License-Identifier: Apache-2.0

config SOC_FAMILY_SILABS_S0
	bool

rsource "/home/ljd/wsMA_prototyp/ZRTOS_demo/zephyr/soc/silabs/silabs_s0/soc/silabs/silabs_s0/efm32hg/Kconfig.soc"
rsource "/home/ljd/wsMA_prototyp/ZRTOS_demo/zephyr/soc/silabs/silabs_s0/soc/silabs/silabs_s0/efm32tg/Kconfig.soc"
rsource "/home/ljd/wsMA_prototyp/ZRTOS_demo/zephyr/soc/silabs/silabs_s0/soc/silabs/silabs_s0/efm32wg/Kconfig.soc"
```

## transform_projects/transform_zrtos/ZRTOS_copy/soc/silabs/silabs_s1/Kconfig.soc
```kconfig
# Copyright (c) 2017 Christian Taedcke
# SPDX-License-Identifier: Apache-2.0

config SOC_FAMILY_SILABS_S1
	bool

rsource "/home/ljd/wsMA_prototyp/ZRTOS_demo/zephyr/soc/silabs/silabs_s1/soc/silabs/silabs_s1/efm32gg11b/Kconfig.soc"
rsource "/home/ljd/wsMA_prototyp/ZRTOS_demo/zephyr/soc/silabs/silabs_s1/soc/silabs/silabs_s1/efm32gg12b/Kconfig.soc"
rsource "/home/ljd/wsMA_prototyp/ZRTOS_demo/zephyr/soc/silabs/silabs_s1/soc/silabs/silabs_s1/efm32jg12b/Kconfig.soc"
rsource "/home/ljd/wsMA_prototyp/ZRTOS_demo/zephyr/soc/silabs/silabs_s1/soc/silabs/silabs_s1/efm32pg12b/Kconfig.soc"
rsource "/home/ljd/wsMA_prototyp/ZRTOS_demo/zephyr/soc/silabs/silabs_s1/soc/silabs/silabs_s1/efm32pg1b/Kconfig.soc"
rsource "/home/ljd/wsMA_prototyp/ZRTOS_demo/zephyr/soc/silabs/silabs_s1/soc/silabs/silabs_s1/efr32bg13p/Kconfig.soc"
rsource "/home/ljd/wsMA_prototyp/ZRTOS_demo/zephyr/soc/silabs/silabs_s1/soc/silabs/silabs_s1/efr32fg13p/Kconfig.soc"
rsource "/home/ljd/wsMA_prototyp/ZRTOS_demo/zephyr/soc/silabs/silabs_s1/soc/silabs/silabs_s1/efr32fg1p/Kconfig.soc"
rsource "/home/ljd/wsMA_prototyp/ZRTOS_demo/zephyr/soc/silabs/silabs_s1/soc/silabs/silabs_s1/efr32mg12p/Kconfig.soc"
```

## transform_projects/transform_zrtos/ZRTOS_copy/soc/snps/nsim/arc_classic/em/Kconfig.defconfig
```kconfig
# Copyright (c) 2024 Synopsys, Inc.
# SPDX-License-Identifier: Apache-2.0

if SOC_SERIES_NSIM_EM

rsource "/home/ljd/wsMA_prototyp/ZRTOS_demo/zephyr/soc/snps/nsim/arc_classic/em/soc/snps/nsim/arc_classic/em/Kconfig.defconfig.em"
rsource "/home/ljd/wsMA_prototyp/ZRTOS_demo/zephyr/soc/snps/nsim/arc_classic/em/soc/snps/nsim/arc_classic/em/Kconfig.defconfig.em11d"
rsource "/home/ljd/wsMA_prototyp/ZRTOS_demo/zephyr/soc/snps/nsim/arc_classic/em/soc/snps/nsim/arc_classic/em/Kconfig.defconfig.em7d_v22"

endif # SOC_SERIES_NSIM_EM
```

## transform_projects/transform_zrtos/ZRTOS_copy/soc/snps/nsim/arc_v/Kconfig.defconfig
```kconfig
# Copyright (c) 2024 Synopsys, Inc.
# SPDX-License-Identifier: Apache-2.0

if SOC_FAMILY_NSIM_ARC_V

rsource "/home/ljd/wsMA_prototyp/ZRTOS_demo/zephyr/soc/snps/nsim/arc_v/soc/snps/nsim/arc_v/rhx/Kconfig.defconfig"
rsource "/home/ljd/wsMA_prototyp/ZRTOS_demo/zephyr/soc/snps/nsim/arc_v/soc/snps/nsim/arc_v/rmx/Kconfig.defconfig"

endif # SOC_FAMILY_NSIM_ARC_V
```

## transform_projects/transform_zrtos/ZRTOS_copy/soc/snps/nsim/arc_v/Kconfig.soc
```kconfig
# Copyright (c) 2024 Synopsys, Inc.
# SPDX-License-Identifier: Apache-2.0

config SOC_FAMILY_NSIM_ARC_V
	bool

config SOC_FAMILY
	default "nsim_arc_v" if SOC_FAMILY_NSIM_ARC_V

rsource "/home/ljd/wsMA_prototyp/ZRTOS_demo/zephyr/soc/snps/nsim/arc_v/soc/snps/nsim/arc_v/rhx/Kconfig.soc"
rsource "/home/ljd/wsMA_prototyp/ZRTOS_demo/zephyr/soc/snps/nsim/arc_v/soc/snps/nsim/arc_v/rmx/Kconfig.soc"
```

## transform_projects/transform_zrtos/ZRTOS_copy/soc/st/stm32/stm32f0x/Kconfig.defconfig
```kconfig
# ST Microelectronics STM32F0 MCU line

# Copyright (c) 2017 RnDity Sp. z o.o.
# SPDX-License-Identifier: Apache-2.0

# Kconfig symbols common to STM32F0 series

if SOC_SERIES_STM32F0X

rsource "/home/ljd/wsMA_prototyp/ZRTOS_demo/zephyr/soc/st/stm32/stm32f0x/soc/st/stm32/stm32f0x/Kconfig.defconfig.stm32f030x4"
rsource "/home/ljd/wsMA_prototyp/ZRTOS_demo/zephyr/soc/st/stm32/stm32f0x/soc/st/stm32/stm32f0x/Kconfig.defconfig.stm32f030x6"
rsource "/home/ljd/wsMA_prototyp/ZRTOS_demo/zephyr/soc/st/stm32/stm32f0x/soc/st/stm32/stm32f0x/Kconfig.defconfig.stm32f030x8"
rsource "/home/ljd/wsMA_prototyp/ZRTOS_demo/zephyr/soc/st/stm32/stm32f0x/soc/st/stm32/stm32f0x/Kconfig.defconfig.stm32f030xc"
rsource "/home/ljd/wsMA_prototyp/ZRTOS_demo/zephyr/soc/st/stm32/stm32f0x/soc/st/stm32/stm32f0x/Kconfig.defconfig.stm32f031x6"
rsource "/home/ljd/wsMA_prototyp/ZRTOS_demo/zephyr/soc/st/stm32/stm32f0x/soc/st/stm32/stm32f0x/Kconfig.defconfig.stm32f042x6"
rsource "/home/ljd/wsMA_prototyp/ZRTOS_demo/zephyr/soc/st/stm32/stm32f0x/soc/st/stm32/stm32f0x/Kconfig.defconfig.stm32f051x8"
rsource "/home/ljd/wsMA_prototyp/ZRTOS_demo/zephyr/soc/st/stm32/stm32f0x/soc/st/stm32/stm32f0x/Kconfig.defconfig.stm32f070xb"
rsource "/home/ljd/wsMA_prototyp/ZRTOS_demo/zephyr/soc/st/stm32/stm32f0x/soc/st/stm32/stm32f0x/Kconfig.defconfig.stm32f072xx"
rsource "/home/ljd/wsMA_prototyp/ZRTOS_demo/zephyr/soc/st/stm32/stm32f0x/soc/st/stm32/stm32f0x/Kconfig.defconfig.stm32f091xc"
rsource "/home/ljd/wsMA_prototyp/ZRTOS_demo/zephyr/soc/st/stm32/stm32f0x/soc/st/stm32/stm32f0x/Kconfig.defconfig.stm32f098xx"

config SRAM_VECTOR_TABLE
	default y

# adjust the fallback because of the LSI oscillator characteristics
config TASK_WDT_HW_FALLBACK_DELAY
	depends on TASK_WDT_HW_FALLBACK
	default 100

endif # SOC_SERIES_STM32F0X
```

## transform_projects/transform_zrtos/ZRTOS_copy/soc/st/stm32/stm32f2x/Kconfig.defconfig
```kconfig
# STMicroelectronics STM32F2 MCU line

# Copyright (c) 2018 qianfan Zhao <qianfanguijin@163.com>
# SPDX-License-Identifier: Apache-2.0

# Kconfig symbols common to STM32F2 series

if SOC_SERIES_STM32F2X

rsource "/home/ljd/wsMA_prototyp/ZRTOS_demo/zephyr/soc/st/stm32/stm32f2x/soc/st/stm32/stm32f2x/Kconfig.defconfig.stm32f205xx"
rsource "/home/ljd/wsMA_prototyp/ZRTOS_demo/zephyr/soc/st/stm32/stm32f2x/soc/st/stm32/stm32f2x/Kconfig.defconfig.stm32f207xx"

endif # SOC_SERIES_STM32F2X
```

## transform_projects/transform_zrtos/ZRTOS_copy/soc/st/stm32/stm32f3x/Kconfig.defconfig
```kconfig
# STMicroelectronics STM32F3 MCU line

# Copyright (c) 2016 RnDity Sp. z o.o.
# SPDX-License-Identifier: Apache-2.0

# Kconfig symbols common to STM32F3 series

if SOC_SERIES_STM32F3X

rsource "/home/ljd/wsMA_prototyp/ZRTOS_demo/zephyr/soc/st/stm32/stm32f3x/soc/st/stm32/stm32f3x/Kconfig.defconfig.stm32f302x8"
rsource "/home/ljd/wsMA_prototyp/ZRTOS_demo/zephyr/soc/st/stm32/stm32f3x/soc/st/stm32/stm32f3x/Kconfig.defconfig.stm32f302xc"
rsource "/home/ljd/wsMA_prototyp/ZRTOS_demo/zephyr/soc/st/stm32/stm32f3x/soc/st/stm32/stm32f3x/Kconfig.defconfig.stm32f303x(b-c)"
rsource "/home/ljd/wsMA_prototyp/ZRTOS_demo/zephyr/soc/st/stm32/stm32f3x/soc/st/stm32/stm32f3x/Kconfig.defconfig.stm32f303x8"
rsource "/home/ljd/wsMA_prototyp/ZRTOS_demo/zephyr/soc/st/stm32/stm32f3x/soc/st/stm32/stm32f3x/Kconfig.defconfig.stm32f303xe"
rsource "/home/ljd/wsMA_prototyp/ZRTOS_demo/zephyr/soc/st/stm32/stm32f3x/soc/st/stm32/stm32f3x/Kconfig.defconfig.stm32f334x8"
rsource "/home/ljd/wsMA_prototyp/ZRTOS_demo/zephyr/soc/st/stm32/stm32f3x/soc/st/stm32/stm32f3x/Kconfig.defconfig.stm32f373xc"

endif # SOC_SERIES_STM32F3X
```

## transform_projects/transform_zrtos/ZRTOS_copy/soc/st/stm32/stm32h7rsx/Kconfig.defconfig
```kconfig
# ST Microelectronics STM32H7RS MCU line

# Copyright (c) 2024 STMicroelectronics
# SPDX-License-Identifier: Apache-2.0

# Kconfig symbols common to STM32H7RS series

if SOC_SERIES_STM32H7RSX

rsource "/home/ljd/wsMA_prototyp/ZRTOS_demo/zephyr/soc/st/stm32/stm32h7rsx/soc/st/stm32/stm32h7rsx/Kconfig.defconfig.stm32h7r3xx"
rsource "/home/ljd/wsMA_prototyp/ZRTOS_demo/zephyr/soc/st/stm32/stm32h7rsx/soc/st/stm32/stm32h7rsx/Kconfig.defconfig.stm32h7r7xx"
rsource "/home/ljd/wsMA_prototyp/ZRTOS_demo/zephyr/soc/st/stm32/stm32h7rsx/soc/st/stm32/stm32h7rsx/Kconfig.defconfig.stm32h7s3xx"
rsource "/home/ljd/wsMA_prototyp/ZRTOS_demo/zephyr/soc/st/stm32/stm32h7rsx/soc/st/stm32/stm32h7rsx/Kconfig.defconfig.stm32h7s7xx"

config ROM_START_OFFSET
	default 0x400 if BOOTLOADER_MCUBOOT
	default 0x0   if !BOOTLOADER_MCUBOOT

endif # SOC_SERIES_STM32H7RSX
```

## transform_projects/transform_zrtos/ZRTOS_copy/soc/st/stm32/stm32l0x/Kconfig.defconfig
```kconfig
# ST Microelectronics STM32L0 MCU line

# Copyright (c) 2018 Endre Karlson <endre.karlson@gmail.com>
# SPDX-License-Identifier: Apache-2.0

# Kconfig symbols common to STM32L0 series

if SOC_SERIES_STM32L0X

rsource "/home/ljd/wsMA_prototyp/ZRTOS_demo/zephyr/soc/st/stm32/stm32l0x/soc/st/stm32/stm32l0x/Kconfig.defconfig.stm32l010x4"
rsource "/home/ljd/wsMA_prototyp/ZRTOS_demo/zephyr/soc/st/stm32/stm32l0x/soc/st/stm32/stm32l0x/Kconfig.defconfig.stm32l010x6"
rsource "/home/ljd/wsMA_prototyp/ZRTOS_demo/zephyr/soc/st/stm32/stm32l0x/soc/st/stm32/stm32l0x/Kconfig.defconfig.stm32l010x8"
rsource "/home/ljd/wsMA_prototyp/ZRTOS_demo/zephyr/soc/st/stm32/stm32l0x/soc/st/stm32/stm32l0x/Kconfig.defconfig.stm32l010xb"
rsource "/home/ljd/wsMA_prototyp/ZRTOS_demo/zephyr/soc/st/stm32/stm32l0x/soc/st/stm32/stm32l0x/Kconfig.defconfig.stm32l011xx"
rsource "/home/ljd/wsMA_prototyp/ZRTOS_demo/zephyr/soc/st/stm32/stm32l0x/soc/st/stm32/stm32l0x/Kconfig.defconfig.stm32l031xx"
rsource "/home/ljd/wsMA_prototyp/ZRTOS_demo/zephyr/soc/st/stm32/stm32l0x/soc/st/stm32/stm32l0x/Kconfig.defconfig.stm32l051xx"
rsource "/home/ljd/wsMA_prototyp/ZRTOS_demo/zephyr/soc/st/stm32/stm32l0x/soc/st/stm32/stm32l0x/Kconfig.defconfig.stm32l053xx"
rsource "/home/ljd/wsMA_prototyp/ZRTOS_demo/zephyr/soc/st/stm32/stm32l0x/soc/st/stm32/stm32l0x/Kconfig.defconfig.stm32l071xx"
rsource "/home/ljd/wsMA_prototyp/ZRTOS_demo/zephyr/soc/st/stm32/stm32l0x/soc/st/stm32/stm32l0x/Kconfig.defconfig.stm32l072xx"
rsource "/home/ljd/wsMA_prototyp/ZRTOS_demo/zephyr/soc/st/stm32/stm32l0x/soc/st/stm32/stm32l0x/Kconfig.defconfig.stm32l073xx"
rsource "/home/ljd/wsMA_prototyp/ZRTOS_demo/zephyr/soc/st/stm32/stm32l0x/soc/st/stm32/stm32l0x/Kconfig.defconfig.stm32l081xx"
rsource "/home/ljd/wsMA_prototyp/ZRTOS_demo/zephyr/soc/st/stm32/stm32l0x/soc/st/stm32/stm32l0x/Kconfig.defconfig.stm32l083xx"

# adjust the fallback because of the LSI oscillator characteristics
config TASK_WDT_HW_FALLBACK_DELAY
	depends on TASK_WDT_HW_FALLBACK
	default 200

endif # SOC_SERIES_STM32L0X
```

## transform_projects/transform_zrtos/ZRTOS_copy/soc/st/stm32/stm32l5x/Kconfig.defconfig
```kconfig
# ST Microelectronics STM32L5 MCU line

# Copyright (c) 2020 Linaro Limited
# SPDX-License-Identifier: Apache-2.0

if SOC_SERIES_STM32L5X

rsource "/home/ljd/wsMA_prototyp/ZRTOS_demo/zephyr/soc/st/stm32/stm32l5x/soc/st/stm32/stm32l5x/Kconfig.defconfig.stm32l552xx"
rsource "/home/ljd/wsMA_prototyp/ZRTOS_demo/zephyr/soc/st/stm32/stm32l5x/soc/st/stm32/stm32l5x/Kconfig.defconfig.stm32l562xx"

config ICACHE
	default y

config CACHE_MANAGEMENT
	default y

choice CACHE_TYPE
	default EXTERNAL_CACHE
endchoice

config ROM_START_OFFSET
	default 0x400 if BOOTLOADER_MCUBOOT

endif # SOC_SERIES_STM32L5X
```

## transform_projects/transform_zrtos/ZRTOS_copy/soc/ti/k3/Kconfig.soc
```kconfig
# Copyright (c) 2024 Nordic Semiconductor ASA
# SPDX-License-Identifier: Apache-2.0

config SOC_FAMILY_TI_K3
	bool

config SOC_FAMILY
	default "ti_k3" if SOC_FAMILY_TI_K3

rsource "/home/ljd/wsMA_prototyp/ZRTOS_demo/zephyr/soc/ti/k3/soc/ti/k3/am6x/Kconfig.soc"
```

## transform_projects/transform_zrtos/ZRTOS_copy/soc/ti/simplelink/Kconfig.defconfig
```kconfig
# SPDX-License-Identifier: Apache-2.0
# Copyright (c) 2017 Zephyr Contributors

if SOC_FAMILY_TI_SIMPLELINK

rsource "/home/ljd/wsMA_prototyp/ZRTOS_demo/zephyr/soc/ti/simplelink/soc/ti/simplelink/cc13x2_cc26x2/Kconfig.defconfig"
rsource "/home/ljd/wsMA_prototyp/ZRTOS_demo/zephyr/soc/ti/simplelink/soc/ti/simplelink/cc13x2x7_cc26x2x7/Kconfig.defconfig"
rsource "/home/ljd/wsMA_prototyp/ZRTOS_demo/zephyr/soc/ti/simplelink/soc/ti/simplelink/cc23x0/Kconfig.defconfig"

endif # SOC_FAMILY_TI_SIMPLELINK
```
