## transform_projects/transform_zrtos/ZRTOS_copy/soc/ti/simplelink/cc32xx/Kconfig.defconfig
```kconfig
# TI SimpleLink Family
# SPDX-License-Identifier: Apache-2.0
# Copyright (c) 2016-2017, Texas Instruments Incorporated

if SOC_SERIES_CC32XX

rsource "/home/ljd/wsMA_prototyp/ZRTOS_demo/zephyr/soc/ti/simplelink/cc32xx/soc/ti/simplelink/cc32xx/Kconfig.defconfig.cc3220sf"
rsource "/home/ljd/wsMA_prototyp/ZRTOS_demo/zephyr/soc/ti/simplelink/cc32xx/soc/ti/simplelink/cc32xx/Kconfig.defconfig.cc3235sf"

endif # SOC_SERIES_CC32XX
```

## transform_projects/transform_zrtos/ZRTOS_copy/soc/wch/ch32v/Kconfig.defconfig
```kconfig
# Copyright (c) 2024 Michael Hope
# Copyright (c) 2024 Jianxiong Gu
# SPDX-License-Identifier: Apache-2.0

if SOC_FAMILY_CH32V

rsource "/home/ljd/wsMA_prototyp/ZRTOS_demo/zephyr/soc/wch/ch32v/soc/wch/ch32v/ch32v00x/Kconfig.defconfig"
rsource "/home/ljd/wsMA_prototyp/ZRTOS_demo/zephyr/soc/wch/ch32v/soc/wch/ch32v/qingke_v2a/Kconfig.defconfig"
rsource "/home/ljd/wsMA_prototyp/ZRTOS_demo/zephyr/soc/wch/ch32v/soc/wch/ch32v/qingke_v4b/Kconfig.defconfig"
rsource "/home/ljd/wsMA_prototyp/ZRTOS_demo/zephyr/soc/wch/ch32v/soc/wch/ch32v/qingke_v4c/Kconfig.defconfig"
rsource "/home/ljd/wsMA_prototyp/ZRTOS_demo/zephyr/soc/wch/ch32v/soc/wch/ch32v/qingke_v4f/Kconfig.defconfig"

endif # SOC_FAMILY_CH32V
```

## transform_projects/transform_zrtos/ZRTOS_copy/soc/wch/ch32v/Kconfig.soc
```kconfig
# Copyright (c) 2024 Michael Hope
# Copyright (c) 2024 Jianxiong Gu
# SPDX-License-Identifier: Apache-2.0

config SOC_FAMILY_CH32V
	bool

config SOC_FAMILY
	default "ch32v" if SOC_FAMILY_CH32V

rsource "/home/ljd/wsMA_prototyp/ZRTOS_demo/zephyr/soc/wch/ch32v/soc/wch/ch32v/ch32v00x/Kconfig.soc"
rsource "/home/ljd/wsMA_prototyp/ZRTOS_demo/zephyr/soc/wch/ch32v/soc/wch/ch32v/qingke_v2a/Kconfig.soc"
rsource "/home/ljd/wsMA_prototyp/ZRTOS_demo/zephyr/soc/wch/ch32v/soc/wch/ch32v/qingke_v4b/Kconfig.soc"
rsource "/home/ljd/wsMA_prototyp/ZRTOS_demo/zephyr/soc/wch/ch32v/soc/wch/ch32v/qingke_v4c/Kconfig.soc"
rsource "/home/ljd/wsMA_prototyp/ZRTOS_demo/zephyr/soc/wch/ch32v/soc/wch/ch32v/qingke_v4f/Kconfig.soc"
```
