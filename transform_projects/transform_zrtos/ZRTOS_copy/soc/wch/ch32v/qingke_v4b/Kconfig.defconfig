## transform_projects/transform_zrtos/ZRTOS_copy/soc/wch/ch32v/qingke_v4b/Kconfig.defconfig
```kconfig
# Copyright (c) 2025 MASSDRIVER EI (massdriver.space)
# SPDX-License-Identifier: Apache-2.0

if SOC_SERIES_QINGKE_V4B

config SYS_CLOCK_HW_CYCLES_PER_SEC
	default $(dt_node_int_prop_int,/cpus/cpu@0,clock-frequency)

config CLOCK_CONTROL
	default y

rsource "/home/ljd/wsMA_prototyp/ZRTOS_demo/zephyr/soc/wch/ch32v/qingke_v4b/soc/wch/ch32v/qingke_v4b/Kconfig.defconfig.ch32v203"

endif # SOC_SERIES_QINGKE_V4B
```

## transform_projects/transform_zrtos/ZRTOS_copy/soc/wch/ch32v/qingke_v4c/Kconfig.defconfig
```kconfig
# Copyright (c) 2025 MASSDRIVER EI (massdriver.space)
# SPDX-License-Identifier: Apache-2.0

if SOC_SERIES_QINGKE_V4C

config SYS_CLOCK_HW_CYCLES_PER_SEC
	default $(dt_node_int_prop_int,/cpus/cpu@0,clock-frequency)

config CLOCK_CONTROL
	default y

rsource "/home/ljd/wsMA_prototyp/ZRTOS_demo/zephyr/soc/wch/ch32v/qingke_v4c/soc/wch/ch32v/qingke_v4c/Kconfig.defconfig.ch32v208"

endif # SOC_SERIES_QINGKE_V4C
```

## transform_projects/transform_zrtos/ZRTOS_copy/soc/xlnx/zynq7000/Kconfig
```kconfig
#
# Copyright (c) 2021 Weidmueller Interface GmbH & Co. KG
# SPDX-License-Identifier: Apache-2.0
#

if SOC_FAMILY_XILINX_ZYNQ7000

rsource "/home/ljd/wsMA_prototyp/ZRTOS_demo/zephyr/soc/xlnx/zynq7000/soc/xlnx/zynq7000/xc7zxxx/Kconfig"
rsource "/home/ljd/wsMA_prototyp/ZRTOS_demo/zephyr/soc/xlnx/zynq7000/soc/xlnx/zynq7000/xc7zxxxs/Kconfig"

endif # SOC_FAMILY_XILINX_ZYNQ7000
```

## transform_projects/transform_zrtos/ZRTOS_copy/subsys/bluetooth/services/Kconfig
```kconfig
# GATT Services

# Copyright (c) 2018 Nordic Semiconductor ASA
# SPDX-License-Identifier: Apache-2.0

menu "GATT Services"
	depends on BT_CONN

rsource "/home/ljd/wsMA_prototyp/ZRTOS_demo/zephyr/subsys/bluetooth/services/subsys/bluetooth/services/Kconfig.ans"

rsource "/home/ljd/wsMA_prototyp/ZRTOS_demo/zephyr/subsys/bluetooth/services/subsys/bluetooth/services/Kconfig.dis"

rsource "/home/ljd/wsMA_prototyp/ZRTOS_demo/zephyr/subsys/bluetooth/services/subsys/bluetooth/services/Kconfig.cts"

rsource "/home/ljd/wsMA_prototyp/ZRTOS_demo/zephyr/subsys/bluetooth/services/subsys/bluetooth/services/Kconfig.hrs"

rsource "/home/ljd/wsMA_prototyp/ZRTOS_demo/zephyr/subsys/bluetooth/services/subsys/bluetooth/services/Kconfig.tps"

rsource "/home/ljd/wsMA_prototyp/ZRTOS_demo/zephyr/subsys/bluetooth/services/subsys/bluetooth/services/nus/Kconfig.nus"

rsource "/home/ljd/wsMA_prototyp/ZRTOS_demo/zephyr/subsys/bluetooth/services/subsys/bluetooth/services/ias/Kconfig.ias"

rsource "/home/ljd/wsMA_prototyp/ZRTOS_demo/zephyr/subsys/bluetooth/services/subsys/bluetooth/services/ots/Kconfig"

rsource "/home/ljd/wsMA_prototyp/ZRTOS_demo/zephyr/subsys/bluetooth/services/subsys/bluetooth/services/bas/Kconfig.bas"

endmenu
```

## transform_projects/transform_zrtos/ZRTOS_copy/subsys/gnss/rtk/Kconfig
```kconfig
# Copyright (c) 2025 Croxel Inc.
# Copyright (c) 2025 CogniPilot Foundation
# SPDX-License-Identifier: Apache-2.0

menuconfig GNSS_RTK
	bool "GNSS RTK client"
	select EXPERIMENTAL
	help
	  Enable GNSS RTK data-correction clients

if GNSS_RTK

rsource "/home/ljd/wsMA_prototyp/ZRTOS_demo/zephyr/subsys/gnss/rtk/subsys/gnss/rtk/protocol/Kconfig"
rsource "/home/ljd/wsMA_prototyp/ZRTOS_demo/zephyr/subsys/gnss/rtk/subsys/gnss/rtk/serial/Kconfig"

module = GNSS_RTK
module-str = GNSS RTK
source "subsys/logging/Kconfig.template.log_config"

endif
```

## transform_projects/transform_zrtos/ZRTOS_copy1/boards/shields/st_lcd_dsi_mb1835/Kconfig.defconfig
```kconfig
# Copyright (c) 2025 Charles Dias
# SPDX-License-Identifier: Apache-2.0

if SHIELD_ST_LCD_DSI_MB1835

if LVGL

config INPUT
	default y

config LV_Z_BITS_PER_PIXEL
	default 32

config LV_Z_FLUSH_THREAD
	default y

endif # LVGL

endif # SHIELD_ST_LCD_DSI_MB1835
```

## transform_projects/transform_zrtos/ZRTOS_copy1/build/Kconfig/Kconfig.modules
```kconfig
menu "acpica (/home/ljd/wsMA_prototyp/ZRTOS_demo/modules/lib/acpica)"
config ZEPHYR_ACPICA_MODULE
	bool
	default y
endmenu
menu "cmsis (/home/ljd/wsMA_prototyp/ZRTOS_demo/modules/hal/cmsis)"
config ZEPHYR_CMSIS_MODULE
	bool
	default y
endmenu
menu "cmsis-dsp (/home/ljd/wsMA_prototyp/ZRTOS_demo/modules/lib/cmsis-dsp)"
config ZEPHYR_CMSIS_DSP_MODULE
	bool
	default y
endmenu
menu "cmsis-nn (/home/ljd/wsMA_prototyp/ZRTOS_demo/modules/lib/cmsis-nn)"
config ZEPHYR_CMSIS_NN_MODULE
	bool
	default y
endmenu
menu "cmsis_6 (/home/ljd/wsMA_prototyp/ZRTOS_demo/modules/hal/cmsis_6)"
config ZEPHYR_CMSIS_6_MODULE
	bool
	default y
endmenu
menu "fatfs (/home/ljd/wsMA_prototyp/ZRTOS_demo/modules/fs/fatfs)"
config ZEPHYR_FATFS_MODULE
	bool
	default y
endmenu
config ZEPHYR_ADI_MODULE
	bool
	default y
menu "hal_afbr (/home/ljd/wsMA_prototyp/ZRTOS_demo/modules/hal/afbr)"
config ZEPHYR_HAL_AFBR_MODULE
	bool
	default y

config ZEPHYR_HAL_AFBR_MODULE_BLOBS
	bool
endmenu
menu "hal_ambiq (/home/ljd/wsMA_prototyp/ZRTOS_demo/modules/hal/ambiq)"
config ZEPHYR_HAL_AMBIQ_MODULE
	bool
	default y
endmenu
config ZEPHYR_ATMEL_MODULE
	bool
	default y
menu "hal_bouffalolab (/home/ljd/wsMA_prototyp/ZRTOS_demo/modules/hal/bouffalolab)"
config ZEPHYR_HAL_BOUFFALOLAB_MODULE
	bool
	default y
endmenu
menu "hal_espressif (/home/ljd/wsMA_prototyp/ZRTOS_demo/modules/hal/espressif)"
config ZEPHYR_HAL_ESPRESSIF_MODULE
	bool
	default y

config ZEPHYR_HAL_ESPRESSIF_MODULE_BLOBS
	bool
endmenu
menu "hal_ethos_u (/home/ljd/wsMA_prototyp/ZRTOS_demo/modules/hal/ethos_u)"
config ZEPHYR_HAL_ETHOS_U_MODULE
	bool
	default y
endmenu
menu "hal_gigadevice (/home/ljd/wsMA_prototyp/ZRTOS_demo/modules/hal/gigadevice)"
config ZEPHYR_HAL_GIGADEVICE_MODULE
	bool
	default y
endmenu
menu "hal_infineon (/home/ljd/wsMA_prototyp/ZRTOS_demo/modules/hal/infineon)"
config ZEPHYR_HAL_INFINEON_MODULE
	bool
	default y

config ZEPHYR_HAL_INFINEON_MODULE_BLOBS
	bool
endmenu
menu "hal_intel (/home/ljd/wsMA_prototyp/ZRTOS_demo/modules/hal/intel)"
config ZEPHYR_HAL_INTEL_MODULE
	bool
	default y
endmenu
config ZEPHYR_MICROCHIP_MODULE
	bool
	default y
menu "hal_nordic (/home/ljd/wsMA_prototyp/ZRTOS_demo/modules/hal/nordic)"
config ZEPHYR_HAL_NORDIC_MODULE
	bool
	default y

config ZEPHYR_HAL_NORDIC_MODULE_BLOBS
	bool
endmenu
config ZEPHYR_NUVOTON_MODULE
	bool
	default y
menu "hal_nxp (/home/ljd/wsMA_prototyp/ZRTOS_demo/modules/hal/nxp)"
config ZEPHYR_HAL_NXP_MODULE
	bool
	default y

config ZEPHYR_HAL_NXP_MODULE_BLOBS
	bool
endmenu
config ZEPHYR_OPENISA_MODULE
	bool
	default y
config ZEPHYR_QUICKLOGIC_MODULE
	bool
	default y
config ZEPHYR_HAL_RENESAS_MODULE
	bool
	default y

config ZEPHYR_HAL_RENESAS_MODULE_BLOBS
	bool
menu "hal_rpi_pico (/home/ljd/wsMA_prototyp/ZRTOS_demo/modules/hal/rpi_pico)"
config ZEPHYR_HAL_RPI_PICO_MODULE
	bool
	default y
endmenu
menu "hal_sifli (/home/ljd/wsMA_prototyp/ZRTOS_demo/modules/hal/sifli)"
config ZEPHYR_HAL_SIFLI_MODULE
	bool
	default y
endmenu
menu "hal_silabs (/home/ljd/wsMA_prototyp/ZRTOS_demo/modules/hal/silabs)"
config ZEPHYR_HAL_SILABS_MODULE
	bool
	default y

config ZEPHYR_HAL_SILABS_MODULE_BLOBS
	bool
endmenu
menu "hal_st (/home/ljd/wsMA_prototyp/ZRTOS_demo/modules/hal/st)"
config ZEPHYR_HAL_ST_MODULE
	bool
	default y
endmenu
config ZEPHYR_HAL_STM32_MODULE
	bool
	default y

config ZEPHYR_HAL_STM32_MODULE_BLOBS
	bool
menu "hal_tdk (/home/ljd/wsMA_prototyp/ZRTOS_demo/modules/hal/tdk)"
config ZEPHYR_HAL_TDK_MODULE
	bool
	default y
endmenu
menu "hal_telink (/home/ljd/wsMA_prototyp/ZRTOS_demo/modules/hal/telink)"
config ZEPHYR_HAL_TELINK_MODULE
	bool
	default y
endmenu
config ZEPHYR_TI_MODULE
	bool
	default y
menu "hal_wch (/home/ljd/wsMA_prototyp/ZRTOS_demo/modules/hal/wch)"
config ZEPHYR_HAL_WCH_MODULE
	bool
	default y
endmenu
config ZEPHYR_HAL_WURTHELEKTRONIK_MODULE
	bool
	default y
config ZEPHYR_XTENSA_MODULE
	bool
	default y
menu "hostap (/home/ljd/wsMA_prototyp/ZRTOS_demo/modules/lib/hostap)"
config ZEPHYR_HOSTAP_MODULE
	bool
	default y
endmenu
menu "liblc3 (/home/ljd/wsMA_prototyp/ZRTOS_demo/modules/lib/liblc3)"
config ZEPHYR_LIBLC3_MODULE
	bool
	default y
endmenu
config ZEPHYR_LIBMCTP_MODULE
	bool
	default y
config ZEPHYR_LIBMETAL_MODULE
	bool
	default y
menu "libsbc (/home/ljd/wsMA_prototyp/ZRTOS_demo/modules/lib/libsbc)"
config ZEPHYR_LIBSBC_MODULE
	bool
	default y
endmenu
menu "littlefs (/home/ljd/wsMA_prototyp/ZRTOS_demo/modules/fs/littlefs)"
config ZEPHYR_LITTLEFS_MODULE
	bool
	default y
endmenu
menu "lora-basics-modem (/home/ljd/wsMA_prototyp/ZRTOS_demo/modules/lib/lora-basics-modem)"
config ZEPHYR_LORA_BASICS_MODEM_MODULE
	bool
	default y
endmenu
menu "loramac-node (/home/ljd/wsMA_prototyp/ZRTOS_demo/modules/lib/loramac-node)"
config ZEPHYR_LORAMAC_NODE_MODULE
	bool
	default y
endmenu
menu "lvgl (/home/ljd/wsMA_prototyp/ZRTOS_demo/modules/lib/gui/lvgl)"
config ZEPHYR_LVGL_MODULE
	bool
	default y
endmenu
menu "mbedtls (/home/ljd/wsMA_prototyp/ZRTOS_demo/modules/crypto/mbedtls)"
config ZEPHYR_MBEDTLS_MODULE
	bool
	default y
endmenu
config ZEPHYR_MCUBOOT_MODULE
	bool
	default y
config ZEPHYR_MIPI_SYS_T_MODULE
	bool
	default y
menu "nanopb (/home/ljd/wsMA_prototyp/ZRTOS_demo/modules/lib/nanopb)"
config ZEPHYR_NANOPB_MODULE
	bool
	default y
endmenu
menu "nrf_wifi (/home/ljd/wsMA_prototyp/ZRTOS_demo/modules/lib/nrf_wifi)"
config ZEPHYR_NRF_WIFI_MODULE
	bool
	default y

config ZEPHYR_NRF_WIFI_MODULE_BLOBS
	bool
endmenu
config ZEPHYR_OPEN_AMP_MODULE
	bool
	default y
menu "openthread (/home/ljd/wsMA_prototyp/ZRTOS_demo/modules/lib/openthread)"
config ZEPHYR_OPENTHREAD_MODULE
	bool
	default y
endmenu
menu "percepio (/home/ljd/wsMA_prototyp/ZRTOS_demo/modules/debug/percepio)"
config ZEPHYR_PERCEPIO_MODULE
	bool
	default y
endmenu
menu "picolibc (/home/ljd/wsMA_prototyp/ZRTOS_demo/modules/lib/picolibc)"
config ZEPHYR_PICOLIBC_MODULE
	bool
	default y
endmenu
menu "segger (/home/ljd/wsMA_prototyp/ZRTOS_demo/modules/debug/segger)"
config ZEPHYR_SEGGER_MODULE
	bool
	default y
endmenu
menu "trusted-firmware-a (/home/ljd/wsMA_prototyp/ZRTOS_demo/modules/tee/tf-a/trusted-firmware-a)"
config ZEPHYR_TRUSTED_FIRMWARE_A_MODULE
	bool
	default y
endmenu
menu "trusted-firmware-m (/home/ljd/wsMA_prototyp/ZRTOS_demo/modules/tee/tf-m/trusted-firmware-m)"
config ZEPHYR_TRUSTED_FIRMWARE_M_MODULE
	bool
	default y
endmenu
menu "uoscore-uedhoc (/home/ljd/wsMA_prototyp/ZRTOS_demo/modules/lib/uoscore-uedhoc)"
config ZEPHYR_UOSCORE_UEDHOC_MODULE
	bool
	default y
endmenu
menu "zcbor (/home/ljd/wsMA_prototyp/ZRTOS_demo/modules/lib/zcbor)"
config ZEPHYR_ZCBOR_MODULE
	bool
	default y
endmenu
config ZEPHYR_NRF_HW_MODELS_MODULE
	bool
	default y
```

## transform_projects/transform_zrtos/ZRTOS_copy1/lib/posix/options/Kconfig
```kconfig
# Copyright (c) 2018 Intel Corporation
# Copyright (c) 2023 Meta
# Copyright (c) 2024 Tenstorrent AI ULC
#
# SPDX-License-Identifier: Apache-2.0

# zephyr-keep-sorted-start
# zephyr-keep-sorted-stop

menu "X/Open system interfaces"

# zephyr-keep-sorted-start
# zephyr-keep-sorted-stop

endmenu # "X/Open system interfaces"
```

## transform_projects/transform_zrtos/ZRTOS_copy1/soc/ite/ec/Kconfig.defconfig
```kconfig
# Copyright (c) 2020 ITE Corporation. All Rights Reserved.
# SPDX-License-Identifier: Apache-2.0

if SOC_FAMILY_ITE_EC

choice PM_POLICY
	default PM_POLICY_CUSTOM if SOC_FAMILY_ITE_EC
endchoice

endif # SOC_FAMILY_ITE_EC
```

## transform_projects/transform_zrtos/ZRTOS_copy1/soc/microchip/pic32c/pic32cz_ca/Kconfig.soc
```kconfig
# Copyright (c) 2025 Microchip Technology Inc.
# SPDX-License-Identifier: Apache-2.0

config SOC_FAMILY_MICROCHIP_PIC32CZ_CA
	bool

config SOC_FAMILY
	default "microchip_pic32cz_ca" if SOC_FAMILY_MICROCHIP_PIC32CZ_CA

source "soc/microchip/pic32c/pic32cz_ca/pic32cz_ca80/Kconfig.soc"
source "soc/microchip/pic32c/pic32cz_ca/pic32cz_ca90/Kconfig.soc"
source "soc/microchip/pic32c/pic32cz_ca/pic32cz_ca91/Kconfig.soc"
```

## transform_projects/transform_zrtos/ZRTOS_copy1/soc/microchip/sam/sama7/Kconfig.soc
```kconfig
# Copyright (C) 2025 Microchip Technology Inc. and its subsidiaries
#
# SPDX-License-Identifier: Apache-2.0
#

config SOC_FAMILY_MICROCHIP_SAMA7
	bool
	help
	  Enable support for Microchip SAMA7 Cortex-A Microprocessors.

config SOC_FAMILY
	default "microchip_sama7" if SOC_FAMILY_MICROCHIP_SAMA7

source "soc/microchip/sam/sama7/sama7d6/Kconfig.soc"
```

## transform_projects/transform_zrtos/ZRTOS_copy1/soc/nordic/nrf53/Kconfig.sync_rtc
```kconfig
# Copyright (c) 2019 Nordic Semiconductor ASA
# SPDX-License-Identifier: Apache-2.0

config NRF53_SYNC_RTC
	bool "RTC clock synchronization"
	default y if LOG && !LOG_MODE_MINIMAL && !IS_BOOTLOADER && \
		(SOC_NRF53_CPUNET_ENABLE || SOC_NRF5340_CPUNET)
	depends on NRF_RTC_TIMER
	select NRFX_GPPI
	select MBOX if !IPM

if NRF53_SYNC_RTC

module = SYNC_RTC
module-str = Synchronized RTC
source "subsys/logging/Kconfig.template.log_config"

config NRF53_SYNC_RTC_INIT_PRIORITY
	int "nRF53 Synchronized RTC init priority"
	default APPLICATION_INIT_PRIORITY
	help
	  nRF53 Synchronized RTC initialization priority.

config NRF_RTC_TIMER_USER_CHAN_COUNT
	default 2 if NRF_802154_RADIO_DRIVER && SOC_COMPATIBLE_NRF5340_CPUNET
	default 3 if NRF_802154_RADIO_DRIVER
	default 1

config NRF53_SYNC_RTC_LOG_TIMESTAMP
	bool "Use Synchronized RTC for logging timestamp"
	default y

config NRF53_SYNC_RTC_IPM_OUT
	int "IPM channel from APP to NET"
	range 0 15
	default 7 if SOC_COMPATIBLE_NRF5340_CPUAPP
	default 8

config NRF53_SYNC_RTC_IPM_IN
	int "IPM channel from APP to NET"
	range 0 15
	default 8 if SOC_COMPATIBLE_NRF5340_CPUAPP
	default 7

ipm_num = 0
ipm_num = 1
ipm_num = 2
ipm_num = 3
ipm_num = 4
ipm_num = 5
ipm_num = 6
ipm_num = 7
ipm_num = 8
ipm_num = 9
ipm_num = 10
ipm_num = 11
ipm_num = 12
ipm_num = 13
ipm_num = 14
ipm_num = 15

endif # NRF53_SYNC_RTC
```

## transform_projects/transform_zrtos/ZRTOS_copy1/soc/nuvoton/numaker/m333x/Kconfig.defconfig
```kconfig
# Copyright (c) 2025 Nuvoton Technology Corporation.
#
# SPDX-License-Identifier: Apache-2.0

if SOC_SERIES_M333X

source "soc/nuvoton/numaker/m333x/Kconfig.defconfig.m333xxx"

config SYS_CLOCK_HW_CYCLES_PER_SEC
	default $(dt_node_int_prop_int,/system-clock,clock-frequency)

endif # SOC_SERIES_M333X
```
