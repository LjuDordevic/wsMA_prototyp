## transform_projects/transform_zrtos/ZRTOS_demo1_output/drivers/wifi/infineon/Kconfig.airoc
```kconfig
# Copyright (c) 2023 Cypress Semiconductor Corporation (an Infineon company) or
# an affiliate of Cypress Semiconductor Corporation
# SPDX-License-Identifier: Apache-2.0

menuconfig WIFI_AIROC
	bool "Infineon AIROC SoC Wi-Fi support"
	depends on DT_HAS_INFINEON_AIROC_WIFI_ENABLED
	default y
	select THREAD_CUSTOM_DATA
	select WIFI_OFFLOAD
	select NET_L2_ETHERNET
	select NET_L2_WIFI_MGMT
	select GPIO
	select WIFI_USE_NATIVE_NETWORKING
	select USE_INFINEON_ABSTRACTION_RTOS
	help
	  Enable Infineon AIROC SoC Wi-Fi support.

if WIFI_AIROC

config AIROC_WIFI_BUS_SDIO
	bool
	default y
	depends on $(dt_compat_on_bus,$(DT_COMPAT_INFINEON_AIROC_WIFI),sd)
	select SDHC
	select SDIO_STACK
	help
	  Enable SDIO bus support.

config AIROC_WIFI_BUS_SPI
	bool
	default y
	depends on $(dt_compat_on_bus,$(DT_COMPAT_INFINEON_AIROC_WIFI),spi)
	select SPI
	help
	  Enable SPI bus support

config AIROC_WIFI6
	bool

config AIROC_WIFI_EVENT_TASK_STACK_SIZE
	int "Event Task Stack Size"
	default 4096

config AIROC_WIFI_EVENT_TASK_PRIO
	int "Event Task Priority"
	default 4

config AIROC_WLAN_MFG_FIRMWARE
	bool "WLAN Manufacturing Firmware"
	help
	  Enable WLAN Manufacturing Firmware.

config WHD_WIFI_COUNTRY
	string "Wifi couuntry option"
	default "WHD_COUNTRY_UNITED_STATES" if CYW55572 || CYW55500
	default "WHD_COUNTRY_AUSTRALIA"
	help
	  Sets the country, this will operate in for wifi initialization
	  parameters. See the wifi-host-driver's whd_country_code_t for legal options.

config AIROC_WIFI_CUSTOM
	bool "Custom CYW43xx device/module"
	help
	  Select Custom CYW43xx device/module. For this option,
	  user must to provide path to FW, CLM and NVRAM for
	  custom or vendor CYW43xx modules.



choice
	prompt "Select CYW43022 module"
	depends on CYW43022 && !AIROC_WIFI_CUSTOM

config CYW43022CUB
	bool "CYW43022CUB"
	help
	  Infineon CYW43022CUB M2 module

	  Detailed information about CYW43022CUB module you can find on
	  https://www.infineon.com/cms/en/product/wireless-connectivity/airoc-wi-fi-plus-bluetooth-combos/wi-fi-5-802.11ac/cyw43022/
endchoice




choice
	prompt "Select CYW55500 module"
	depends on CYW55500 && !AIROC_WIFI_CUSTOM

config CYW955513SDM2WLIPA_SM
	bool "CYW955513SDM2WLIPA_SM"
	help
	  Infineon CYW955513SDM2WLIPA (SM) module
endchoice

choice
	prompt "Select CYW55572 module"
	depends on CYW55572 && !AIROC_WIFI_CUSTOM

config CYW955573M2IPA1_SM
	bool "CYW955573M2IPA1_SM"
	help
	  Infineon CYW955573M2IPA1 (SM) module
endchoice

endif # AIROC_WIFI
```

## transform_projects/transform_zrtos/ZRTOS_demo1_output/dts/Kconfig
```kconfig
# SPDX-License-Identifier: Apache-2.0

menu "Devicetree Info"

source "build/Kconfig/Kconfig.dts"

endmenu
```

## transform_projects/transform_zrtos/ZRTOS_demo1_output/lib/libc/Kconfig
```kconfig
# C library

# Copyright (c) 2016 Intel Corporation
# SPDX-License-Identifier: Apache-2.0

config REQUIRES_FULL_LIBC
	prompt "Require complete C library"
	bool
	help
	  Select a C library implementation that provides a complete C library
	  implementation, rather than the subset provided by MINIMAL_LIBC.

config REQUIRES_FLOAT_PRINTF
	bool "Requires floating point support in printf"
	select CBPRINTF_FP_SUPPORT if MINIMAL_LIBC
	select NEWLIB_LIBC_FLOAT_PRINTF if NEWLIB_LIBC
	help
	  Select a printf implementation that provides a complete
	  implementation including floating point support.

config FULL_LIBC_SUPPORTED
	bool
	help
	  Selected when the target has at least one C library that offers a
	  complete implementation and which would be selected when
	  REQUIRES_FULL_LIBC is set.

config MINIMAL_LIBC_SUPPORTED
	bool
	depends on !NATIVE_APPLICATION
	default y
	help
	  Selected when the target has support for the minimal C library

config NEWLIB_LIBC_SUPPORTED
	bool
	default y
	depends on "$(TOOLCHAIN_HAS_NEWLIB)" = "y"
	depends on !NATIVE_APPLICATION
	select FULL_LIBC_SUPPORTED
	help
	  Selected when the target has support for the newlib C library

# Picolibc with C++ support in Zephyr SDK is handled by Zephyr SDK's own Kconfig.
config PICOLIBC_SUPPORTED
	bool
	depends on !NATIVE_APPLICATION
	depends on ("$(TOOLCHAIN_HAS_PICOLIBC)" = "y") || (ZEPHYR_PICOLIBC_MODULE && !REQUIRES_FULL_LIBCPP)
	default y
	select FULL_LIBC_SUPPORTED
	help
	  Selected when the target has support for picolibc.

config IAR_LIBC_SUPPORTED
	bool
	default n
	select FULL_LIBC_SUPPORTED
	help
	  Selected if the target is an IAR Systems compiler

config NATIVE_LIBC_INCOMPATIBLE
	bool
	help
	  Other Kconfig options can select this, if they are not compatible with the
	  native/host libC, and should only be compiled with an embedded libC

menu "C Library"


config HAS_NEWLIB_LIBC_NANO
	bool

source "lib/libc/common/Kconfig"
source "lib/libc/minimal/Kconfig"
source "lib/libc/newlib/Kconfig"
source "lib/libc/picolibc/Kconfig"

config STDOUT_CONSOLE
	bool "Send stdout to console"
	depends on CONSOLE_HAS_DRIVER
	depends on !(NATIVE_APPLICATION || (NATIVE_LIBRARY && EXTERNAL_LIBC))
	default y
	help
	  This option directs standard output (e.g. printf) to the console
	  device, rather than suppressing it entirely. See also EARLY_CONSOLE
	  option.

config NEED_LIBC_MEM_PARTITION
	bool
	help
	  Hidden option to signal that a memory partition is needed for
	  the C library even though it would not have been enabled
	  otherwise.

endmenu
```

## transform_projects/transform_zrtos/ZRTOS_demo1_output/lib/posix/shell/Kconfig
```kconfig
# Copyright (c) 2024 Meta
# SPDX-License-Identifier: Apache-2.0

menu "POSIX Shell Utilities"

if SHELL

config POSIX_SHELL
	bool
	help
	  Compile the parent `posix` shell command.

source "lib/posix/shell/Kconfig.env"
source "lib/posix/shell/Kconfig.uname"

endif # SHELL

endmenu # "POSIX Shell Utilities"
```

## transform_projects/transform_zrtos/ZRTOS_demo1_output/modules/hal_ambiq/Kconfig
```kconfig
# SPDX-License-Identifier: Apache-2.0
#
# Copyright (c) 2023 Antmicro <www.antmicro.com>
# Copyright (c) 2025, Ambiq Micro Inc. <www.ambiq.com>

source "modules/hal_ambiq/Kconfig.hal"
source "modules/hal_ambiq/Kconfig.components"
```

## transform_projects/transform_zrtos/ZRTOS_demo1_output/modules/hal_ethos_u/Kconfig
```kconfig
# SPDX-FileCopyrightText: <text>Copyright 2021-2022, 2024-2025 Arm Limited and/or its
# affiliates <open-source-office@arm.com></text>
# SPDX-License-Identifier: Apache-2.0

config ETHOS_U
	bool "Ethos-U core driver"
	default n
	depends on MULTITHREADING
	help
	  This option enables the Arm Ethos-U core driver.

if ETHOS_U
menu "Ethos-U NPU configuration"
endmenu

config ETHOS_U_NPU_NAME
	string
	default "ethos-u55-64" if ETHOS_U55_64
	default "ethos-u55-128" if ETHOS_U55_128
	default "ethos-u55-256" if ETHOS_U55_256
	default "ethos-u65-128" if ETHOS_U65_128
	default "ethos-u65-256" if ETHOS_U65_256
	default "ethos-u65-512" if ETHOS_U65_512
	default "ethos-u85-128" if ETHOS_U85_128
	default "ethos-u85-256" if ETHOS_U85_256
	default "ethos-u85-512" if ETHOS_U85_512
	default "ethos-u85-1024" if ETHOS_U85_1024
	default "ethos-u85-2048" if ETHOS_U85_2048
	help
	  Name of the used Ethos-U NPU

choice "ETHOS_U_LOG_LEVEL_CHOICE"
	prompt "Max compiled-in log level for ETHOS_U"
	default ETHOS_U_LOG_LEVEL_WRN
	depends on STDOUT_CONSOLE

config ETHOS_U_LOG_LEVEL_NONE
	bool "None"

config ETHOS_U_LOG_LEVEL_ERR
	bool "Error"

config ETHOS_U_LOG_LEVEL_WRN
	bool "Warning"

config ETHOS_U_LOG_LEVEL_INF
	bool "Info"

config ETHOS_U_LOG_LEVEL_DBG
	bool "Debug"

config ETHOS_U_LOG_LEVEL_DEFAULT
	bool "Default"

endchoice

config ETHOS_U_LOG_LEVEL
	int
	depends on STDOUT_CONSOLE
	default 0 if ETHOS_U_LOG_LEVEL_NONE
	default 1 if ETHOS_U_LOG_LEVEL_ERR
	default 2 if ETHOS_U_LOG_LEVEL_WRN
	default 3 if ETHOS_U_LOG_LEVEL_INF
	default 4 if ETHOS_U_LOG_LEVEL_DBG

endif
```

## transform_projects/transform_zrtos/ZRTOS_demo1_output/modules/hal_nxp/Kconfig
```kconfig
#
# Copyright (c) 2021 Linaro, Limited
# Copyright 2025 NXP
#
# SPDX-License-Identifier: Apache-2.0


config ZEPHYR_HAL_NXP_MODULE
	bool

source "modules/hal_nxp/imx/Kconfig.imx"
source "modules/hal_nxp/s32/Kconfig.nxp_s32"
source "modules/hal_nxp/mcux/Kconfig.mcux"
```

## transform_projects/transform_zrtos/ZRTOS_demo1_output/modules/trusted-firmware-m/Kconfig
```kconfig
# Configuration for the TF-M Module

# Copyright (c) 2019, 2020 Linaro Limited
# Copyright (c) 2020, 2021 Nordic Semiconductor ASA
# SPDX-License-Identifier: Apache-2.0

source "modules/trusted-firmware-m/Kconfig.tfm"
source "modules/trusted-firmware-m/Kconfig.tfm.partitions"
source "modules/trusted-firmware-m/Kconfig.tfm.crypto_modules"
```

## transform_projects/transform_zrtos/ZRTOS_demo1_output/soc/adi/max32/Kconfig.defconfig
```kconfig
# Analog Devices MAX32xxx MCU family

# Copyright (c) 2023-2024 Analog Devices, Inc.
# SPDX-License-Identifier: Apache-2.0

if SOC_FAMILY_MAX32

source "soc/adi/max32/Kconfig.defconfig.max32650"
source "soc/adi/max32/Kconfig.defconfig.max32655"
source "soc/adi/max32/Kconfig.defconfig.max32657"
source "soc/adi/max32/Kconfig.defconfig.max32660"
source "soc/adi/max32/Kconfig.defconfig.max32662"
source "soc/adi/max32/Kconfig.defconfig.max32666"
source "soc/adi/max32/Kconfig.defconfig.max32670"
source "soc/adi/max32/Kconfig.defconfig.max32672"
source "soc/adi/max32/Kconfig.defconfig.max32675"
source "soc/adi/max32/Kconfig.defconfig.max32680"
source "soc/adi/max32/Kconfig.defconfig.max32690"
source "soc/adi/max32/Kconfig.defconfig.max78000"
source "soc/adi/max32/Kconfig.defconfig.max78002"

endif # SOC_FAMILY_MAX32
```

## transform_projects/transform_zrtos/ZRTOS_demo1_output/soc/ambiq/Kconfig
```kconfig
# SPDX-License-Identifier: Apache-2.0
#
# Copyright (c) 2023 Antmicro <www.antmicro.com>

if SOC_FAMILY_AMBIQ

source "soc/ambiq/apollo3x/Kconfig"
source "soc/ambiq/apollo4x/Kconfig"
source "soc/ambiq/apollo5x/Kconfig"

endif # SOC_FAMILY_AMBIQ
```

## transform_projects/transform_zrtos/ZRTOS_demo1_output/soc/ambiq/Kconfig.defconfig
```kconfig
# SPDX-License-Identifier: Apache-2.0
#
# Copyright (c) 2023 Antmicro <www.antmicro.com>

if SOC_FAMILY_AMBIQ

source "soc/ambiq/apollo3x/Kconfig.defconfig"
source "soc/ambiq/apollo4x/Kconfig.defconfig"
source "soc/ambiq/apollo5x/Kconfig.defconfig"

config CORTEX_M_SYSTICK
	default n if AMBIQ_STIMER_TIMER

config SYS_CLOCK_TICKS_PER_SEC
	default 1024

endif # SOC_FAMILY_AMBIQ
```
