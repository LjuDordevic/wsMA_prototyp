## transform_projects/transform_zrtos/ZRTOS_demo1_output/boards/shields/seeed_xiao_expansion_board/Kconfig.defconfig
```kconfig
# Copyright (c) 2024 Charles Dias <charlesdias.cd@outlook.com>
# SPDX-License-Identifier: Apache-2.0

if SHIELD_SEEED_XIAO_EXPANSION_BOARD

if DISPLAY

if LVGL

config LV_Z_VDB_SIZE
	default 64

config LV_DPI_DEF
	default 148

config LV_Z_BITS_PER_PIXEL
	default 1

endif # LVGL

endif # DISPLAY

endif # SHIELD_SEEED_XIAO_EXPANSION_BOARD
```

## transform_projects/transform_zrtos/ZRTOS_demo1_output/boards/shields/seeed_xiao_round_display/Kconfig.defconfig
```kconfig
# Copyright (c) 2024 Nicolas Goualard <nicolas.goualard@sfr.fr>
# SPDX-License-Identifier: Apache-2.0

if SHIELD_SEEED_XIAO_ROUND_DISPLAY

if DISPLAY

if LVGL

config INPUT
	default y



endif # LVGL
endif # DISPLAY

endif # SHIELD_XIAO_ROUND_DISPLAY
```

## transform_projects/transform_zrtos/ZRTOS_demo1_output/boards/shields/sparkfun_sara_r4/Kconfig.defconfig
```kconfig
# Copyright (c) 2019 Linaro Limited
# SPDX-License-Identifier: Apache-2.0

if SHIELD_SPARKFUN_SARA_R4

if NETWORKING

config MODEM
	default y

config MODEM_SHELL
	default y

config MODEM_UBLOX_SARA
	default y

choice
	default MODEM_UBLOX_SARA_R4
endchoice
config MODEM_UBLOX_SARA_R4
	bool "u-blox SARA-R4"
	help
	  Enable support for SARA-R4 modem

config MODEM_UBLOX_SARA_U2
	bool "u-blox SARA-U2"
	help
	  Enable support for SARA-U2 modem

config MODEM_UBLOX_SARA_AUTODETECT_VARIANT
	bool "detect automatically"
	help
	  Enable automatic detection of modem variant (SARA-R4 or SARA-U2)

endchoice

config MODEM_UBLOX_SARA_R4_NET_STATUS
	default y

config UART_INTERRUPT_DRIVEN
	default y

# extend retry timing to 20 seconds for LTE/LTE-M
config COAP_INIT_ACK_TIMEOUT_MS
	default 20000

# Hack: disable IPv6 for now
config NET_IPV6
	default n

config NET_CONFIG_NEED_IPV6
	default n

endif # NETWORKING

endif # SHIELD_SPARKFUN_SARA_R4
```

## transform_projects/transform_zrtos/ZRTOS_demo1_output/boards/shields/st_b_lcd40_dsi1_mb1166/Kconfig.defconfig
```kconfig
# Copyright (c) 2023 BrainCo Inc.
# Copyright (c) 2024 Erik Andersson <erian747@gmail.com>
# SPDX-License-Identifier: Apache-2.0

if SHIELD_ST_B_LCD40_DSI1_MB1166 || SHIELD_ST_B_LCD40_DSI1_MB1166_A09

source "boards/shields/st_b_lcd40_dsi1_mb1166/boards/stm32h747i_disco_stm32h747xx_m7.defconfig"
source "boards/shields/st_b_lcd40_dsi1_mb1166/boards/stm32h757i_eval_stm32h757xx_m7.defconfig"

if LVGL

config INPUT
	default y

config LV_Z_BITS_PER_PIXEL
	default 32

config LV_DPI_DEF
	default 128

config LV_Z_FLUSH_THREAD
	default y

endif # LVGL

endif # SHIELD_ST_B_LCD40_DSI1_MB1166 || SHIELD_ST_B_LCD40_DSI1_MB1166_A09
```

## transform_projects/transform_zrtos/ZRTOS_demo1_output/boards/shields/waveshare_pico_lcd_1_14/Kconfig.defconfig
```kconfig
# Copyright (c) 2025 TOKITA Hiroshi
# SPDX-License-Identifier: Apache-2.0

if SHIELD_WAVESHARE_PICO_LCD_1_14 || SHIELD_WAVESHARE_PICO_LCD_1_14_DISPLAY

if DISPLAY

if LVGL

config LV_DPI_DEF
	default 242

config LV_Z_BITS_PER_PIXEL
	default 16

endif # LVGL

endif # DISPLAY

endif # SHIELD_WAVESHARE_PICO_LCD_1_14
```

## transform_projects/transform_zrtos/ZRTOS_demo1_output/build/Kconfig/boards/Kconfig.defconfig
```kconfig
# Load Zephyr board defconfig descriptions.
source "boards/native/native_sim/Kconfig.defconfig"
```

## transform_projects/transform_zrtos/ZRTOS_demo1_output/build/Kconfig/soc/Kconfig.defconfig
```kconfig
# Load Zephyr SoC defconfig descriptions.
source "soc/xlnx/zynqmp/Kconfig.defconfig"
source "soc/xlnx/zynq7000/Kconfig.defconfig"
source "soc/xlnx/versalnet/Kconfig.defconfig"
source "soc/xlnx/versal2/Kconfig.defconfig"
source "soc/xen/Kconfig.defconfig"
source "soc/ti/mspm0/Kconfig.defconfig"
source "soc/ti/lm3s6965/Kconfig.defconfig"
source "soc/starfive/jh71xx/Kconfig.defconfig"
source "soc/st/stm32/Kconfig.defconfig"
source "soc/snps/qemu_arc/Kconfig.defconfig"
source "soc/snps/nsim/arc_classic/Kconfig.defconfig"
source "soc/snps/hsdk4xd/Kconfig.defconfig"
source "soc/snps/hsdk/Kconfig.defconfig"
source "soc/snps/emsdp/Kconfig.defconfig"
source "soc/snps/arc_iot/Kconfig.defconfig"
source "soc/silabs/Kconfig.defconfig"
source "soc/renode/riscv_virtual/Kconfig.defconfig"
source "soc/renode/cortex_r8_virtual/Kconfig.defconfig"
source "soc/quicklogic/eos_s3/Kconfig.defconfig"
source "soc/qemu/virt_riscv/Kconfig.defconfig"
source "soc/qemu/malta/Kconfig.defconfig"
source "soc/openisa/rv32m1/Kconfig.defconfig"
source "soc/openhwgroup/cva6/Kconfig.defconfig"
source "soc/nxp/rw/Kconfig.defconfig"
source "soc/nxp/lpc/Kconfig.defconfig"
source "soc/nxp/imxrt/Kconfig.defconfig"
source "soc/nuvoton/numaker/Kconfig.defconfig"
source "soc/nordic/Kconfig.defconfig"
source "soc/neorv32/Kconfig.defconfig"
source "soc/microchip/sam/Kconfig.defconfig"
source "soc/mediatek/mt8xxx/Kconfig.defconfig"
source "soc/lowrisc/opentitan/Kconfig.defconfig"
source "soc/litex/litex_vexriscv/Kconfig.defconfig"
source "soc/ite/ec/Kconfig.defconfig"
source "soc/intel/raptor_lake/Kconfig.defconfig"
source "soc/intel/lakemont/Kconfig.defconfig"
source "soc/intel/intel_ish/Kconfig.defconfig"
source "soc/intel/intel_adsp/Kconfig.defconfig"
source "soc/intel/elkhart_lake/Kconfig.defconfig"
source "soc/intel/atom/Kconfig.defconfig"
source "soc/intel/apollo_lake/Kconfig.defconfig"
source "soc/intel/alder_lake/Kconfig.defconfig"
source "soc/gd/gd32/Kconfig.defconfig"
source "soc/gaisler/leon3/Kconfig.defconfig"
source "soc/gaisler/gr716a/Kconfig.defconfig"
source "soc/espressif/Kconfig.defconfig"
source "soc/ene/kb1200/Kconfig.defconfig"
source "soc/efinix/sapphire/Kconfig.defconfig"
source "soc/cdns/sample_controller32/Kconfig.defconfig"
source "soc/cdns/dc233c/Kconfig.defconfig"
source "soc/brcm/bcm2712/Kconfig.defconfig"
source "soc/brcm/bcm2711/Kconfig.defconfig"
source "soc/bflb/Kconfig.defconfig"
source "soc/atmel/sam0/Kconfig.defconfig"
source "soc/atmel/sam/Kconfig.defconfig"
source "soc/arm/beetle/Kconfig.defconfig"
source "soc/amd/acp_6_0/Kconfig.defconfig"
source "soc/ambiq/Kconfig.defconfig"
```

## transform_projects/transform_zrtos/ZRTOS_demo1_output/build/Kconfig/soc/Kconfig.soc
```kconfig
# Load SoC Kconfig descriptions.
source "soc/xlnx/zynqmp/Kconfig.soc"
source "soc/xlnx/zynq7000/Kconfig.soc"
source "soc/xlnx/versalnet/Kconfig.soc"
source "soc/xlnx/versal2/Kconfig.soc"
source "soc/xen/Kconfig.soc"
source "soc/wch/ch32v/Kconfig.soc"
source "soc/ti/simplelink/Kconfig.soc"
source "soc/ti/mspm0/Kconfig.soc"
source "soc/ti/lm3s6965/Kconfig.soc"
source "soc/ti/k3/Kconfig.soc"
source "soc/telink/tlsr/Kconfig.soc"
source "soc/starfive/jh71xx/Kconfig.soc"
source "soc/st/stm32/Kconfig.soc"
source "soc/snps/qemu_arc/Kconfig.soc"
source "soc/snps/nsim/arc_v/Kconfig.soc"
source "soc/snps/nsim/arc_classic/Kconfig.soc"
source "soc/snps/hsdk4xd/Kconfig.soc"
source "soc/snps/hsdk/Kconfig.soc"
source "soc/snps/emsk/Kconfig.soc"
source "soc/snps/emsdp/Kconfig.soc"
source "soc/snps/arc_iot/Kconfig.soc"
source "soc/silabs/Kconfig.soc"
source "soc/sifive/sifive_freedom/Kconfig.soc"
source "soc/sensry/Kconfig.soc"
source "soc/rockchip/Kconfig.soc"
source "soc/renode/riscv_virtual/Kconfig.soc"
source "soc/renode/cortex_r8_virtual/Kconfig.soc"
source "soc/renesas/smartbond/Kconfig.soc"
source "soc/renesas/rz/Kconfig.soc"
source "soc/renesas/rx/Kconfig.soc"
source "soc/renesas/rcar/Kconfig.soc"
source "soc/renesas/ra/Kconfig.soc"
source "soc/realtek/ec/Kconfig.soc"
source "soc/raspberrypi/rpi_pico/Kconfig.soc"
source "soc/quicklogic/eos_s3/Kconfig.soc"
source "soc/qemu/virt_riscv/Kconfig.soc"
source "soc/qemu/malta/Kconfig.soc"
source "soc/openisa/rv32m1/Kconfig.soc"
source "soc/openhwgroup/cva6/Kconfig.soc"
source "soc/oct/osd32mp15x/Kconfig.soc"
source "soc/nxp/s32/Kconfig.soc"
source "soc/nxp/rw/Kconfig.soc"
source "soc/nxp/mcx/Kconfig.soc"
source "soc/nxp/lpc/Kconfig.soc"
source "soc/nxp/layerscape/Kconfig.soc"
source "soc/nxp/kinetis/Kconfig.soc"
source "soc/nxp/imxrt/Kconfig.soc"
source "soc/nxp/imx/Kconfig.soc"
source "soc/nuvoton/numicro/Kconfig.soc"
source "soc/nuvoton/numaker/Kconfig.soc"
source "soc/nuvoton/npcx/Kconfig.soc"
source "soc/nuvoton/npcm/Kconfig.soc"
source "soc/nordic/Kconfig.soc"
source "soc/neorv32/Kconfig.soc"
source "soc/native/inf_clock/Kconfig.soc"
source "soc/microchip/sam/Kconfig.soc"
source "soc/microchip/miv/Kconfig.soc"
source "soc/microchip/mec/Kconfig.soc"
source "soc/mediatek/mt8xxx/Kconfig.soc"
source "soc/lowrisc/opentitan/Kconfig.soc"
source "soc/litex/litex_vexriscv/Kconfig.soc"
source "soc/ite/ec/Kconfig.soc"
source "soc/intel/raptor_lake/Kconfig.soc"
source "soc/intel/lakemont/Kconfig.soc"
source "soc/intel/intel_socfpga_std/Kconfig.soc"
source "soc/intel/intel_socfpga/Kconfig.soc"
source "soc/intel/intel_niosv/Kconfig.soc"
source "soc/intel/intel_ish/Kconfig.soc"
source "soc/intel/intel_adsp/Kconfig.soc"
source "soc/intel/elkhart_lake/Kconfig.soc"
source "soc/intel/atom/Kconfig.soc"
source "soc/intel/apollo_lake/Kconfig.soc"
source "soc/intel/alder_lake/Kconfig.soc"
source "soc/infineon/cat3/Kconfig.soc"
source "soc/infineon/cat1c/Kconfig.soc"
source "soc/infineon/cat1b/Kconfig.soc"
source "soc/infineon/cat1a/Kconfig.soc"
source "soc/gd/gd32/Kconfig.soc"
source "soc/gaisler/leon3/Kconfig.soc"
source "soc/gaisler/gr716a/Kconfig.soc"
source "soc/espressif/Kconfig.soc"
source "soc/ene/kb1200/Kconfig.soc"
source "soc/ene/kb106x/Kconfig.soc"
source "soc/efinix/sapphire/Kconfig.soc"
source "soc/cdns/xtensa_sample_controller/Kconfig.soc"
source "soc/cdns/sample_controller32/Kconfig.soc"
source "soc/cdns/dc233c/Kconfig.soc"
source "soc/brcm/bcmvk/Kconfig.soc"
source "soc/brcm/bcm2712/Kconfig.soc"
source "soc/brcm/bcm2711/Kconfig.soc"
source "soc/bflb/Kconfig.soc"
source "soc/atmel/sam0/Kconfig.soc"
source "soc/atmel/sam/Kconfig.soc"
source "soc/aspeed/Kconfig.soc"
source "soc/arm/Kconfig.soc"
source "soc/arm/beetle/Kconfig.soc"
source "soc/antmicro/myra/Kconfig.soc"
source "soc/andestech/Kconfig.soc"
source "soc/amd/acp_6_0/Kconfig.soc"
source "soc/ambiq/Kconfig.soc"
source "soc/adi/max32/Kconfig.soc"
```
