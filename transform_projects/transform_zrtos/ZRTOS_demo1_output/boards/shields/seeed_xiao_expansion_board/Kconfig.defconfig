## transform_projects/transform_zrtos/ZRTOS_demo1_output/drivers/bluetooth/hci/Kconfig.infineon
```kconfig
# Copyright (c) 2023 Cypress Semiconductor Corporation (an Infineon company) or
# an affiliate of Cypress Semiconductor Corporation
# SPDX-License-Identifier: Apache-2.0

if BT_AIROC

config BT_CYW43XX
	bool
	default y if BT_AIROC && BT_H4

choice
	prompt "Select AIROC part"

  prompt "Select AIROC part" if !AIROC_WIFI_CUSTOM && WIFI_AIROC
config CYW4343W
	bool "CYW4343W"
	depends on BT_H4
	help
	  Enable Infineon CYW4343W BLE connectivity,
	  More information about CYW4343W device you can find on
	  https://www.infineon.com/cms/en/product/wireless-connectivity/airoc-wi-fi-plus-bluetooth-combos/cyw4343w/

config CYW4373
	bool "CYW4373"
	depends on BT_H4
	help
	  Enable Infineon CYW4373 BLE connectivity,
	  More information about CYW4373 device you can find on
	  https://www.infineon.com/cms/en/product/wireless-connectivity/airoc-wi-fi-plus-bluetooth-combos/cyw4373/

config CYW43012
	bool "CYW43012"
	depends on BT_H4
	help
	  Enable Infineon CYW43012 BLE connectivity,
	  More information about CYW43012 device you can find on
	  https://www.infineon.com/cms/en/product/wireless-connectivity/airoc-wi-fi-plus-bluetooth-combos/cyw43012/

config CYW43438
	bool "CYW43438"
	depends on BT_H4
	help
	  Enable Infineon CYW43438 BLE connectivity,
	  More information about CYW43438 device you can find on
	  https://www.infineon.com/cms/en/product/wireless-connectivity/airoc-wi-fi-plus-bluetooth-combos/cyw43438/

config CYW43439
	bool "CYW43439"
	depends on BT_H4
	help
	  Enable Infineon CYW43439 BLE connectivity,
	  More information about CYW43439 device you can find on
	  https://www.infineon.com/cms/en/product/wireless-connectivity/airoc-wi-fi-plus-bluetooth-combos/cyw43439/

config CYW20829
	bool "CYW20829"
	depends on BT_CYW208XX
	help
	  Enable Infineon CYW20829 BLE connectivity,
	  More information about CYW20829 device you can find on
	  https://www.infineon.com/cms/en/product/wireless-connectivity/airoc-bluetooth-le-bluetooth-multiprotocol/airoc-bluetooth-le/cyw20829/

config BT_AIROC_CUSTOM
	bool "Custom AIROC device/module"
	help
	  Select Custom AIROC device/module. For this option,
	  user must to provide path to BT firmware HCD file for
	  custom or vendor AIROC modules in AIROC_CUSTOM_FIRMWARE_HCD_BLOB.

config CYW43022
 bool "CYW43022" if !AIROC_WIFI_CUSTOM && WIFI_AIROC
	help
	  Enable Infineon AIROC CYW43022 Wi-Fi connectivity,
	  More information about CYW43022 device you can find on
	  https://www.infineon.com/cms/en/product/wireless-connectivity/airoc-wi-fi-plus-bluetooth-combos/wi-fi-5-802.11ac/cyw43022/

config CYW55500
 bool "CYW55500" if !AIROC_WIFI_CUSTOM && WIFI_AIROC
	select AIROC_WIFI6
	help
	  Enable Infineon AIROC CYW55500 Wi-Fi connectivity,
	  More information about CYW55500 device you can find on
	  https://www.infineon.com/cms/en/product/wireless-connectivity/airoc-wi-fi-plus-bluetooth-combos/wi-fi-6-6e-802.11ax/cyw55511/

config CYW55572
 bool "CYW55572" if !AIROC_WIFI_CUSTOM && WIFI_AIROC
	select AIROC_WIFI6
	help
	  Enable Infineon AIROC CYW55572 Wi-Fi connectivity,
	  More information about CYW55572 device you can find on
	  https://www.infineon.com/cms/en/product/wireless-connectivity/airoc-wi-fi-plus-bluetooth-combos/wi-fi-6-6e-802.11ax/cyw55572/

endchoice

choice
	prompt "Select CYW43012 module"
	depends on CYW43012

  prompt "Select CYW43012 module" if CYW43012 && !AIROC_WIFI_CUSTOM && WIFI_AIROC
config CYW43012_MURATA_1LV
	bool "MURATA-1LV"
	help
	  Murata Type 1LV module based on Infineon CYW43012 combo chipset
	  which supports Wi-Fi® 802.11a/b/g/n + Bluetooth® 5.0 BR/EDR/LE
	  up to 72.2Mbps PHY data rate on Wi-fi® and 3Mbps PHY data rate
	  on Bluetooth®. 2Mbps LE PHY is also supported.

	  Detailed information about Murata Type 1LV module you can find on
	  https://www.murata.com/en-us/products/connectivitymodule/wi-fi-bluetooth/overview/lineup/type1lv

endchoice

choice
	prompt "Select CYW4343W module"
	depends on CYW4343W

  prompt "Select CYW4343W module" if CYW4343W && !AIROC_WIFI_CUSTOM && WIFI_AIROC
config CYW4343W_MURATA_1DX
	bool "MURATA-1DX"
	help
	  Murata Type 1DX modules based on Infineon CYW4343W combo chipset
	  which supports Wi-Fi® 802.11b/g/n + Bluetooth® 5.1 BR/EDR/LE
	  up to 65Mbps PHY data rate on Wi-fi® and 3Mbps PHY data rate
	  on Bluetooth®.

	  Detailed information about Type 1DX module you can find on
	  https://www.murata.com/en-us/products/connectivitymodule/wi-fi-bluetooth/overview/lineup/type1dx

endchoice

choice
	prompt "Select CYW4373 module"
	depends on CYW4373

  prompt "Select CYW4373 module" if CYW4373 && !AIROC_WIFI_CUSTOM && WIFI_AIROC
config CYW4373_STERLING_LWB5PLUS
	bool "STERLING-LWB5plus"
	help
	  Ezurio Sterling LWB5+ 802.11ac / Bluetooth 5.0 M.2 Carrier Board
	  (E-Type Key w/ SDIO/UART)

	  Detailed information about Type Sterling LWB5+ module you can find on
	  https://www.ezurio.com/wireless-modules/wifi-modules-bluetooth/sterling-lwb5-plus-wifi-5-bluetooth-5-module

config CYW4373_MURATA_2AE
 bool "CYW4373_MURATA_2AE" if CYW4373 && !AIROC_WIFI_CUSTOM && WIFI_AIROC
	help
	  Murata Type 2AE modules based on Infineon CYW4373 combo chipset

	  Detailed information about Murata Type 2AE module you can find on
	  https://www.murata.com/en-us/products/connectivitymodule/wi-fi-bluetooth/overview/lineup/type2ae

config CYW4373_MURATA_2BC
 bool "CYW4373_MURATA_2BC" if CYW4373 && !AIROC_WIFI_CUSTOM && WIFI_AIROC
	help
	  Murata Type 2BC modules based on Infineon CYW4373 combo chipset

	  Detailed information about Murata Type 2BC module you can find on
	  https://www.murata.com/en-us/products/connectivitymodule/wi-fi-bluetooth/overview/lineup/type2bc

endchoice

choice
	prompt "Select CYW43439 module"
	depends on CYW43439

  prompt "Select CYW43439 module" if CYW43439 && !AIROC_WIFI_CUSTOM && WIFI_AIROC
config CYW43439_MURATA_1YN
	bool "MURATA_1YN"
	help
	  Murata Type 1YN module based on Infineon CYW43439 combo chipset
	  which supports Wi-Fi® 802.11b/g/n + Bluetooth® 5.2 BR/EDR/LE
	  up to 65Mbps PHY data rate on Wi-fi® and 3Mbps PHY data rate on
	  Bluetooth®.

	  Detailed information about Murata Type 1YN module you can find on
	  https://www.murata.com/en-us/products/connectivitymodule/wi-fi-bluetooth/overview/lineup/type1yn

config CYW43439_STERLING_LWBPLUS
 bool "STERLING-LWBplus" if CYW43439 && !AIROC_WIFI_CUSTOM && WIFI_AIROC
	help
	  Ezurio Sterling-LWB+ WiFi 4 with Bluetooth 5.2 module
	  Detailed information about this module you can find on
	  https://www.ezurio.com/wireless-modules/wifi-modules-bluetooth/sterling-lwb-wifi-4-and-bluetooth-52-modules

endchoice

if CYW20829

config CYW20829_BT_FW_TX10DBM_POWER
	bool "CYW20829_BT_FW_TX10DBM_POWER"
	default y
	help
	  Enable 10dBm TX Power variant of CYW20829 FW patch.

choice
	prompt "Select variant of default CYW20829 BT FW"
	default CYW20829_BT_FW_ISOC_TX10 if BT_ISO &&  CYW20829_BT_FW_TX10DBM_POWER
	default CYW20829_BT_FW_ISOC_TX0  if BT_ISO && !CYW20829_BT_FW_TX10DBM_POWER
	default CYW20829_BT_FW_PAWR_TX10 if (BT_PER_ADV_RSP || BT_PER_ADV_SYNC_RSP) &&  CYW20829_BT_FW_TX10DBM_POWER
	default CYW20829_BT_FW_PAWR_TX0  if (BT_PER_ADV_RSP || BT_PER_ADV_SYNC_RSP) && !CYW20829_BT_FW_TX10DBM_POWER
	default CYW20829_BT_FW_TX10      if CYW20829_BT_FW_TX10DBM_POWER
	default CYW20829_BT_FW_TX0

config CYW20829_BT_FW_TX0
	bool "CYW20829_BT_FW_TX0"
	help
	  Enable CYW20829 FW patch for 0dBm TX Power.
	  This configuration should be used with non-PAWR and non-ISOC applications.

config CYW20829_BT_FW_TX10
	bool "CYW20829_BT_FW_TX10"
	help
	  Enable CYW20829 FW patch for 10dBm TX Power.
	  This configuration should be used with non-PAwR and non-ISOC applications.

config CYW20829_BT_FW_PAWR_TX0
	bool "CYW20829_BT_FW_PAWR_TX0"
	help
	  Enable CYW20829 FW patch with PAwR support for 0dBm TX Power.
	  This configuration should be used with PAwR applications.

config CYW20829_BT_FW_PAWR_TX10
	bool "CYW20829_BT_FW_PAWR_TX10"
	help
	  Enable CYW20829 FW patch for 10dBm TX Power.
	  This configuration should be used with PAwR applications.

config CYW20829_BT_FW_ISOC_TX0
	bool "CYW20829_BT_FW_ISOC_TX0"
	help
	  Enable CYW20829 FW patch for 0dBm TX Power.
	  This configuration should be used with ISOC applications.

config CYW20829_BT_FW_ISOC_TX10
	bool "CYW20829_BT_FW_ISOC_TX10"
	help
	  Enable CYW20829 FW patch for 10dBm TX Power.
	  This configuration should be used with ISOC applications.

endchoice
endif # CYW20829

config AIROC_CUSTOM_FIRMWARE_HCD_BLOB
	string  "Path to user BT firmware HCD file"
	help
	  Path to BT firmware HCD file for custom or vendor CYW43xx modules.
	  It can be absolute path, or relative from project folder.

config AIROC_AUTOBAUD_MODE
	bool "Autobaud mode"
	help
	  Use Autobaud feature of AIROC Controller for fast firmware download

	  Newer AIROC Controllers such as CYW555xx only allow firmware
	  upload in Download Mode after a Recovery Reset.
	  In Download Mode the Baud Rate vendor command cannot be used
	  initially. Instead, Autobaud mode allows to direct use a higher
	  baud rate.

	  Autobaud mode is not required on older AIROC controllers.

	  https://infineon.github.io/btsdk-docs/BT-SDK/AIROC-HCI-Firmware-Download.pdf


# Change size of command lengths. It for vendor commands related to
# firmware downloading.
config BT_BUF_CMD_TX_SIZE
	default $(UINT8_MAX)

endif # BT_AIROC

if BT_PSOC6_BLESS

config BT_PSOC6_BLESS_MAX_TX_PAYLOAD
	int "Max Tx payload size"
	range 27 251
	default 27

config BT_PSOC6_BLESS_MAX_RX_PAYLOAD
	int "Max Rx payload size"
	range 27 251
	default 27

endif # BT_PSOC6_BLESS
```

## transform_projects/transform_zrtos/ZRTOS_demo1_output/drivers/bluetooth/hci/Kconfig.nxp
```kconfig
#
# Copyright 2023-2025 NXP
#
# SPDX-License-Identifier: Apache-2.0
#

config HCI_NXP_ENABLE_AUTO_SLEEP
	bool "BLE Controller auto sleep mode"
	help
	  If enabled, the Controller auto sleep mode will be configured and enabled during HCI init.
	  Auto sleep mode means the Controller will handle its low power state automatically.
	  Enabling this feature will allow to save power at the cost of some latency when sending a HCI
	  message to the Controller as the Host will need to wake it up.

config HCI_NXP_SET_CAL_DATA
	bool "Bluetooth Controller calibration data"
	help
	  If enabled, the Host will send calibration data to the Bluetooth Controller during HCI init.

config HCI_NXP_SET_CAL_DATA_ANNEX100
	bool "Bluetooth Controller calibration data annex 100"
	help
	  If enabled, the Host will send calibration data annex 100 to the Bluetooth Controller during HCI
	  init.

config HCI_NXP_RX_THREAD
	bool "Process RX buffers in a dedicated thread"
	help
	  Some platforms receive the HCI RX buffers in ISR context.
	  If enabled, the HCI RX message is queued by the ISR, and the message is processed
	  in a dedicated thread.

if HCI_NXP_RX_THREAD

config HCI_NXP_RX_STACK_SIZE
	int "HCI RX stack size"
	default 512

config HCI_NXP_RX_MSG_QUEUE_SIZE
	int "HCI RX message queue size"
	default 4

config HEAP_MEM_POOL_ADD_SIZE_BT_NXP_RX_THREAD
	int
	default 768

endif

if BT_NXP

config BT_DIS_MANUF_NAME
	default y

config BT_DIS_MANUF_NAME_STR
	default "NXP"

config BT_HCI_ACL_FLOW_CONTROL
	default n

config BT_BUF_EVT_DISCARDABLE_SIZE
	default 84

config HEAP_MEM_POOL_ADD_SIZE_BT_NXP
	int
	default 256

config FLASH
	default y

endif # BT_NXP

if BT_H4_NXP_CTLR


endif # BT_H4_NXP_CTLR
```

## transform_projects/transform_zrtos/ZRTOS_demo1_output/drivers/pinctrl/renesas/Kconfig
```kconfig
# Copyright (c) 2024 EPAM Systems
# SPDX-License-Identifier: Apache-2.0

source "drivers/pinctrl/renesas/ra/Kconfig"
source "drivers/pinctrl/renesas/rcar/Kconfig"
source "drivers/pinctrl/renesas/rx/Kconfig"
source "drivers/pinctrl/renesas/rz/Kconfig"
source "drivers/pinctrl/renesas/smartbond/Kconfig"
```

## transform_projects/transform_zrtos/ZRTOS_demo1_output/drivers/reset/Kconfig
```kconfig
# Reset Controller driver configuration options

# Copyright (c) 2022 Andrei-Edward Popa <andrei.popa105@yahoo.com>
# SPDX-License-Identifier: Apache-2.0

#
# Reset Controller options
#
menuconfig RESET
	bool "Reset Controller drivers"
	help
	  Reset Controller drivers. Reset node represents a region containing
	  information about reset controller device. The typical use-case is
	  for some other node's drivers to acquire a reference to the reset
	  controller node together with some reset information.

if RESET

config RESET_INIT_PRIORITY
	int "Reset Controller driver init priority"
	default 35
	help
	  This option controls the priority of the reset controller device
	  initialization. Higher priority ensures that the device is
	  initialized earlier in the startup cycle. If unsure, leave at default
	  value

comment "Reset Controller Drivers"

source "drivers/reset/Kconfig.rpi_pico"
source "drivers/reset/Kconfig.gd32"
source "drivers/reset/Kconfig.aspeed"
source "drivers/reset/Kconfig.stm32"
source "drivers/reset/Kconfig.numaker"
source "drivers/reset/Kconfig.intel_socfpga"
source "drivers/reset/Kconfig.npcx"
source "drivers/reset/Kconfig.lpc_syscon"
source "drivers/reset/Kconfig.nxp_rstctl"
source "drivers/reset/Kconfig.mmio"
source "drivers/reset/Kconfig.mchp_mss"

endif # RESET
```

## transform_projects/transform_zrtos/ZRTOS_demo1_output/drivers/stepper/Kconfig
```kconfig
# SPDX-FileCopyrightText: Copyright (c) 2023 Carl Zeiss Meditec AG
# SPDX-License-Identifier: Apache-2.0

menuconfig STEPPER
	bool "Stepper Controller"
	help
	  Enable stepper controller

if STEPPER

module = STEPPER
module-str = stepper
source "subsys/logging/Kconfig.template.log_config"

config STEPPER_INIT_PRIORITY
	int "Stepper Motor Controller init priority"
	default 90
	help
	  Stepper motor controller initialization priority.

config STEPPER_SHELL
	bool "Stepper shell"
	depends on SHELL
	help
	  Enable stepper shell for testing.

comment "Stepper Driver Common"

source "drivers/stepper/step_dir/Kconfig"

comment "Stepper Drivers"

# zephyr-keep-sorted-start
source "drivers/stepper/Kconfig.fake"
source "drivers/stepper/Kconfig.gpio"
source "drivers/stepper/adi_tmc/Kconfig"
source "drivers/stepper/allegro/Kconfig"
source "drivers/stepper/ti/Kconfig"
# zephyr-keep-sorted-stop

endif
```

## transform_projects/transform_zrtos/ZRTOS_demo1_output/drivers/stepper/ti/Kconfig
```kconfig
# SPDX-FileCopyrightText: Copyright (c) 2024 Navimatix GmbH
# SPDX-License-Identifier: Apache-2.0

config STEPPER_TI
	bool
	depends on STEPPER

source "drivers/stepper/ti/Kconfig.drv84xx"
```
