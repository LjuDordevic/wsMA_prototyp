## transform_projects/transform_zrtos/ZRTOS_demo1_output/soc/snps/nsim/arc_classic/hs/Kconfig.defconfig
```kconfig
# Copyright (c) 2024 Synopsys, Inc.
# SPDX-License-Identifier: Apache-2.0

if SOC_SERIES_NSIM_HS

source "soc/snps/nsim/arc_classic/hs/Kconfig.defconfig.hs"
source "soc/snps/nsim/arc_classic/hs/Kconfig.defconfig.hs5x"
source "soc/snps/nsim/arc_classic/hs/Kconfig.defconfig.hs5x_smp"
source "soc/snps/nsim/arc_classic/hs/Kconfig.defconfig.hs6x"
source "soc/snps/nsim/arc_classic/hs/Kconfig.defconfig.hs6x_smp"
source "soc/snps/nsim/arc_classic/hs/Kconfig.defconfig.hs_mpuv6"
source "soc/snps/nsim/arc_classic/hs/Kconfig.defconfig.hs_smp"

endif # SOC_SERIES_NSIM_HS
```

## transform_projects/transform_zrtos/ZRTOS_demo1_output/soc/snps/nsim/arc_v/Kconfig
```kconfig
# Copyright (c) 2024 Synopsys, Inc.
# SPDX-License-Identifier: Apache-2.0

if SOC_FAMILY_NSIM_ARC_V

source "soc/snps/nsim/arc_v/rmx/Kconfig"

endif # SOC_FAMILY_NSIM_ARC_V
```

## transform_projects/transform_zrtos/ZRTOS_demo1_output/soc/st/stm32/stm32c0x/Kconfig.defconfig
```kconfig
# STMicroelectronics STM32C0 MCU line

# Copyright (c) 2023 Benjamin Björnsson <benjamin.bjornsson@gmail.com>
# SPDX-License-Identifier: Apache-2.0

if SOC_SERIES_STM32C0X

source "soc/st/stm32/stm32c0x/Kconfig.defconfig.stm32c011xx"
source "soc/st/stm32/stm32c0x/Kconfig.defconfig.stm32c031xx"
source "soc/st/stm32/stm32c0x/Kconfig.defconfig.stm32c071xx"

endif # SOC_SERIES_STM32C0X
```

## transform_projects/transform_zrtos/ZRTOS_demo1_output/soc/st/stm32/stm32f0x/Kconfig.defconfig
```kconfig
# ST Microelectronics STM32F0 MCU line

# Copyright (c) 2017 RnDity Sp. z o.o.
# SPDX-License-Identifier: Apache-2.0

# Kconfig symbols common to STM32F0 series

if SOC_SERIES_STM32F0X

source "soc/st/stm32/stm32f0x/Kconfig.defconfig.stm32f030x4"
source "soc/st/stm32/stm32f0x/Kconfig.defconfig.stm32f030x6"
source "soc/st/stm32/stm32f0x/Kconfig.defconfig.stm32f030x8"
source "soc/st/stm32/stm32f0x/Kconfig.defconfig.stm32f030xc"
source "soc/st/stm32/stm32f0x/Kconfig.defconfig.stm32f031x6"
source "soc/st/stm32/stm32f0x/Kconfig.defconfig.stm32f042x6"
source "soc/st/stm32/stm32f0x/Kconfig.defconfig.stm32f051x8"
source "soc/st/stm32/stm32f0x/Kconfig.defconfig.stm32f070xb"
source "soc/st/stm32/stm32f0x/Kconfig.defconfig.stm32f072xx"
source "soc/st/stm32/stm32f0x/Kconfig.defconfig.stm32f091xc"
source "soc/st/stm32/stm32f0x/Kconfig.defconfig.stm32f098xx"

config SRAM_VECTOR_TABLE
	default y

# adjust the fallback because of the LSI oscillator characteristics
config TASK_WDT_HW_FALLBACK_DELAY
	depends on TASK_WDT_HW_FALLBACK
	default 100

endif # SOC_SERIES_STM32F0X
```

## transform_projects/transform_zrtos/ZRTOS_demo1_output/soc/st/stm32/stm32f2x/Kconfig.defconfig
```kconfig
# STMicroelectronics STM32F2 MCU line

# Copyright (c) 2018 qianfan Zhao <qianfanguijin@163.com>
# SPDX-License-Identifier: Apache-2.0

# Kconfig symbols common to STM32F2 series

if SOC_SERIES_STM32F2X

source "soc/st/stm32/stm32f2x/Kconfig.defconfig.stm32f205xx"
source "soc/st/stm32/stm32f2x/Kconfig.defconfig.stm32f207xx"

endif # SOC_SERIES_STM32F2X
```

## transform_projects/transform_zrtos/ZRTOS_demo1_output/soc/st/stm32/stm32f3x/Kconfig.defconfig
```kconfig
# STMicroelectronics STM32F3 MCU line

# Copyright (c) 2016 RnDity Sp. z o.o.
# SPDX-License-Identifier: Apache-2.0

# Kconfig symbols common to STM32F3 series

if SOC_SERIES_STM32F3X

source "soc/st/stm32/stm32f3x/Kconfig.defconfig.stm32f302x8"
source "soc/st/stm32/stm32f3x/Kconfig.defconfig.stm32f302xc"
source "soc/st/stm32/stm32f3x/Kconfig.defconfig.stm32f303x(b-c)"
source "soc/st/stm32/stm32f3x/Kconfig.defconfig.stm32f303x8"
source "soc/st/stm32/stm32f3x/Kconfig.defconfig.stm32f303xe"
source "soc/st/stm32/stm32f3x/Kconfig.defconfig.stm32f334x8"
source "soc/st/stm32/stm32f3x/Kconfig.defconfig.stm32f373xc"

endif # SOC_SERIES_STM32F3X
```

## transform_projects/transform_zrtos/ZRTOS_demo1_output/soc/st/stm32/stm32f4x/Kconfig.defconfig
```kconfig
# STMicroelectronics STM32F4 MCU line

# Copyright (c) 2016 Linaro Limited
# SPDX-License-Identifier: Apache-2.0

# Kconfig symbols common to STM32F4 series

if SOC_SERIES_STM32F4X

source "soc/st/stm32/stm32f4x/Kconfig.defconfig.stm32f401xc"
source "soc/st/stm32/stm32f4x/Kconfig.defconfig.stm32f401xd"
source "soc/st/stm32/stm32f4x/Kconfig.defconfig.stm32f401xe"
source "soc/st/stm32/stm32f4x/Kconfig.defconfig.stm32f405xx"
source "soc/st/stm32/stm32f4x/Kconfig.defconfig.stm32f407xx"
source "soc/st/stm32/stm32f4x/Kconfig.defconfig.stm32f410xx"
source "soc/st/stm32/stm32f4x/Kconfig.defconfig.stm32f411xe"
source "soc/st/stm32/stm32f4x/Kconfig.defconfig.stm32f412rx"
source "soc/st/stm32/stm32f4x/Kconfig.defconfig.stm32f412xx"
source "soc/st/stm32/stm32f4x/Kconfig.defconfig.stm32f413xx"
source "soc/st/stm32/stm32f4x/Kconfig.defconfig.stm32f415xx"
source "soc/st/stm32/stm32f4x/Kconfig.defconfig.stm32f417xx"
source "soc/st/stm32/stm32f4x/Kconfig.defconfig.stm32f423xx"
source "soc/st/stm32/stm32f4x/Kconfig.defconfig.stm32f427xx"
source "soc/st/stm32/stm32f4x/Kconfig.defconfig.stm32f429xx"
source "soc/st/stm32/stm32f4x/Kconfig.defconfig.stm32f437xx"
source "soc/st/stm32/stm32f4x/Kconfig.defconfig.stm32f439xx"
source "soc/st/stm32/stm32f4x/Kconfig.defconfig.stm32f446xx"
source "soc/st/stm32/stm32f4x/Kconfig.defconfig.stm32f469xx"
source "soc/st/stm32/stm32f4x/Kconfig.defconfig.stm32f479xx"

# adjust the fallback because of the LSI oscaillator characteristics
config TASK_WDT_HW_FALLBACK_DELAY
	depends on TASK_WDT_HW_FALLBACK
	default 200

if PM

config COUNTER
	default y

config COUNTER_RTC_STM32_SUBSECONDS
	default y if DT_HAS_ST_STM32_RTC_ENABLED

config IDLE_STACK_SIZE
	default 512

endif # PM

endif # SOC_SERIES_STM32F4X
```

## transform_projects/transform_zrtos/ZRTOS_demo1_output/soc/st/stm32/stm32f7x/Kconfig.defconfig
```kconfig
# ST Microelectronics STM32F7 MCU line

# Copyright (c) 2018 Yurii Hamann
# SPDX-License-Identifier: Apache-2.0

# Kconfig symbols common to STM32F7 series

if SOC_SERIES_STM32F7X

source "soc/st/stm32/stm32f7x/Kconfig.defconfig.stm32f722xx"
source "soc/st/stm32/stm32f7x/Kconfig.defconfig.stm32f723xx"
source "soc/st/stm32/stm32f7x/Kconfig.defconfig.stm32f745xx"
source "soc/st/stm32/stm32f7x/Kconfig.defconfig.stm32f746xx"
source "soc/st/stm32/stm32f7x/Kconfig.defconfig.stm32f750xx"
source "soc/st/stm32/stm32f7x/Kconfig.defconfig.stm32f756xx"
source "soc/st/stm32/stm32f7x/Kconfig.defconfig.stm32f765xx"
source "soc/st/stm32/stm32f7x/Kconfig.defconfig.stm32f767xx"
source "soc/st/stm32/stm32f7x/Kconfig.defconfig.stm32f769xx"

endif # SOC_SERIES_STM32F7X
```

## transform_projects/transform_zrtos/ZRTOS_demo1_output/soc/st/stm32/stm32g0x/Kconfig.defconfig
```kconfig
# STMicroelectronics STM32G0 MCU line

# Copyright (c) 2019 Philippe Retornaz <philippe@shapescale.com>
# Copyright (c) 2019 STMicroelectronics
# Copyright (c) 2021 G-Technologies Sdn. Bhd.
# SPDX-License-Identifier: Apache-2.0

if SOC_SERIES_STM32G0X

source "soc/st/stm32/stm32g0x/Kconfig.defconfig.stm32g030xx"
source "soc/st/stm32/stm32g0x/Kconfig.defconfig.stm32g031xx"
source "soc/st/stm32/stm32g0x/Kconfig.defconfig.stm32g041xx"
source "soc/st/stm32/stm32g0x/Kconfig.defconfig.stm32g050xx"
source "soc/st/stm32/stm32g0x/Kconfig.defconfig.stm32g051xx"
source "soc/st/stm32/stm32g0x/Kconfig.defconfig.stm32g061xx"
source "soc/st/stm32/stm32g0x/Kconfig.defconfig.stm32g070xx"
source "soc/st/stm32/stm32g0x/Kconfig.defconfig.stm32g071xx"
source "soc/st/stm32/stm32g0x/Kconfig.defconfig.stm32g081xx"
source "soc/st/stm32/stm32g0x/Kconfig.defconfig.stm32g0b0xx"
source "soc/st/stm32/stm32g0x/Kconfig.defconfig.stm32g0b1xx"
source "soc/st/stm32/stm32g0x/Kconfig.defconfig.stm32g0c1xx"

if UART_STM32


config SHARED_INTERRUPTS
	# LPUART1 - USART3/4/5/6 : irq 29
	default y if $(dt_nodelabel_enabled,usart3) && $(dt_nodelabel_enabled,usart4)
	default y if $(dt_nodelabel_enabled,usart3) && $(dt_nodelabel_enabled,usart5)
	default y if $(dt_nodelabel_enabled,usart3) && $(dt_nodelabel_enabled,usart6)
	default y if $(dt_nodelabel_enabled,usart3) && $(dt_nodelabel_enabled,lpuart1)
	default y if $(dt_nodelabel_enabled,usart4) && $(dt_nodelabel_enabled,usart5)
	default y if $(dt_nodelabel_enabled,usart4) && $(dt_nodelabel_enabled,usart6)
	default y if $(dt_nodelabel_enabled,usart4) && $(dt_nodelabel_enabled,lpuart1)
	default y if $(dt_nodelabel_enabled,usart5) && $(dt_nodelabel_enabled,usart6)
	default y if $(dt_nodelabel_enabled,usart5) && $(dt_nodelabel_enabled,lpuart1)
	default y if $(dt_nodelabel_enabled,usart6) && $(dt_nodelabel_enabled,lpuart1)
	# USART2 - LPUART2 : irq 28
	default y if $(dt_nodelabel_enabled,lpuart2) && $(dt_nodelabel_enabled,usart2)

endif # UART_STM32

endif # SOC_SERIES_STM32G0X
```

## transform_projects/transform_zrtos/ZRTOS_demo1_output/soc/st/stm32/stm32g4x/Kconfig.defconfig
```kconfig
# STMicroelectronics STM32G4 MCU line

# Copyright (c) 2019 Richard Osterloh <richard.osterloh@gmail.com>
# SPDX-License-Identifier: Apache-2.0

if SOC_SERIES_STM32G4X

source "soc/st/stm32/stm32g4x/Kconfig.defconfig.stm32g431xx"
source "soc/st/stm32/stm32g4x/Kconfig.defconfig.stm32g441xx"
source "soc/st/stm32/stm32g4x/Kconfig.defconfig.stm32g473xx"
source "soc/st/stm32/stm32g4x/Kconfig.defconfig.stm32g474xx"
source "soc/st/stm32/stm32g4x/Kconfig.defconfig.stm32g483xx"
source "soc/st/stm32/stm32g4x/Kconfig.defconfig.stm32g484xx"
source "soc/st/stm32/stm32g4x/Kconfig.defconfig.stm32g491xx"
source "soc/st/stm32/stm32g4x/Kconfig.defconfig.stm32g4a1xx"

if PM
config PM_DEVICE
	default y

config STM32_LPTIM_TIMER
	default y
endif # PM

endif # SOC_SERIES_STM32G4X
```

## transform_projects/transform_zrtos/ZRTOS_demo1_output/soc/st/stm32/stm32h5x/Kconfig.defconfig
```kconfig
# ST Microelectronics STM32H5 MCU line

# Copyright (c) 2023 STMicroelectronics
# SPDX-License-Identifier: Apache-2.0

if SOC_SERIES_STM32H5X

source "soc/st/stm32/stm32h5x/Kconfig.defconfig.stm32h503xx"
source "soc/st/stm32/stm32h5x/Kconfig.defconfig.stm32h533xx"
source "soc/st/stm32/stm32h5x/Kconfig.defconfig.stm32h562xx"
source "soc/st/stm32/stm32h5x/Kconfig.defconfig.stm32h563xx"
source "soc/st/stm32/stm32h5x/Kconfig.defconfig.stm32h573xx"

config ICACHE
	default y

config DCACHE
	default y if !SOC_STM32H503XX

config CACHE_MANAGEMENT
	default y

choice
	default EXTERNAL_CACHE
endchoice
endchoice

config ROM_START_OFFSET
	default 0x400 if BOOTLOADER_MCUBOOT

endif # SOC_SERIES_STM32H5X
```

## transform_projects/transform_zrtos/ZRTOS_demo1_output/soc/st/stm32/stm32h7x/Kconfig.defconfig
```kconfig
# ST Microelectronics STM32H7 MCU line

# Copyright (c) 2019 Linaro  Limited
# Copyright (c) 2022 SILA Embedded Solutions GmbH <office@embedded-solutions.at>
# SPDX-License-Identifier: Apache-2.0

# Kconfig symbols common to STM32H7 series

if SOC_SERIES_STM32H7X

source "soc/st/stm32/stm32h7x/Kconfig.defconfig.stm32h723xx"
source "soc/st/stm32/stm32h7x/Kconfig.defconfig.stm32h725xx"
source "soc/st/stm32/stm32h7x/Kconfig.defconfig.stm32h730xx"
source "soc/st/stm32/stm32h7x/Kconfig.defconfig.stm32h735xx"
source "soc/st/stm32/stm32h7x/Kconfig.defconfig.stm32h742xx"
source "soc/st/stm32/stm32h7x/Kconfig.defconfig.stm32h743xx"
source "soc/st/stm32/stm32h7x/Kconfig.defconfig.stm32h745xx"
source "soc/st/stm32/stm32h7x/Kconfig.defconfig.stm32h747xx"
source "soc/st/stm32/stm32h7x/Kconfig.defconfig.stm32h750xx"
source "soc/st/stm32/stm32h7x/Kconfig.defconfig.stm32h753xx"
source "soc/st/stm32/stm32h7x/Kconfig.defconfig.stm32h755xx"
source "soc/st/stm32/stm32h7x/Kconfig.defconfig.stm32h757xx"
source "soc/st/stm32/stm32h7x/Kconfig.defconfig.stm32h7a3xx"
source "soc/st/stm32/stm32h7x/Kconfig.defconfig.stm32h7b0xx"
source "soc/st/stm32/stm32h7x/Kconfig.defconfig.stm32h7b3xx"

config ROM_START_OFFSET
	default 0x400 if BOOTLOADER_MCUBOOT
	default 0x0   if !BOOTLOADER_MCUBOOT

if LVGL

config LV_DRAW_DMA2D_HAL_INCLUDE
	default "stm32h7xx.h"

endif # LVGL

endif # SOC_SERIES_STM32H7X
```

## transform_projects/transform_zrtos/ZRTOS_demo1_output/soc/st/stm32/stm32l0x/Kconfig.defconfig
```kconfig
# ST Microelectronics STM32L0 MCU line

# Copyright (c) 2018 Endre Karlson <endre.karlson@gmail.com>
# SPDX-License-Identifier: Apache-2.0

# Kconfig symbols common to STM32L0 series

if SOC_SERIES_STM32L0X

source "soc/st/stm32/stm32l0x/Kconfig.defconfig.stm32l010x4"
source "soc/st/stm32/stm32l0x/Kconfig.defconfig.stm32l010x6"
source "soc/st/stm32/stm32l0x/Kconfig.defconfig.stm32l010x8"
source "soc/st/stm32/stm32l0x/Kconfig.defconfig.stm32l010xb"
source "soc/st/stm32/stm32l0x/Kconfig.defconfig.stm32l011xx"
source "soc/st/stm32/stm32l0x/Kconfig.defconfig.stm32l031xx"
source "soc/st/stm32/stm32l0x/Kconfig.defconfig.stm32l051xx"
source "soc/st/stm32/stm32l0x/Kconfig.defconfig.stm32l053xx"
source "soc/st/stm32/stm32l0x/Kconfig.defconfig.stm32l071xx"
source "soc/st/stm32/stm32l0x/Kconfig.defconfig.stm32l072xx"
source "soc/st/stm32/stm32l0x/Kconfig.defconfig.stm32l073xx"
source "soc/st/stm32/stm32l0x/Kconfig.defconfig.stm32l081xx"

# adjust the fallback because of the LSI oscillator characteristics
config TASK_WDT_HW_FALLBACK_DELAY
	depends on TASK_WDT_HW_FALLBACK
	default 200

endif # SOC_SERIES_STM32L0X
```

## transform_projects/transform_zrtos/ZRTOS_demo1_output/soc/st/stm32/stm32l1x/Kconfig.defconfig
```kconfig
# STMicroelectronics STM32L1 MCU line

# Copyright (c) 2019 Linaro Ltd.
# SPDX-License-Identifier: Apache-2.0

if SOC_SERIES_STM32L1X

source "soc/st/stm32/stm32l1x/Kconfig.defconfig.stm32l100xb"
source "soc/st/stm32/stm32l1x/Kconfig.defconfig.stm32l151xb"
source "soc/st/stm32/stm32l1x/Kconfig.defconfig.stm32l151xba"
source "soc/st/stm32/stm32l1x/Kconfig.defconfig.stm32l151xc"
source "soc/st/stm32/stm32l1x/Kconfig.defconfig.stm32l152xc"
source "soc/st/stm32/stm32l1x/Kconfig.defconfig.stm32l152xe"

# adjust the fallback because of the LSI oscaillator characteristics
config TASK_WDT_HW_FALLBACK_DELAY
	depends on TASK_WDT_HW_FALLBACK
	default 200

endif # SOC_SERIES_STM32L1X
```

## transform_projects/transform_zrtos/ZRTOS_demo1_output/soc/st/stm32/stm32l4x/Kconfig.defconfig
```kconfig
# ST Microelectronics STM32L4 MCU line

# Copyright (c) 2016 Open-RnD Sp. z o.o.
# Copyright (c) 2016 BayLibre, SAS
# SPDX-License-Identifier: Apache-2.0

# Kconfig symbols common to STM32L4 series

if SOC_SERIES_STM32L4X

source "soc/st/stm32/stm32l4x/Kconfig.defconfig.stm32l412xx"
source "soc/st/stm32/stm32l4x/Kconfig.defconfig.stm32l422xx"
source "soc/st/stm32/stm32l4x/Kconfig.defconfig.stm32l431xx"
source "soc/st/stm32/stm32l4x/Kconfig.defconfig.stm32l432xx"
source "soc/st/stm32/stm32l4x/Kconfig.defconfig.stm32l433xx"
source "soc/st/stm32/stm32l4x/Kconfig.defconfig.stm32l451xx"
source "soc/st/stm32/stm32l4x/Kconfig.defconfig.stm32l452xx"
source "soc/st/stm32/stm32l4x/Kconfig.defconfig.stm32l462xx"
source "soc/st/stm32/stm32l4x/Kconfig.defconfig.stm32l471xx"
source "soc/st/stm32/stm32l4x/Kconfig.defconfig.stm32l475xx"
source "soc/st/stm32/stm32l4x/Kconfig.defconfig.stm32l476xx"
source "soc/st/stm32/stm32l4x/Kconfig.defconfig.stm32l486xx"
source "soc/st/stm32/stm32l4x/Kconfig.defconfig.stm32l496xx"
source "soc/st/stm32/stm32l4x/Kconfig.defconfig.stm32l4a6xx"
source "soc/st/stm32/stm32l4x/Kconfig.defconfig.stm32l4p5xx"
source "soc/st/stm32/stm32l4x/Kconfig.defconfig.stm32l4q5xx"
source "soc/st/stm32/stm32l4x/Kconfig.defconfig.stm32l4r5xx"
source "soc/st/stm32/stm32l4x/Kconfig.defconfig.stm32l4r9xx"
source "soc/st/stm32/stm32l4x/Kconfig.defconfig.stm32l4s5xx"

endif # SOC_SERIES_STM32L4X
```

## transform_projects/transform_zrtos/ZRTOS_demo1_output/soc/st/stm32/stm32l5x/Kconfig.defconfig
```kconfig
# ST Microelectronics STM32L5 MCU line

# Copyright (c) 2020 Linaro Limited
# SPDX-License-Identifier: Apache-2.0

if SOC_SERIES_STM32L5X

source "soc/st/stm32/stm32l5x/Kconfig.defconfig.stm32l552xx"
source "soc/st/stm32/stm32l5x/Kconfig.defconfig.stm32l562xx"

config ICACHE
	default y

config CACHE_MANAGEMENT
	default y


config ROM_START_OFFSET
	default 0x400 if BOOTLOADER_MCUBOOT

endif # SOC_SERIES_STM32L5X
```
