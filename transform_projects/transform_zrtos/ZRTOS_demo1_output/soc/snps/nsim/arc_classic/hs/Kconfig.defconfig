## transform_projects/transform_zrtos/ZRTOS_demo1_output/soc/st/stm32/stm32mp1x/Kconfig.defconfig
```kconfig
# STMicroelectronics STM32MP1 MCU/MPU line

# Copyright (c) 2019 STMicroelectronics
# SPDX-License-Identifier: Apache-2.0

if SOC_SERIES_STM32MP1X

source "soc/st/stm32/stm32mp1x/Kconfig.defconfig.stm32mp15_m4"

endif # SOC_SERIES_STM32MP1X
```

## transform_projects/transform_zrtos/ZRTOS_demo1_output/soc/st/stm32/stm32mp2x/Kconfig.defconfig
```kconfig
# STMicroelectronics STM32MP2 MPU series
#
# Copyright (C) 2025 Savoir-faire Linux, Inc.
# SPDX-License-Identifier: Apache-2.0

if SOC_SERIES_STM32MP2X

source "soc/st/stm32/stm32mp2x/Kconfig.defconfig.stm32mp257fxx"

endif # SOC_SERIES_STM32MP2X
```

## transform_projects/transform_zrtos/ZRTOS_demo1_output/soc/st/stm32/stm32u0x/Kconfig.defconfig
```kconfig
# ST Microelectronics STM32U0 MCU line

# Copyright (c) 2024 STMicroelectronics
# SPDX-License-Identifier: Apache-2.0

if SOC_SERIES_STM32U0X

source "soc/st/stm32/stm32u0x/Kconfig.defconfig.stm32u031xx"
source "soc/st/stm32/stm32u0x/Kconfig.defconfig.stm32u073xx"
source "soc/st/stm32/stm32u0x/Kconfig.defconfig.stm32u083xx"

if I2C_STM32

config SHARED_INTERRUPTS
	default y if $(dt_nodelabel_enabled,i2c2) && $(dt_nodelabel_enabled,i2c3)
	default y if $(dt_nodelabel_enabled,i2c2) && $(dt_nodelabel_enabled,i2c4)
	default y if $(dt_nodelabel_enabled,i2c3) && $(dt_nodelabel_enabled,i2c4)

endif # I2C_STM32

endif # SOC_SERIES_STM32U0X
```

## transform_projects/transform_zrtos/ZRTOS_demo1_output/soc/st/stm32/stm32u5x/Kconfig.defconfig
```kconfig
# ST Microelectronics STM32U5 MCU line

# Copyright (c) 2021 Linaro Limited
# SPDX-License-Identifier: Apache-2.0

if SOC_SERIES_STM32U5X

source "soc/st/stm32/stm32u5x/Kconfig.defconfig.stm32u535xx"
source "soc/st/stm32/stm32u5x/Kconfig.defconfig.stm32u545xx"
source "soc/st/stm32/stm32u5x/Kconfig.defconfig.stm32u575xx"
source "soc/st/stm32/stm32u5x/Kconfig.defconfig.stm32u585xx"
source "soc/st/stm32/stm32u5x/Kconfig.defconfig.stm32u595xx"
source "soc/st/stm32/stm32u5x/Kconfig.defconfig.stm32u599xx"
source "soc/st/stm32/stm32u5x/Kconfig.defconfig.stm32u5a5xx"
source "soc/st/stm32/stm32u5x/Kconfig.defconfig.stm32u5a9xx"
source "soc/st/stm32/stm32u5x/Kconfig.defconfig.stm32u5f9xx"
source "soc/st/stm32/stm32u5x/Kconfig.defconfig.stm32u5g9xx"

config ROM_START_OFFSET
	default 0x400 if BOOTLOADER_MCUBOOT

config ICACHE
	default y

config DCACHE
	default y

config CACHE_MANAGEMENT
	default y


if STM32_STOP3_LP_MODE

config COUNTER
	default y

config COUNTER_RTC_STM32_SUBSECONDS
	default y

config STM32_LPTIM_STDBY_TIMER
	default y

config TICKLESS_KERNEL
	default y

config COUNTER_RTC_STM32_SAVE_VALUE_BETWEEN_RESETS
	default y

config IDLE_STACK_SIZE
	default 512

endif #STM32_USE_STOP3

endif # SOC_SERIES_STM32U5X
```

## transform_projects/transform_zrtos/ZRTOS_demo1_output/soc/st/stm32/stm32wbax/Kconfig.defconfig
```kconfig
# ST Microelectronics STM32WBA MCU line

# Copyright (c) 2023 STMicroelectronics
# SPDX-License-Identifier: Apache-2.0

if SOC_SERIES_STM32WBAX

source "soc/st/stm32/stm32wbax/Kconfig.defconfig.stm32wba52xx"
source "soc/st/stm32/stm32wbax/Kconfig.defconfig.stm32wba55xx"
source "soc/st/stm32/stm32wbax/Kconfig.defconfig.stm32wba65xx"

config ICACHE
	default y

config CACHE_MANAGEMENT
	default y

config STM32_LPTIM_TIMER
	default y if PM

config STM32_FLASH_PREFETCH
	default y

config BT_STM32WBA
	select DYNAMIC_INTERRUPTS
	select DYNAMIC_DIRECT_INTERRUPTS
	select ENTROPY_GENERATOR
	select USE_STM32_HAL_RAMCFG

if BT_STM32WBA

choice
	default NEWLIB_LIBC
endchoice
config MINIMAL_LIBC
	bool "Minimal C library"
	depends on !REQUIRES_FULL_LIBC
	depends on MINIMAL_LIBC_SUPPORTED
	imply COMPILER_FREESTANDING
	select COMMON_LIBC_ABORT
	select COMMON_LIBC_STRNLEN
	imply COMMON_LIBC_MALLOC
	imply COMMON_LIBC_CALLOC
	imply COMMON_LIBC_REALLOCARRAY
	imply COMMON_LIBC_TIME
	help
	  Build with minimal C library.

config PICOLIBC
	bool "Picolibc library"
	select COMMON_LIBC_ABORT
	imply THREAD_LOCAL_STORAGE if ARCH_HAS_THREAD_LOCAL_STORAGE && TOOLCHAIN_SUPPORTS_THREAD_LOCAL_STORAGE
	select LIBC_ERRNO if THREAD_LOCAL_STORAGE
	select NEED_LIBC_MEM_PARTITION
	select TC_PROVIDES_POSIX_C_LANG_SUPPORT_R
	imply COMMON_LIBC_MALLOC
	imply COMMON_LIBC_ABORT
	imply COMMON_LIBC_TIME
	depends on PICOLIBC_SUPPORTED
	help
	  Build with picolibc library. The picolibc library is built as
	  a module if PICOLIBC_MODULE is set, otherwise picolibc is
	  expected to be provided by the toolchain.

config NEWLIB_LIBC
	bool "Newlib C library"
	select COMMON_LIBC_ABORT
	depends on NEWLIB_LIBC_SUPPORTED
	select NEED_LIBC_MEM_PARTITION
	select TC_PROVIDES_POSIX_C_LANG_SUPPORT_R
	imply POSIX_DEVICE_IO_ALIAS_CLOSE
	imply POSIX_DEVICE_IO_ALIAS_OPEN
	imply POSIX_DEVICE_IO_ALIAS_READ
	imply POSIX_DEVICE_IO_ALIAS_WRITE
	imply POSIX_FD_MGMT_ALIAS_LSEEK
	imply POSIX_FILE_SYSTEM_ALIAS_FSTAT
	imply POSIX_MULTI_PROCESS_ALIAS_GETPID
	imply POSIX_SIGNALS_ALIAS_KILL
	imply COMMON_LIBC_TIME
	help
	  Build with newlib library. The newlib library is expected to be
	  part of the SDK in this case.

config ARCMWDT_LIBC
	bool "ARC MWDT C library"
	depends on !NATIVE_APPLICATION
	depends on "$(ZEPHYR_TOOLCHAIN_VARIANT)" = "arcmwdt"
	select STATIC_INIT_GNU
	help
	  C library provided by ARC MWDT toolchain.

config EXTERNAL_LIBC
	bool "External C library"
	help
	  Build with external/user provided C library.

config IAR_LIBC
	bool "IAR C Runtime Library"
	depends on IAR_LIBC_SUPPORTED
	depends on "$(ZEPHYR_TOOLCHAIN_VARIANT)" = "iar"
	select COMMON_LIBC_STRNLEN
	select COMMON_LIBC_TIME
	help
	  Use the full IAR Compiler runtime libraries.
	  A reduced Zephyr minimal libc will be used for library functionality
	  not provided by the IAR C Runtime Library.

endchoice

choice
	default LINKER_ORPHAN_SECTION_PLACE
endchoice
config LINKER_ORPHAN_SECTION_PLACE
	bool "Place"
	help
	  Linker puts orphan sections in place without warnings
	  or errors.

config LINKER_ORPHAN_SECTION_WARN
	bool "Warn"
	help
	  Linker places the orphan sections in output and issues
	  warning about those sections.

config LINKER_ORPHAN_SECTION_ERROR
	bool "Error"
	help
	  Linker exits with error when an orphan section is found.

endchoice

config ENTROPY_STM32_CLK_CHECK
	default n

config FPU
	default y

config SYSTEM_WORKQUEUE_STACK_SIZE
	default 2048

endif

if PM_S2RAM

config COUNTER
	default y

config COUNTER_RTC_STM32_SUBSECONDS
	default y

config STM32_LPTIM_STDBY_TIMER
	default y

config TICKLESS_KERNEL
	default y

config COUNTER_RTC_STM32_SAVE_VALUE_BETWEEN_RESETS
	default y

config IDLE_STACK_SIZE
	default 512

endif

endif # SOC_SERIES_STM32WBAX
```

## transform_projects/transform_zrtos/ZRTOS_demo1_output/soc/st/stm32/stm32wlx/Kconfig.defconfig
```kconfig
# STMicroelectronics STM32WL MCU line

# Copyright (c) 2020 STMicroelectronics.
# SPDX-License-Identifier: Apache-2.0

if SOC_SERIES_STM32WLX

source "soc/st/stm32/stm32wlx/Kconfig.defconfig.stm32wl54xx"
source "soc/st/stm32/stm32wlx/Kconfig.defconfig.stm32wl55xx"
source "soc/st/stm32/stm32wlx/Kconfig.defconfig.stm32wle4xx"
source "soc/st/stm32/stm32wlx/Kconfig.defconfig.stm32wle5xx"

endif # SOC_SERIES_STM32WLX
```

## transform_projects/transform_zrtos/ZRTOS_demo1_output/soc/ti/k3/Kconfig.defconfig
```kconfig
# Copyright (c) 2024 Nordic Semiconductor ASA
# SPDX-License-Identifier: Apache-2.0

if SOC_FAMILY_TI_K3

source "soc/ti/k3/am6x/Kconfig.defconfig"

endif # SOC_FAMILY_TI_K3
```

## transform_projects/transform_zrtos/ZRTOS_demo1_output/soc/ti/k3/Kconfig.soc
```kconfig
# Copyright (c) 2024 Nordic Semiconductor ASA
# SPDX-License-Identifier: Apache-2.0

config SOC_FAMILY_TI_K3
	bool

config SOC_FAMILY
	default "ti_k3" if SOC_FAMILY_TI_K3

source "soc/ti/k3/am6x/Kconfig.soc"
```

## transform_projects/transform_zrtos/ZRTOS_demo1_output/soc/ti/k3/am6x/Kconfig.defconfig
```kconfig
# Copyright (c) 2023 Enphase Energy
# SPDX-License-Identifier: Apache-2.0

if SOC_SERIES_AM6X

config KERNEL_ENTRY
	default "_vector_table" if SOC_SERIES_AM6X_R5

# Workaround for not being able to have commas in macro arguments
DT_CHOSEN_Z_FLASH := zephyr,flash

config FLASH_SIZE
	default $(dt_chosen_reg_size_int,$(DT_CHOSEN_Z_FLASH),0,K)

config FLASH_BASE_ADDRESS
	default $(dt_chosen_reg_addr_hex,$(DT_CHOSEN_Z_FLASH))

config NUM_IRQS
	default 64 if SOC_SERIES_AM6X_M4
	default 280 if SOC_SERIES_AM6X_A53
	default 512 if SOC_SERIES_AM6X_R5

config SYS_CLOCK_HW_CYCLES_PER_SEC
	default 400000000 if SOC_SERIES_AM6X_M4
	default 200000000 if SOC_SERIES_AM6X_A53
	default 19200000 if SOC_SERIES_AM6X_R5

if SERIAL

config UART_NS16550
	default y

config UART_NS16550_TI_K3
	default y if SOC_SERIES_AM6X_M4
	default y if SOC_SERIES_AM6X_R5

choice
	default UART_NS16550_VARIANT_NS16750
endchoice
config UART_NS16550_VARIANT_NS16550
	bool "UART 16550 (16-bytes FIFO)"
	help
	  This enables support for 16-bytes FIFO if UART controller is 16550.

config UART_NS16550_VARIANT_NS16750
	bool "UART 16750 (64-bytes FIFO and auto flow control)"
	help
	  This enables support for 64-bytes FIFO and automatic hardware
	  flow control if UART controller is 16750.

config UART_NS16550_VARIANT_NS16950
	bool "UART 16950 (128-bytes FIFO and auto flow control)"
	help
	  This enables support for 128-bytes FIFO and automatic hardware flow control.
endchoice

endif # SERIAL

config BUILD_OUTPUT_BIN
	default n if SOC_SERIES_AM6X_M4
	default n if SOC_SERIES_AM6X_R5

endif # SOC_SERIES_AM6X
```
