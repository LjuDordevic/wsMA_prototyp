## transform_projects/transform_zrtos/ZRTOS_demo1_output/soc/infineon/cat1c/Kconfig.defconfig
```kconfig
# PSOC CAT1B Configuration

# Copyright (c) 2024 Cypress Semiconductor Corporation.
# SPDX-License-Identifier: Apache-2.0

if SOC_FAMILY_INFINEON_CAT1C

source "soc/infineon/cat1c/xmc7200/Kconfig.defconfig"

endif # SOC_FAMILY_INFINEON_CAT1C
```

## transform_projects/transform_zrtos/ZRTOS_demo1_output/soc/infineon/cat3/Kconfig.defconfig
```kconfig
# SPDX-License-Identifier: Apache-2.0
#
# Copyright (c) 2020 Linumiz
# Author: Parthiban Nallathambi <parthiban@linumiz.com>

if SOC_FAMILY_INFINEON_XMC

source "soc/infineon/cat3/xmc4xxx/Kconfig.defconfig"

endif # SOC_FAMILY_INFINEON_XMC
```

## transform_projects/transform_zrtos/ZRTOS_demo1_output/soc/infineon/cat3/xmc4xxx/Kconfig.defconfig
```kconfig
# SPDX-License-Identifier: Apache-2.0
#
# XMC 4xxx series configuration options
# Copyright (c) 2020 Linumiz
# Author: Parthiban Nallathambi <parthiban@linumiz.com>

if SOC_SERIES_XMC4XXX

config NUM_IRQS
	default 112

source "soc/infineon/cat3/xmc4xxx/Kconfig.defconfig.xmc4500"
source "soc/infineon/cat3/xmc4xxx/Kconfig.defconfig.xmc4700"

endif # SOC_SERIES_XMC4XXX
```

## transform_projects/transform_zrtos/ZRTOS_demo1_output/soc/intel/intel_adsp/Kconfig.soc
```kconfig
# Intel CAVS SoC series selection
#
# Copyright (c) 2020-2024 Intel Corporation
# SPDX-License-Identifier: Apache-2.0

config SOC_FAMILY_INTEL_ADSP
	bool

config SOC_FAMILY
	default "intel_adsp" if SOC_FAMILY_INTEL_ADSP

source "soc/intel/intel_adsp/ace/Kconfig.soc"
source "soc/intel/intel_adsp/cavs/Kconfig.soc"
```

## transform_projects/transform_zrtos/ZRTOS_demo1_output/soc/intel/intel_ish/Kconfig.soc
```kconfig
# Intel ISH family selection
#
# Copyright (c) 2023-2024 Intel Corporation
#
# SPDX-License-Identifier: Apache-2.0

config SOC_FAMILY_INTEL_ISH
	bool

config SOC_FAMILY
	default "intel_ish" if SOC_FAMILY_INTEL_ISH

source "soc/intel/intel_ish/intel_ish5/Kconfig.soc"
```

## transform_projects/transform_zrtos/ZRTOS_demo1_output/soc/intel/intel_ish/intel_ish5/Kconfig.defconfig.series
```kconfig
# Copyright (c) 2023-2024 Intel Corporation
#
# SPDX-License-Identifier: Apache-2.0
#

if SOC_SERIES_INTEL_ISH5

source "soc/intel/intel_ish/intel_ish5/pm/Kconfig.pm"

endif # SOC_SERIES_INTEL_ISH5
```

## transform_projects/transform_zrtos/ZRTOS_demo1_output/soc/intel/intel_socfpga/agilex/Kconfig.defconfig.series
```kconfig
# Copyright (c) 2021-2024 Intel Corporation
# SPDX-License-Identifier: Apache-2.0

if SOC_SERIES_AGILEX

source "soc/intel/intel_socfpga/agilex/Kconfig.defconfig.agilex"

endif # SOC_SERIES_AGILEX
```

## transform_projects/transform_zrtos/ZRTOS_demo1_output/soc/intel/intel_socfpga/agilex5/Kconfig.defconfig.series
```kconfig
# Copyright (c) 2022-2024 Intel Corporation
# SPDX-License-Identifier: Apache-2.0

if SOC_SERIES_AGILEX5

source "soc/intel/intel_socfpga/agilex5/Kconfig.defconfig.agilex5"

endif # SOC_SERIES_AGILEX5
```

## transform_projects/transform_zrtos/ZRTOS_demo1_output/soc/intel/intel_socfpga_std/Kconfig
```kconfig
# Copyright (c) 2022-2024 Intel Corporation
# SPDX-License-Identifier: Apache-2.0

if SOC_FAMILY_INTEL_SOCFPGA_STD

source "soc/intel/intel_socfpga_std/cyclonev/Kconfig"

endif # SOC_FAMILY_INTEL_SOCFPGA_STD
```

## transform_projects/transform_zrtos/ZRTOS_demo1_output/soc/intel/intel_socfpga_std/cyclonev/Kconfig.defconfig.series
```kconfig
# Copyright (c) 2022-2024 Intel Corporation
# SPDX-License-Identifier: Apache-2.0

if SOC_SERIES_CYCLONEV

source "soc/intel/intel_socfpga_std/cyclonev/Kconfig.defconfig.cyclonev"

endif # SOC_SERIES_CYCLONEV
```

## transform_projects/transform_zrtos/ZRTOS_demo1_output/soc/ite/ec/Kconfig.defconfig
```kconfig
# Copyright (c) 2020 ITE Corporation. All Rights Reserved.
# SPDX-License-Identifier: Apache-2.0

if SOC_FAMILY_ITE_EC

source "soc/ite/ec/it51xxx/Kconfig.defconfig.series"
source "soc/ite/ec/it8xxx2/Kconfig.defconfig.series"


endif # SOC_FAMILY_ITE_EC
```

## transform_projects/transform_zrtos/ZRTOS_demo1_output/soc/microchip/mec/Kconfig.defconfig
```kconfig
# Copyright (c) 2024, Microchip Technology Inc.
# SPDX-License-Identifier: Apache-2.0

if SOC_FAMILY_MICROCHIP_MEC

source "soc/microchip/mec/mec15xx/Kconfig.defconfig.series"
source "soc/microchip/mec/mec172x/Kconfig.defconfig.series"
source "soc/microchip/mec/mec174x/Kconfig.defconfig.series"
source "soc/microchip/mec/mec175x/Kconfig.defconfig.series"
source "soc/microchip/mec/mech172x/Kconfig.defconfig.series"

endif # SOC_FAMILY_MICROCHIP_MEC
```

## transform_projects/transform_zrtos/ZRTOS_demo1_output/soc/microchip/mec/Kconfig.soc
```kconfig
# Microchip MEC172x, MEC1501 MCU line

# Copyright (c) 2018 Intel Corporation
# SPDX-License-Identifier: Apache-2.0

config SOC_FAMILY_MICROCHIP_MEC
	bool

config SOC_FAMILY
	default "microchip_mec" if SOC_FAMILY_MICROCHIP_MEC

source "soc/microchip/mec/mec15xx/Kconfig.soc"
source "soc/microchip/mec/mec172x/Kconfig.soc"
source "soc/microchip/mec/mec174x/Kconfig.soc"
source "soc/microchip/mec/mec175x/Kconfig.soc"
source "soc/microchip/mec/mech172x/Kconfig.soc"
```

## transform_projects/transform_zrtos/ZRTOS_demo1_output/soc/microchip/miv/Kconfig
```kconfig
# Copyright (c) 2024 Nordic Semiconductor ASA
# SPDX-License-Identifier: Apache-2.0

if SOC_FAMILY_MICROCHIP_MIV

source "soc/microchip/miv/miv/Kconfig"
source "soc/microchip/miv/polarfire/Kconfig"

endif # SOC_FAMILY_MICROCHIP_MIV
```

## transform_projects/transform_zrtos/ZRTOS_demo1_output/soc/microchip/miv/Kconfig.defconfig
```kconfig
# Copyright (c) 2024 Nordic Semiconductor ASA
# SPDX-License-Identifier: Apache-2.0

if SOC_FAMILY_MICROCHIP_MIV

source "soc/microchip/miv/miv/Kconfig.defconfig"
source "soc/microchip/miv/polarfire/Kconfig.defconfig"

endif # SOC_FAMILY_MICROCHIP_MIV
```

## transform_projects/transform_zrtos/ZRTOS_demo1_output/soc/nordic/nrf52/Kconfig.defconfig
```kconfig
# Nordic Semiconductor nRF52 MCU line

# Copyright (c) 2016-2018 Nordic Semiconductor ASA
# SPDX-License-Identifier: Apache-2.0

if SOC_SERIES_NRF52X

source "soc/nordic/nrf52/Kconfig.defconfig.nrf52805_CAAA"
source "soc/nordic/nrf52/Kconfig.defconfig.nrf52810_QFAA"
source "soc/nordic/nrf52/Kconfig.defconfig.nrf52811_QFAA"
source "soc/nordic/nrf52/Kconfig.defconfig.nrf52820_QDAA"
source "soc/nordic/nrf52/Kconfig.defconfig.nrf52832_CIAA"
source "soc/nordic/nrf52/Kconfig.defconfig.nrf52832_QFAA"
source "soc/nordic/nrf52/Kconfig.defconfig.nrf52832_QFAB"
source "soc/nordic/nrf52/Kconfig.defconfig.nrf52833_QDAA"
source "soc/nordic/nrf52/Kconfig.defconfig.nrf52833_QIAA"
source "soc/nordic/nrf52/Kconfig.defconfig.nrf52840_QFAA"
source "soc/nordic/nrf52/Kconfig.defconfig.nrf52840_QIAA"

# If the kernel has timer support, enable the timer
config NRF_RTC_TIMER
	default y if SYS_CLOCK_EXISTS

config SYS_CLOCK_HW_CYCLES_PER_SEC
	default $(dt_nodelabel_int_prop,rtc1,clock-frequency)

endif # SOC_SERIES_NRF52X
```

## transform_projects/transform_zrtos/ZRTOS_demo1_output/soc/nordic/nrf54h/Kconfig.defconfig
```kconfig
# Nordic Semiconductor nRF54H MCU line

# Copyright (c) 2024 Nordic Semiconductor ASA
# SPDX-License-Identifier: Apache-2.0

if SOC_SERIES_NRF54HX

source "soc/nordic/nrf54h/Kconfig.defconfig.nrf54h20_cpuapp"
source "soc/nordic/nrf54h/Kconfig.defconfig.nrf54h20_cpuflpr"
source "soc/nordic/nrf54h/Kconfig.defconfig.nrf54h20_cpuppr"
source "soc/nordic/nrf54h/Kconfig.defconfig.nrf54h20_cpurad"

if ARM

config CACHE_NRF_CACHE
	default y if EXTERNAL_CACHE

endif # ARM

if RISCV

DT_CHOSEN_Z_SRAM = zephyr,sram
DT_CHOSEN_Z_CODE = zephyr,code-partition

config BUILD_OUTPUT_ADJUST_LMA
	depends on !XIP
	default "$(dt_chosen_partition_addr_hex,$(DT_CHOSEN_Z_CODE)) - \
		 $(dt_chosen_reg_addr_hex,$(DT_CHOSEN_Z_SRAM))"

config BUILD_OUTPUT_HEX
	default y

endif # RISCV

config SPI_DW_HSSI
	default y if SPI_DW

config SPI_DW_ACCESS_WORD_ONLY
	default y if SPI_DW

config PM_DEVICE_POWER_DOMAIN
	default n if PM_DEVICE

config PM_DEVICE_RUNTIME
	default y if PM_DEVICE

config SYS_CLOCK_HW_CYCLES_PER_SEC
	default $(dt_nodelabel_int_prop,grtc,clock-frequency) if NRF_GRTC_TIMER

endif # SOC_SERIES_NRF54HX
```

## transform_projects/transform_zrtos/ZRTOS_demo1_output/soc/nordic/nrf54l/Kconfig.defconfig
```kconfig
# Nordic Semiconductor nRF54L MCU line

# Copyright (c) 2024 Nordic Semiconductor ASA
# SPDX-License-Identifier: Apache-2.0

if SOC_SERIES_NRF54LX

source "soc/nordic/nrf54l/Kconfig.defconfig.nrf54l09_enga_cpuapp"
source "soc/nordic/nrf54l/Kconfig.defconfig.nrf54l09_enga_cpuflpr"
source "soc/nordic/nrf54l/Kconfig.defconfig.nrf54l20_enga_cpuapp"
source "soc/nordic/nrf54l/Kconfig.defconfig.nrf54l20_enga_cpuflpr"
source "soc/nordic/nrf54l/Kconfig.defconfig.nrf54l_05_10_15_cpuapp"
source "soc/nordic/nrf54l/Kconfig.defconfig.nrf54l_05_10_15_cpuflpr"
source "soc/nordic/nrf54l/Kconfig.defconfig.nrf54lm20a_enga_cpuapp"
source "soc/nordic/nrf54l/Kconfig.defconfig.nrf54lm20a_enga_cpuflpr"

if ARM

config CORTEX_M_SYSTICK
	default !NRF_GRTC_TIMER

# Start SYSCOUNTER on driver init
config NRF_GRTC_START_SYSCOUNTER
	default NRF_GRTC_TIMER

config CACHE_NRF_CACHE
	default y if EXTERNAL_CACHE

config CACHE_MANAGEMENT
	default y


# MPU-based null-pointer dereferencing detection cannot
# be applied as the (0x0 - 0x400) is unmapped for this target.
choice
	default NULL_POINTER_EXCEPTION_DETECTION_NONE
endchoice
endchoice

endif # ARM

if RISCV

DT_CHOSEN_Z_SRAM = zephyr,sram
DT_CHOSEN_Z_CODE = zephyr,code-partition

config BUILD_OUTPUT_ADJUST_LMA
	depends on !XIP
	default "$(dt_chosen_partition_addr_hex,$(DT_CHOSEN_Z_CODE)) - \
		 $(dt_chosen_reg_addr_hex,$(DT_CHOSEN_Z_SRAM))"

endif # RISCV

config SYS_CLOCK_HW_CYCLES_PER_SEC
	default $(dt_nodelabel_int_prop,grtc,clock-frequency) if NRF_GRTC_TIMER

endif # SOC_SERIES_NRF54LX
```

## transform_projects/transform_zrtos/ZRTOS_demo1_output/soc/nuvoton/npcx/Kconfig.defconfig
```kconfig
# SPDX-License-Identifier: Apache-2.0

# Copyright (c) 2020 Nuvoton Technology Corporation.
# SPDX-License-Identifier: Apache-2.0

if SOC_FAMILY_NPCX

source "soc/nuvoton/npcx/npck3/Kconfig.defconfig"
source "soc/nuvoton/npcx/npcx4/Kconfig.defconfig"
source "soc/nuvoton/npcx/npcx7/Kconfig.defconfig"
source "soc/nuvoton/npcx/npcx9/Kconfig.defconfig"

endif # SOC_FAMILY_NPCX
```

## transform_projects/transform_zrtos/ZRTOS_demo1_output/soc/nuvoton/numaker/Kconfig
```kconfig
# Copyright (c) 2023 Nuvoton Technology Corporation.
#
# SPDX-License-Identifier: Apache-2.0

config SOC_FAMILY_NUMAKER
	select SOC_RESET_HOOK

if SOC_FAMILY_NUMAKER

source "soc/nuvoton/numaker/m2l31x/Kconfig"
source "soc/nuvoton/numaker/m46x/Kconfig"
source "soc/nuvoton/numaker/m55m1x/Kconfig"

endif # SOC_FAMILY_NUMAKER
```

## transform_projects/transform_zrtos/ZRTOS_demo1_output/soc/nuvoton/numaker/m2l31x/Kconfig.defconfig
```kconfig
# Copyright (c) 2024 Nuvoton Technology Corporation.
#
# SPDX-License-Identifier: Apache-2.0

if SOC_SERIES_M2L31X

source "soc/nuvoton/numaker/m2l31x/Kconfig.defconfig.m2l31xxx"

endif # SOC_SERIES_M2L31X
```

## transform_projects/transform_zrtos/ZRTOS_demo1_output/soc/nuvoton/numaker/m46x/Kconfig.defconfig
```kconfig
# Copyright (c) 2023 Nuvoton Technology Corporation.
#
# SPDX-License-Identifier: Apache-2.0

if SOC_SERIES_M46X

source "soc/nuvoton/numaker/m46x/Kconfig.defconfig.m467"

endif # SOC_SERIES_M46X
```

## transform_projects/transform_zrtos/ZRTOS_demo1_output/soc/nuvoton/numaker/m55m1x/Kconfig.defconfig
```kconfig
# Copyright (c) 2025 Nuvoton Technology Corporation.
#
# SPDX-License-Identifier: Apache-2.0

if SOC_SERIES_M55M1X

source "soc/nuvoton/numaker/m55m1x/Kconfig.defconfig.m55m1xxx"

endif # SOC_SERIES_M55M1X
```
