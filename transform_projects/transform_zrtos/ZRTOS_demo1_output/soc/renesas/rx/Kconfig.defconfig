## transform_projects/transform_zrtos/ZRTOS_demo1_output/soc/renesas/rx/Kconfig.defconfig
```kconfig
# Copyright (c) 2024 Renesas Electronics Corporation
# SPDX-License-Identifier: Apache-2.0

if SOC_FAMILY_RENESAS_RX

source "soc/renesas/rx/rx130/Kconfig.defconfig"
source "soc/renesas/rx/rx62n/Kconfig.defconfig"

endif
```

## transform_projects/transform_zrtos/ZRTOS_demo1_output/soc/renesas/rx/Kconfig.soc
```kconfig
# Copyright (c) 2024 Renesas Electronics Corporation
# SPDX-License-Identifier: Apache-2.0

config SOC_FAMILY_RENESAS_RX
	bool

config SOC_FAMILY
	default "renesas_rx" if SOC_FAMILY_RENESAS_RX

source "soc/renesas/rx/rx130/Kconfig.soc"
source "soc/renesas/rx/rx62n/Kconfig.soc"
```

## transform_projects/transform_zrtos/ZRTOS_demo1_output/soc/renesas/rz/Kconfig
```kconfig
# Copyright (c) 2024-2025 Renesas Electronics Corporation
# SPDX-License-Identifier: Apache-2.0

config SOC_FAMILY_RENESAS_RZ
	select HAS_SEGGER_RTT if ZEPHYR_SEGGER_MODULE

if SOC_FAMILY_RENESAS_RZ

source "soc/renesas/rz/rza2m/Kconfig"
source "soc/renesas/rz/rza3ul/Kconfig"
source "soc/renesas/rz/rzg2l/Kconfig"
source "soc/renesas/rz/rzg2ul/Kconfig"
source "soc/renesas/rz/rzg3s/Kconfig"
source "soc/renesas/rz/rzn2l/Kconfig"
source "soc/renesas/rz/rzt2l/Kconfig"
source "soc/renesas/rz/rzt2m/Kconfig"
source "soc/renesas/rz/rzv2h/Kconfig"
source "soc/renesas/rz/rzv2l/Kconfig"
source "soc/renesas/rz/rzv2n/Kconfig"

endif # SOC_FAMILY_RENESAS_RZ
```

## transform_projects/transform_zrtos/ZRTOS_demo1_output/soc/renesas/rz/Kconfig.defconfig
```kconfig
# Copyright (c) 2024 Renesas Electronics Corporation
# SPDX-License-Identifier: Apache-2.0

if SOC_FAMILY_RENESAS_RZ

source "soc/renesas/rz/rza2m/Kconfig.defconfig"
source "soc/renesas/rz/rza3ul/Kconfig.defconfig"
source "soc/renesas/rz/rzg2l/Kconfig.defconfig"
source "soc/renesas/rz/rzg2ul/Kconfig.defconfig"
source "soc/renesas/rz/rzg3s/Kconfig.defconfig"
source "soc/renesas/rz/rzn2l/Kconfig.defconfig"
source "soc/renesas/rz/rzt2l/Kconfig.defconfig"
source "soc/renesas/rz/rzt2m/Kconfig.defconfig"
source "soc/renesas/rz/rzv2l/Kconfig.defconfig"
source "soc/renesas/rz/rzv2n/Kconfig.defconfig"

endif # SOC_FAMILY_RENESAS_RZ
```

## transform_projects/transform_zrtos/ZRTOS_demo1_output/soc/renesas/rz/Kconfig.soc
```kconfig
# Copyright (c) 2024 Renesas Electronics Corporation
# SPDX-License-Identifier: Apache-2.0

config SOC_FAMILY_RENESAS_RZ
	bool

config SOC_FAMILY
	default "renesas_rz" if SOC_FAMILY_RENESAS_RZ

source "soc/renesas/rz/rza2m/Kconfig.soc"
source "soc/renesas/rz/rza3ul/Kconfig.soc"
source "soc/renesas/rz/rzg2l/Kconfig.soc"
source "soc/renesas/rz/rzg2ul/Kconfig.soc"
source "soc/renesas/rz/rzg3s/Kconfig.soc"
source "soc/renesas/rz/rzn2l/Kconfig.soc"
source "soc/renesas/rz/rzt2l/Kconfig.soc"
source "soc/renesas/rz/rzt2m/Kconfig.soc"
source "soc/renesas/rz/rzv2h/Kconfig.soc"
source "soc/renesas/rz/rzv2l/Kconfig.soc"
source "soc/renesas/rz/rzv2n/Kconfig.soc"
```

## transform_projects/transform_zrtos/ZRTOS_demo1_output/soc/renesas/rz/rzv2h/Kconfig.defconfig
```kconfig
# Copyright (c) 2025 Renesas Electronics Corporation
# SPDX-License-Identifier: Apache-2.0

if SOC_SERIES_RZV2H

source "soc/renesas/rz/rzv2h/Kconfig.defconfig.rzv2h_cm33"
source "soc/renesas/rz/rzv2h/Kconfig.defconfig.rzv2h_cr8"

endif # SOC_SERIES_RZV2H
```

## transform_projects/transform_zrtos/ZRTOS_demo1_output/soc/rockchip/rk3399/Kconfig.defconfig
```kconfig
#
# Copyright 2022 Huawei France Technologies SASU
#
# SPDX-License-Identifier: Apache-2.0
#

if SOC_SERIES_RK3399

source "soc/rockchip/rk3399/Kconfig.defconfig.rk3399"

endif # SOC_SERIES_RK3399
```

## transform_projects/transform_zrtos/ZRTOS_demo1_output/soc/rockchip/rk35/Kconfig.soc
```kconfig
# Copyright 2024 Université Gustave Eiffel
# SPDX-License-Identifier: Apache-2.0

config SOC_SERIES_RK35
	bool
	select SOC_FAMILY_ROCKCHIP

config SOC_SERIES
	default "rk35" if SOC_SERIES_RK35

source "soc/rockchip/rk35/rk3568/Kconfig.soc"
source "soc/rockchip/rk35/rk3588s/Kconfig.soc"
```

## transform_projects/transform_zrtos/ZRTOS_demo1_output/soc/rockchip/rk35/rk3588s/Kconfig.defconfig
```kconfig
# Copyright 2024 Université Gustave Eiffel
# SPDX-License-Identifier: Apache-2.0

if SOC_RK3588S

source "soc/rockchip/rk35/rk3588s/Kconfig.defconfig.rk3588s"

endif # SOC_RK3588S
```

## transform_projects/transform_zrtos/ZRTOS_demo1_output/soc/sensry/ganymed/Kconfig.defconfig
```kconfig
# SPDX-License-Identifier: Apache-2.0
# Copyright (c) 2024 sensry.io

if SOC_SERIES_SY1XX

source "soc/sensry/ganymed/sy1xx/Kconfig.defconfig"

endif
```

## transform_projects/transform_zrtos/ZRTOS_demo1_output/soc/sensry/ganymed/Kconfig.soc
```kconfig
# SPDX-License-Identifier: Apache-2.0
# Copyright (c) 2024 sensry.io

source "soc/sensry/ganymed/sy1xx/Kconfig.soc"
```

## transform_projects/transform_zrtos/ZRTOS_demo1_output/soc/sifive/sifive_freedom/Kconfig
```kconfig
# Copyright (c) 2024 Nordic Semiconductor ASA
# Copyright (c) 2024 Antmicro <www.antmicro.com>
# SPDX-License-Identifier: Apache-2.0

if SOC_FAMILY_SIFIVE_FREEDOM

source "soc/sifive/sifive_freedom/fe300/Kconfig"
source "soc/sifive/sifive_freedom/fu500/Kconfig"
source "soc/sifive/sifive_freedom/fu700/Kconfig"

endif # SOC_FAMILY_SIFIVE_FREEDOM
```

## transform_projects/transform_zrtos/ZRTOS_demo1_output/soc/sifive/sifive_freedom/Kconfig.defconfig
```kconfig
# Copyright (c) 2024 Nordic Semiconductor ASA
# Copyright (c) 2024 Antmicro <www.antmicro.com>
# SPDX-License-Identifier: Apache-2.0

if SOC_FAMILY_SIFIVE_FREEDOM

source "soc/sifive/sifive_freedom/fe300/Kconfig.defconfig"
source "soc/sifive/sifive_freedom/fu500/Kconfig.defconfig"
source "soc/sifive/sifive_freedom/fu700/Kconfig.defconfig"

endif # SOC_FAMILY_SIFIVE_FREEDOM
```

## transform_projects/transform_zrtos/ZRTOS_demo1_output/soc/sifive/sifive_freedom/Kconfig.soc
```kconfig
# Copyright (c) 2024 Nordic Semiconductor ASA
# Copyright (c) 2024 Antmicro <www.antmicro.com>
# SPDX-License-Identifier: Apache-2.0

config SOC_FAMILY_SIFIVE_FREEDOM
	bool

config SOC_FAMILY
	default "sifive_freedom" if SOC_FAMILY_SIFIVE_FREEDOM

source "soc/sifive/sifive_freedom/fe300/Kconfig.soc"
source "soc/sifive/sifive_freedom/fu500/Kconfig.soc"
source "soc/sifive/sifive_freedom/fu700/Kconfig.soc"
```

## transform_projects/transform_zrtos/ZRTOS_demo1_output/soc/silabs/silabs_s0/Kconfig.defconfig
```kconfig
# Copyright (c) 2024 Silicon Laboratories Inc.
# SPDX-License-Identifier: Apache-2.0

source "soc/silabs/silabs_s0/efm32hg/Kconfig.defconfig"
source "soc/silabs/silabs_s0/efm32wg/Kconfig.defconfig"
```

## transform_projects/transform_zrtos/ZRTOS_demo1_output/soc/silabs/silabs_s1/Kconfig.defconfig
```kconfig
# Copyright (c) 2024 Silicon Laboratories Inc.
# SPDX-License-Identifier: Apache-2.0

source "soc/silabs/silabs_s1/efm32gg11b/Kconfig.defconfig"
source "soc/silabs/silabs_s1/efm32gg12b/Kconfig.defconfig"
source "soc/silabs/silabs_s1/efm32jg12b/Kconfig.defconfig"
source "soc/silabs/silabs_s1/efm32pg12b/Kconfig.defconfig"
source "soc/silabs/silabs_s1/efm32pg1b/Kconfig.defconfig"
source "soc/silabs/silabs_s1/efr32bg13p/Kconfig.defconfig"
source "soc/silabs/silabs_s1/efr32fg13p/Kconfig.defconfig"
source "soc/silabs/silabs_s1/efr32fg1p/Kconfig.defconfig"
source "soc/silabs/silabs_s1/efr32mg12p/Kconfig.defconfig"
```

## transform_projects/transform_zrtos/ZRTOS_demo1_output/soc/silabs/silabs_s2/Kconfig
```kconfig
# Copyright (c) 2024 GARDENA GmbH
# SPDX-License-Identifier: Apache-2.0

if SOC_FAMILY_SILABS_S2

config SOC_FAMILY_SILABS_S2
	select HAS_SEGGER_RTT if ZEPHYR_SEGGER_MODULE
	select BUILD_OUTPUT_HEX
	select SOC_PREP_HOOK
	select SOC_EARLY_INIT_HOOK

source "soc/silabs/silabs_s2/efr32bg22/Kconfig"
source "soc/silabs/silabs_s2/efr32bg27/Kconfig"
source "soc/silabs/silabs_s2/efr32mg21/Kconfig"
source "soc/silabs/silabs_s2/efr32zg23/Kconfig"
source "soc/silabs/silabs_s2/xg24/Kconfig"
source "soc/silabs/silabs_s2/xg29/Kconfig"

config ARM_SECURE_FIRMWARE
	default y

config SILABS_DEVICE_IS_MODULE
	bool
	default n

endif
```

## transform_projects/transform_zrtos/ZRTOS_demo1_output/soc/silabs/silabs_s2/xg24/Kconfig.defconfig
```kconfig
# Copyright (c) 2021 Sateesh Kotapati
# Copyright (c) 2025 Silicon Laboratories Inc.
# SPDX-License-Identifier: Apache-2.0

if SOC_SERIES_EFR32MG24 || SOC_SERIES_MGM24

config NUM_IRQS
	# must be >= the highest interrupt number used
	default 75

config PM
	default n
	select UART_INTERRUPT_DRIVEN if SERIAL_SUPPORT_INTERRUPT

choice
	default PM_POLICY_DEFAULT
	depends on PM
endchoice
config PM_POLICY_DEFAULT
	bool "Default PM policy"
	help
	  This option selects the default PM policy. Default policy is based
	  on CPU residency times and other constraints imposed by the drivers or
	  application.

config PM_POLICY_CUSTOM
	bool "Custom PM Policy"
	help
	  This options allows applications to override the default policy with
	  a custom implementation.

endchoice

endif
```

## transform_projects/transform_zrtos/ZRTOS_demo1_output/soc/silabs/silabs_sim3/Kconfig.defconfig
```kconfig
# Copyright (c) 2024 Silicon Laboratories Inc.
# SPDX-License-Identifier: Apache-2.0

source "soc/silabs/silabs_sim3/sim3u/Kconfig.defconfig"
```

## transform_projects/transform_zrtos/ZRTOS_demo1_output/soc/snps/emsk/Kconfig.defconfig
```kconfig
# Copyright (c) 2014 Wind River Systems, Inc.
# Copyright (c) 2018 Synopsys, Inc. All rights reserved.
# SPDX-License-Identifier: Apache-2.0

if SOC_EMSK

source "soc/snps/emsk/Kconfig.defconfig.em11d"
source "soc/snps/emsk/Kconfig.defconfig.em7d"
source "soc/snps/emsk/Kconfig.defconfig.em9d"

endif # SOC_EMSK
```

## transform_projects/transform_zrtos/ZRTOS_demo1_output/soc/snps/nsim/arc_classic/Kconfig
```kconfig
# Copyright (c) 2024 Synopsys, Inc.
# SPDX-License-Identifier: Apache-2.0

if SOC_FAMILY_NSIM_ARC_CLASSIC

source "soc/snps/nsim/arc_classic/em/Kconfig"
source "soc/snps/nsim/arc_classic/hs/Kconfig"
source "soc/snps/nsim/arc_classic/sem/Kconfig"
source "soc/snps/nsim/arc_classic/vpx5/Kconfig"

endif # SOC_FAMILY_NSIM_ARC_CLASSIC
```

## transform_projects/transform_zrtos/ZRTOS_demo1_output/soc/snps/nsim/arc_classic/Kconfig.defconfig
```kconfig
# Copyright (c) 2024 Synopsys, Inc.
# SPDX-License-Identifier: Apache-2.0

if SOC_FAMILY_NSIM_ARC_CLASSIC

config XIP
	default n

source "soc/snps/nsim/arc_classic/sem/Kconfig.defconfig"
source "soc/snps/nsim/arc_classic/vpx5/Kconfig.defconfig"

endif # SOC_FAMILY_NSIM_ARC_CLASSIC
```

## transform_projects/transform_zrtos/ZRTOS_demo1_output/soc/snps/nsim/arc_classic/em/Kconfig.defconfig
```kconfig
# Copyright (c) 2024 Synopsys, Inc.
# SPDX-License-Identifier: Apache-2.0

if SOC_SERIES_NSIM_EM

source "soc/snps/nsim/arc_classic/em/Kconfig.defconfig.em"
source "soc/snps/nsim/arc_classic/em/Kconfig.defconfig.em11d"
source "soc/snps/nsim/arc_classic/em/Kconfig.defconfig.em7d_v22"

endif # SOC_SERIES_NSIM_EM
```
