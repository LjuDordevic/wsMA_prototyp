## transform_projects/transform_zrtos/ZRTOS_demo1_output/soc/nxp/imx/Kconfig.soc
```kconfig
# Copyright 2024 NXP
# SPDX-License-Identifier: Apache-2.0

config SOC_FAMILY_NXP_IMX
	bool

config SOC_FAMILY
	default "nxp_imx" if SOC_FAMILY_NXP_IMX

source "soc/nxp/imx/imx6sx/Kconfig.soc"
source "soc/nxp/imx/imx7d/Kconfig.soc"
source "soc/nxp/imx/imx8/Kconfig.soc"
source "soc/nxp/imx/imx8m/Kconfig.soc"
source "soc/nxp/imx/imx8ulp/Kconfig.soc"
source "soc/nxp/imx/imx8x/Kconfig.soc"
source "soc/nxp/imx/imx9/Kconfig.soc"
```

## transform_projects/transform_zrtos/ZRTOS_demo1_output/soc/nxp/imx/imx8m/Kconfig.defconfig
```kconfig
# Copyright 2024 NXP
# SPDX-License-Identifier: Apache-2.0

if SOC_SERIES_IMX8M

source "soc/nxp/imx/imx8m/Kconfig.defconfig.mimx8ml8_a53"
source "soc/nxp/imx/imx8m/Kconfig.defconfig.mimx8ml8_adsp"
source "soc/nxp/imx/imx8m/Kconfig.defconfig.mimx8ml8_m7"
source "soc/nxp/imx/imx8m/Kconfig.defconfig.mimx8mm6_a53"
source "soc/nxp/imx/imx8m/Kconfig.defconfig.mimx8mm6_m4"
source "soc/nxp/imx/imx8m/Kconfig.defconfig.mimx8mn6_a53"
source "soc/nxp/imx/imx8m/Kconfig.defconfig.mimx8mq6_m4"

endif # SOC_SERIES_IMX8M
```

## transform_projects/transform_zrtos/ZRTOS_demo1_output/soc/nxp/imx/imx9/Kconfig
```kconfig
# Copyright 2024 NXP
# SPDX-License-Identifier: Apache-2.0

if SOC_SERIES_IMX9
source "soc/nxp/imx/imx9/imx91/Kconfig"
source "soc/nxp/imx/imx9/imx93/Kconfig"
source "soc/nxp/imx/imx9/imx943/Kconfig"
source "soc/nxp/imx/imx9/imx95/Kconfig"
endif
```

## transform_projects/transform_zrtos/ZRTOS_demo1_output/soc/nxp/imx/imx9/imx91/Kconfig.defconfig
```kconfig
# Copyright 2025 NXP
# SPDX-License-Identifier: Apache-2.0

if SOC_SERIES_IMX9

source "soc/nxp/imx/imx9/imx91/Kconfig.defconfig.mimx91"

endif # SOC_SERIES_IMX9
```

## transform_projects/transform_zrtos/ZRTOS_demo1_output/soc/nxp/imx/imx9/imx93/Kconfig.defconfig
```kconfig
# Copyright 2022,2024 NXP
# SPDX-License-Identifier: Apache-2.0

if SOC_SERIES_IMX9

source "soc/nxp/imx/imx9/imx93/Kconfig.defconfig.mimx93.a55"
source "soc/nxp/imx/imx9/imx93/Kconfig.defconfig.mimx93.m33"

endif # SOC_SERIES_IMX9
```

## transform_projects/transform_zrtos/ZRTOS_demo1_output/soc/nxp/imx/imx9/imx943/Kconfig.defconfig
```kconfig
# Copyright 2025 NXP
# SPDX-License-Identifier: Apache-2.0

if SOC_SERIES_IMX9

source "soc/nxp/imx/imx9/imx943/Kconfig.defconfig.mimx94398.a55"
source "soc/nxp/imx/imx9/imx943/Kconfig.defconfig.mimx94398.m33"

endif # SOC_SERIES_IMX9
```

## transform_projects/transform_zrtos/ZRTOS_demo1_output/soc/nxp/imx/imx9/imx95/Kconfig.defconfig
```kconfig
# Copyright 2024 NXP
# SPDX-License-Identifier: Apache-2.0

if SOC_SERIES_IMX9

source "soc/nxp/imx/imx9/imx95/Kconfig.defconfig.mimx95.a55"
source "soc/nxp/imx/imx9/imx95/Kconfig.defconfig.mimx95.m7"

endif # SOC_SERIES_IMX9
```

## transform_projects/transform_zrtos/ZRTOS_demo1_output/soc/nxp/imxrt/Kconfig.soc
```kconfig
# Copyright 2024 NXP
# SPDX-License-Identifier: Apache-2.0

config SOC_FAMILY_NXP_IMXRT
	bool

config SOC_FAMILY
	default "nxp_imxrt" if SOC_FAMILY_NXP_IMXRT

source "soc/nxp/imxrt/imxrt10xx/Kconfig.soc"
source "soc/nxp/imxrt/imxrt118x/Kconfig.soc"
source "soc/nxp/imxrt/imxrt11xx/Kconfig.soc"
source "soc/nxp/imxrt/imxrt5xx/Kconfig.soc"
source "soc/nxp/imxrt/imxrt6xx/Kconfig.soc"
source "soc/nxp/imxrt/imxrt7xx/Kconfig.soc"
```

## transform_projects/transform_zrtos/ZRTOS_demo1_output/soc/nxp/kinetis/Kconfig.defconfig
```kconfig
# Copyright 2024 NXP
# SPDX-License-Identifier: Apache-2.0

if SOC_FAMILY_KINETIS

source "soc/nxp/kinetis/k2x/Kconfig.defconfig"
source "soc/nxp/kinetis/k32lx/Kconfig.defconfig"
source "soc/nxp/kinetis/k6x/Kconfig.defconfig"
source "soc/nxp/kinetis/k8x/Kconfig.defconfig"
source "soc/nxp/kinetis/ke1xf/Kconfig.defconfig"
source "soc/nxp/kinetis/ke1xz/Kconfig.defconfig"
source "soc/nxp/kinetis/kl2x/Kconfig.defconfig"
source "soc/nxp/kinetis/kv5x/Kconfig.defconfig"
source "soc/nxp/kinetis/kwx/Kconfig.defconfig"

endif # SOC_FAMILY_KINETIS
```

## transform_projects/transform_zrtos/ZRTOS_demo1_output/soc/nxp/kinetis/kwx/Kconfig.defconfig
```kconfig
# Kinetis KWx series configuration options

# Copyright 2024 NXP
# SPDX-License-Identifier: Apache-2.0

if SOC_SERIES_KINETIS_KWX

config NUM_IRQS
	default 65 if SOC_MKW22D5 || SOC_MKW24D5
	default 32 if SOC_MKW40Z4 || SOC_MKW41Z4

config SPI
	default y if SOC_MKW22D5 || SOC_MKW24D5

config NET_L2_IEEE802154
	default y if !NET_L2_OPENTHREAD && SOC_MKW41Z4

if SOC_MKW40Z4 || SOC_MKW41Z4

choice
	default CTR_DRBG_CSPRNG_GENERATOR
endchoice
config HARDWARE_DEVICE_CS_GENERATOR
	bool "Use hardware random driver for CS random numbers"
	depends on ENTROPY_HAS_DRIVER
	help
	  Enables a cryptographically secure random number generator that
	  uses the enabled hardware random number driver to generate
	  random numbers.

config CTR_DRBG_CSPRNG_GENERATOR
	bool "Use CTR-DRBG CSPRNG"
	depends on MBEDTLS
	depends on ENTROPY_HAS_DRIVER
	select MBEDTLS_CIPHER_AES_ENABLED
	help
	  Enables the CTR-DRBG pseudo-random number generator. This CSPRNG
	  shall use the entropy API for an initialization seed. The CTR-DRBG
	  is a FIPS140-2 recommended cryptographically secure random number
	  generator.

config TEST_CSPRNG_GENERATOR
	bool "Use insecure CSPRNG for testing purposes"
	depends on TEST_RANDOM_GENERATOR
	help
	  Route calls to `sys_csrand_get` through `sys_rand_get` to enable
	  libraries that use the former to be tested with ZTEST.

endchoice

choice
	default XOSHIRO_RANDOM_GENERATOR
endchoice
config TIMER_RANDOM_GENERATOR
	bool "System timer clock based number generator"
	depends on TEST_RANDOM_GENERATOR
	help
	  This options enables number generator based on system timer
	  clock. This number generator is not random and used for
	  testing only.

config ENTROPY_DEVICE_RANDOM_GENERATOR
	bool "Use entropy driver to generate random numbers"
	depends on ENTROPY_HAS_DRIVER
	help
	  Enables a random number generator that uses the enabled hardware
	  entropy gathering driver to generate random numbers. Should only be
	  selected if hardware entropy driver is designed to be a random
	  number generator source.

config XOSHIRO_RANDOM_GENERATOR
	bool "Use Xoshiro128++ as PRNG"
	depends on ENTROPY_HAS_DRIVER
	help
	  Enables the Xoshiro128++ pseudo-random number generator, that uses
	  the entropy driver as a seed source. This is a fast general-purpose
	  non-cryptographically secure random number generator.

endchoice

# The flash option register (FOPT) boot options
# 1111 1011 - Set NMI pin/interrupts to disabled.
config KINETIS_FLASH_CONFIG_FOPT
	default 0xFB
	depends on KINETIS_FLASH_CONFIG

endif # SOC_MKW40Z4 || SOC_MKW41Z4

if SOC_MKW22D5 || SOC_MKW24D5

# The flash option register (FOPT) boot options
# 1111 1001 - Set NMI pin/interrupts and EzPort reset default to disabled
config KINETIS_FLASH_CONFIG_FOPT
	default 0xF9
	depends on KINETIS_FLASH_CONFIG

endif # SOC_MKW22D5 || SOC_MKW24D5

endif # SOC_SERIES_KINETIS_KWX
```

## transform_projects/transform_zrtos/ZRTOS_demo1_output/soc/nxp/layerscape/Kconfig
```kconfig
#
# Copyright 2024 NXP
#
# SPDX-License-Identifier: Apache-2.0
#
#
if SOC_FAMILY_NXP_LAYERSCAPE

source "soc/nxp/layerscape/ls1046a/Kconfig"

endif # SOC_FAMILY_NXP_LAYERSCAPE
```

## transform_projects/transform_zrtos/ZRTOS_demo1_output/soc/nxp/lpc/Kconfig
```kconfig
# Copyright 2017,2024 NXP
# SPDX-License-Identifier: Apache-2.0

config SOC_FAMILY_LPC
	select HAS_SEGGER_RTT if ZEPHYR_SEGGER_MODULE
	select CLOCK_CONTROL
	select ARM

if SOC_FAMILY_LPC
source "soc/nxp/lpc/lpc11u6x/Kconfig"
source "soc/nxp/lpc/lpc51u68/Kconfig"
source "soc/nxp/lpc/lpc54xxx/Kconfig"
source "soc/nxp/lpc/lpc55xxx/Kconfig"

endif # SOC_FAMILY_LPC
```

## transform_projects/transform_zrtos/ZRTOS_demo1_output/soc/nxp/lpc/Kconfig.defconfig
```kconfig
# Copyright 2017,2024 NXP
# SPDX-License-Identifier: Apache-2.0

if SOC_FAMILY_LPC

config BUILD_WITH_TFM
	default y if TRUSTED_EXECUTION_NONSECURE

source "soc/nxp/lpc/lpc11u6x/Kconfig.defconfig"
source "soc/nxp/lpc/lpc51u68/Kconfig.defconfig"
source "soc/nxp/lpc/lpc54xxx/Kconfig.defconfig"
source "soc/nxp/lpc/lpc55xxx/Kconfig.defconfig"

endif # SOC_FAMILY_LPC
```

## transform_projects/transform_zrtos/ZRTOS_demo1_output/soc/nxp/lpc/Kconfig.soc
```kconfig
# Copyright 2017,2024 NXP
# SPDX-License-Identifier: Apache-2.0

config SOC_FAMILY_LPC
	bool

config SOC_FAMILY
	default "lpc" if SOC_FAMILY_LPC

source "soc/nxp/lpc/lpc11u6x/Kconfig.soc"
source "soc/nxp/lpc/lpc51u68/Kconfig.soc"
source "soc/nxp/lpc/lpc54xxx/Kconfig.soc"
source "soc/nxp/lpc/lpc55xxx/Kconfig.soc"
```

## transform_projects/transform_zrtos/ZRTOS_demo1_output/soc/nxp/mcx/Kconfig.soc
```kconfig
# Copyright 2024 NXP
# SPDX-License-Identifier: Apache-2.0

config SOC_FAMILY_NXP_MCX
	bool

config SOC_FAMILY
	default "nxp_mcx" if SOC_FAMILY_NXP_MCX

source "soc/nxp/mcx/mcxa/Kconfig.soc"
source "soc/nxp/mcx/mcxc/Kconfig.soc"
source "soc/nxp/mcx/mcxn/Kconfig.soc"
source "soc/nxp/mcx/mcxw/Kconfig.soc"
```

## transform_projects/transform_zrtos/ZRTOS_demo1_output/soc/nxp/s32/Kconfig.defconfig
```kconfig
# Copyright 2022,2024 NXP
# SPDX-License-Identifier: Apache-2.0

if SOC_FAMILY_NXP_S32

source "soc/nxp/s32/s32k1/Kconfig.defconfig"
source "soc/nxp/s32/s32k3/Kconfig.defconfig"
source "soc/nxp/s32/s32ze/Kconfig.defconfig"

endif # SOC_FAMILY_NXP_S32
```

## transform_projects/transform_zrtos/ZRTOS_demo1_output/soc/nxp/s32/Kconfig.soc
```kconfig
# Copyright 2022,2024 NXP
# SPDX-License-Identifier: Apache-2.0

config SOC_FAMILY_NXP_S32
	bool

config SOC_FAMILY
	default "nxp_s32" if SOC_FAMILY_NXP_S32

source "soc/nxp/s32/s32k1/Kconfig.soc"
source "soc/nxp/s32/s32k3/Kconfig.soc"
source "soc/nxp/s32/s32ze/Kconfig.soc"
```

## transform_projects/transform_zrtos/ZRTOS_demo1_output/soc/openhwgroup/cva6/Kconfig
```kconfig
# Copyright (c) 2024 CISPA Helmholtz Center for Information Security gGmbH
# SPDX-License-Identifier: Apache-2.0

if SOC_FAMILY_OPENHWGROUP_CVA6

source "soc/openhwgroup/cva6/cv32a6/Kconfig"
source "soc/openhwgroup/cva6/cv64a6/Kconfig"

endif # SOC_FAMILY_OPENHWGROUP_CVA6
```

## transform_projects/transform_zrtos/ZRTOS_demo1_output/soc/qemu/virt_riscv/Kconfig.soc
```kconfig
# Copyright (c) 2024 Antmicro <www.antmicro.com>
# SPDX-License-Identifier: Apache-2.0

config SOC_FAMILY_QEMU_VIRT_RISCV
	bool

config SOC_FAMILY
	default "qemu_virt_riscv" if SOC_FAMILY_QEMU_VIRT_RISCV

source "soc/qemu/virt_riscv/qemu_virt_riscv32/Kconfig.soc"
source "soc/qemu/virt_riscv/qemu_virt_riscv32e/Kconfig.soc"
source "soc/qemu/virt_riscv/qemu_virt_riscv64/Kconfig.soc"
```

## transform_projects/transform_zrtos/ZRTOS_demo1_output/soc/raspberrypi/rpi_pico/Kconfig.defconfig
```kconfig
# Raspberry Pi (RP) MCU line

# Copyright (c) 2021 Nordic Semiconductor ASA
# SPDX-License-Identifier: Apache-2.0

if SOC_FAMILY_RPI_PICO

source "soc/raspberrypi/rpi_pico/rp2040/Kconfig.defconfig"
source "soc/raspberrypi/rpi_pico/rp2350/Kconfig.defconfig"

endif # SOC_FAMILY_RPI_PICO
```

## transform_projects/transform_zrtos/ZRTOS_demo1_output/soc/renesas/ra/Kconfig.soc
```kconfig
# Copyright (c) 2023 TOKITA Hiroshi <tokita.hiroshi@fujitsu.com>
# SPDX-License-Identifier: Apache-2.0

config SOC_FAMILY_RENESAS_RA
	bool

config SOC_FAMILY
	default "renesas_ra" if SOC_FAMILY_RENESAS_RA

source "soc/renesas/ra/ra2a1/Kconfig.soc"
source "soc/renesas/ra/ra2l1/Kconfig.soc"
source "soc/renesas/ra/ra4e1/Kconfig.soc"
source "soc/renesas/ra/ra4e2/Kconfig.soc"
source "soc/renesas/ra/ra4l1/Kconfig.soc"
source "soc/renesas/ra/ra4m1/Kconfig.soc"
source "soc/renesas/ra/ra4m2/Kconfig.soc"
source "soc/renesas/ra/ra4m3/Kconfig.soc"
source "soc/renesas/ra/ra4w1/Kconfig.soc"
source "soc/renesas/ra/ra6e1/Kconfig.soc"
source "soc/renesas/ra/ra6e2/Kconfig.soc"
source "soc/renesas/ra/ra6m1/Kconfig.soc"
source "soc/renesas/ra/ra6m2/Kconfig.soc"
source "soc/renesas/ra/ra6m3/Kconfig.soc"
source "soc/renesas/ra/ra6m4/Kconfig.soc"
source "soc/renesas/ra/ra6m5/Kconfig.soc"
source "soc/renesas/ra/ra8d1/Kconfig.soc"
source "soc/renesas/ra/ra8m1/Kconfig.soc"
source "soc/renesas/ra/ra8p1/Kconfig.soc"
source "soc/renesas/ra/ra8t1/Kconfig.soc"
```

## transform_projects/transform_zrtos/ZRTOS_demo1_output/soc/renesas/rcar/Kconfig.defconfig
```kconfig
# Copyright (c) 2021 IoT.bzh
# SPDX-License-Identifier: Apache-2.0

if SOC_FAMILY_RENESAS_RCAR

source "soc/renesas/rcar/rcar_gen3/Kconfig.defconfig"

endif # SOC_FAMILY_RENESAS_RCAR
```

## transform_projects/transform_zrtos/ZRTOS_demo1_output/soc/renesas/rcar/Kconfig.soc
```kconfig
# Renesas R-Car SoC line
# Copyright (c) 2021 IoT.bzh
# SPDX-License-Identifier: Apache-2.0

config SOC_FAMILY_RENESAS_RCAR
	bool

config SOC_FAMILY
	default "renesas_rcar" if SOC_FAMILY_RENESAS_RCAR

source "soc/renesas/rcar/rcar_gen3/Kconfig.soc"
source "soc/renesas/rcar/rcar_gen4/Kconfig.soc"
```

## transform_projects/transform_zrtos/ZRTOS_demo1_output/soc/renesas/rcar/rcar_gen4/Kconfig.defconfig
```kconfig
# Renesas R-Car Gen4 SoC line

# Copyright (c) 2023 IoT.bzh
# SPDX-License-Identifier: Apache-2.0

if SOC_SERIES_RCAR_GEN4

source "soc/renesas/rcar/rcar_gen4/Kconfig.defconfig.r8a779f0"

endif # SOC_SERIES_RCAR_GEN4
```
