## transform_projects/transform_zrtos/ZRTOS_demo1_output/soc/arm/Kconfig
```kconfig
# Copyright (c) 2024 Nordic Semiconductor ASA
# SPDX-License-Identifier: Apache-2.0

if SOC_FAMILY_ARM || SOC_FAMILY_ARM64

source "soc/arm/beetle/Kconfig"
source "soc/arm/designstart/Kconfig"
source "soc/arm/fvp_aemv8a/Kconfig"
source "soc/arm/fvp_aemv8r/Kconfig"
source "soc/arm/mps2/Kconfig"
source "soc/arm/mps3/Kconfig"
source "soc/arm/mps4/Kconfig"
source "soc/arm/musca/Kconfig"
source "soc/arm/qemu_cortex_a53/Kconfig"
source "soc/arm/qemu_virt_arm64/Kconfig"

endif # SOC_FAMILY_ARM || SOC_FAMILY_ARM64
```

## transform_projects/transform_zrtos/ZRTOS_demo1_output/soc/arm/Kconfig.defconfig
```kconfig
# Copyright (c) 2024 Nordic Semiconductor ASA
# SPDX-License-Identifier: Apache-2.0

if SOC_FAMILY_ARM || SOC_FAMILY_ARM64

source "soc/arm/beetle/Kconfig.defconfig"
source "soc/arm/fvp_aemv8a/Kconfig.defconfig"
source "soc/arm/fvp_aemv8r/Kconfig.defconfig"
source "soc/arm/mps2/Kconfig.defconfig"
source "soc/arm/mps3/Kconfig.defconfig"
source "soc/arm/mps4/Kconfig.defconfig"
source "soc/arm/musca/Kconfig.defconfig"
source "soc/arm/qemu_cortex_a53/Kconfig.defconfig"
source "soc/arm/qemu_virt_arm64/Kconfig.defconfig"

endif # SOC_FAMILY_ARM || SOC_FAMILY_ARM64
```

## transform_projects/transform_zrtos/ZRTOS_demo1_output/soc/arm/Kconfig.soc
```kconfig
# Copyright (c) 2024 Nordic Semiconductor ASA
# SPDX-License-Identifier: Apache-2.0

config SOC_FAMILY_ARM
	bool

config SOC_FAMILY_ARM64
	bool

config SOC_FAMILY
	default "arm" if SOC_FAMILY_ARM
	default "arm64" if SOC_FAMILY_ARM64

source "soc/arm/beetle/Kconfig.soc"
source "soc/arm/designstart/Kconfig.soc"
source "soc/arm/fvp_aemv8a/Kconfig.soc"
source "soc/arm/fvp_aemv8r/Kconfig.soc"
source "soc/arm/mps2/Kconfig.soc"
source "soc/arm/mps3/Kconfig.soc"
source "soc/arm/mps4/Kconfig.soc"
source "soc/arm/musca/Kconfig.soc"
source "soc/arm/qemu_cortex_a53/Kconfig.soc"
source "soc/arm/qemu_virt_arm64/Kconfig.soc"
```

## transform_projects/transform_zrtos/ZRTOS_demo1_output/soc/arm/mps2/Kconfig.defconfig
```kconfig
# Copyright (c) 2017 Linaro Limited
# SPDX-License-Identifier: Apache-2.0

if SOC_SERIES_MPS2

config SYS_CLOCK_HW_CYCLES_PER_SEC
	default 25000000

source "soc/arm/mps2/Kconfig.defconfig.an383"
source "soc/arm/mps2/Kconfig.defconfig.an385"
source "soc/arm/mps2/Kconfig.defconfig.an386"
source "soc/arm/mps2/Kconfig.defconfig.an500"
source "soc/arm/mps2/Kconfig.defconfig.an521"

endif # SOC_SERIES_MPS2
```

## transform_projects/transform_zrtos/ZRTOS_demo1_output/soc/arm/mps3/Kconfig.defconfig
```kconfig
# Copyright (c) 2021 Linaro Limited
# SPDX-License-Identifier: Apache-2.0

if SOC_SERIES_MPS3

config SYS_CLOCK_HW_CYCLES_PER_SEC
	default 25000000

source "soc/arm/mps3/Kconfig.defconfig.mps3_corstone300"
source "soc/arm/mps3/Kconfig.defconfig.mps3_corstone310"

endif # SOC_SERIES_MPS3
```

## transform_projects/transform_zrtos/ZRTOS_demo1_output/soc/arm/mps4/Kconfig.defconfig
```kconfig
# Copyright 2025 Arm Limited and/or its affiliates <open-source-office@arm.com>
# SPDX-License-Identifier: Apache-2.0

if SOC_SERIES_MPS4

config SYS_CLOCK_HW_CYCLES_PER_SEC
	default $(dt_node_int_prop_int,$(dt_nodelabel_path,sysclk),clock-frequency)

source "soc/arm/mps4/Kconfig.defconfig.mps4_corstone315"
source "soc/arm/mps4/Kconfig.defconfig.mps4_corstone320"

endif # SOC_SERIES_MPS4
```

## transform_projects/transform_zrtos/ZRTOS_demo1_output/soc/aspeed/Kconfig.defconfig
```kconfig
# SPDX-License-Identifier: Apache-2.0
#
# Copyright (c) 2021 ASPEED Technology Inc.

if SOC_FAMILY_ASPEED

source "soc/aspeed/ast10x0/Kconfig.defconfig"

endif # SOC_FAMILY_ASPEED
```

## transform_projects/transform_zrtos/ZRTOS_demo1_output/soc/aspeed/ast10x0/Kconfig.defconfig
```kconfig
# SPDX-License-Identifier: Apache-2.0
#
# Copyright (c) 2021 ASPEED Technology Inc.

if SOC_SERIES_AST10X0

source "soc/aspeed/ast10x0/Kconfig.defconfig.ast1030"

config ICACHE_LINE_SIZE
	default 32

config DCACHE_LINE_SIZE
	default 32

endif # SOC_SERIES_AST10X0
```

## transform_projects/transform_zrtos/ZRTOS_demo1_output/soc/atmel/sam/Kconfig
```kconfig
# Copyright (c) 2024 Gerson Fernando Budke <nandojve@gmail.com>
# SPDX-License-Identifier: Apache-2.0

config SOC_FAMILY_ATMEL_SAM
	select ASF
	select HAS_SEGGER_RTT if ZEPHYR_SEGGER_MODULE

if SOC_FAMILY_ATMEL_SAM

source "soc/atmel/sam/common/Kconfig"
source "soc/atmel/sam/sam3x/Kconfig"
source "soc/atmel/sam/sam4e/Kconfig"
source "soc/atmel/sam/sam4l/Kconfig"
source "soc/atmel/sam/sam4s/Kconfig"
source "soc/atmel/sam/samx7x/Kconfig"

endif # SOC_FAMILY_ATMEL_SAM
```

## transform_projects/transform_zrtos/ZRTOS_demo1_output/soc/atmel/sam/Kconfig.defconfig
```kconfig
# Atmel SAM MCU family default configuration options

# Copyright (c) 2016 Piotr Mienkowski
# Copyright (c) 2024 Gerson Fernando Budke <nandojve@gmail.com>
# SPDX-License-Identifier: Apache-2.0

if SOC_FAMILY_ATMEL_SAM

source "soc/atmel/sam/sam3x/Kconfig.defconfig"
source "soc/atmel/sam/sam4e/Kconfig.defconfig"
source "soc/atmel/sam/sam4l/Kconfig.defconfig"
source "soc/atmel/sam/sam4s/Kconfig.defconfig"
source "soc/atmel/sam/samx7x/Kconfig.defconfig"

config CLOCK_CONTROL
	default y

config GPIO
	default y

config SYS_CLOCK_HW_CYCLES_PER_SEC
	default $(dt_node_int_prop_int,/cpus/cpu@0,clock-frequency)

config WATCHDOG
	default y

endif # SOC_FAMILY_ATMEL_SAM
```

## transform_projects/transform_zrtos/ZRTOS_demo1_output/soc/atmel/sam/Kconfig.soc
```kconfig
# Copyright (c) 2024 Gerson Fernando Budke <nandojve@gmail.com>
# SPDX-License-Identifier: Apache-2.0

config SOC_FAMILY_ATMEL_SAM
	bool

config SOC_FAMILY
	default "atmel_sam" if SOC_FAMILY_ATMEL_SAM

source "soc/atmel/sam/sam3x/Kconfig.soc"
source "soc/atmel/sam/sam4e/Kconfig.soc"
source "soc/atmel/sam/sam4l/Kconfig.soc"
source "soc/atmel/sam/sam4s/Kconfig.soc"
source "soc/atmel/sam/samx7x/Kconfig.soc"
```

## transform_projects/transform_zrtos/ZRTOS_demo1_output/soc/brcm/bcmvk/Kconfig.defconfig
```kconfig
# SPDX-License-Identifier: Apache-2.0
#
# Copyright 2020 Broadcom.
#

if SOC_FAMILY_BCMVK

source "soc/brcm/bcmvk/valkyrie/Kconfig.defconfig"

endif # SOC_FAMILY_BCMVK
```

## transform_projects/transform_zrtos/ZRTOS_demo1_output/soc/brcm/bcmvk/viper/Kconfig.defconfig
```kconfig
# Copyright 2020 Broadcom
# SPDX-License-Identifier: Apache-2.0

if SOC_SERIES_VIPER

source "soc/brcm/bcmvk/viper/Kconfig.defconfig.viper_bcm58402_a72"
source "soc/brcm/bcmvk/viper/Kconfig.defconfig.viper_bcm58402_m7"

endif # SOC_SERIES_VIPER
```

## transform_projects/transform_zrtos/ZRTOS_demo1_output/soc/ene/kb106x/Kconfig.defconfig
```kconfig
# Copyright (c) 2025 ENE Technology Inc.
# SPDX-License-Identifier: Apache-2.0

if SOC_FAMILY_KB106X

source "soc/ene/kb106x/kb106x/Kconfig.defconfig"

endif # SOC_FAMILY_KB106X
```

## transform_projects/transform_zrtos/ZRTOS_demo1_output/soc/espressif/Kconfig.defconfig
```kconfig
# Copyright (c) 2023 Espressif Systems (Shanghai) Co., Ltd.
# SPDX-License-Identifier: Apache-2.0

if SOC_FAMILY_ESPRESSIF_ESP32

source "soc/espressif/common/Kconfig.defconfig"
source "soc/espressif/esp32/Kconfig.defconfig"
source "soc/espressif/esp32c2/Kconfig.defconfig"
source "soc/espressif/esp32c3/Kconfig.defconfig"
source "soc/espressif/esp32c6/Kconfig.defconfig"
source "soc/espressif/esp32s2/Kconfig.defconfig"
source "soc/espressif/esp32s3/Kconfig.defconfig"

config HAS_FLASH_LOAD_OFFSET
	default y

config FLASH_LOAD_OFFSET
	default $(dt_node_reg_addr_hex,$(dt_nodelabel_path,boot_partition)) if ESP_SIMPLE_BOOT

endif # SOC_FAMILY_ESPRESSIF_ESP32
```

## transform_projects/transform_zrtos/ZRTOS_demo1_output/soc/espressif/Kconfig.soc
```kconfig
# Copyright (c) 2023 Espressif Systems (Shanghai) Co., Ltd.
# SPDX-License-Identifier: Apache-2.0

config SOC_FAMILY_ESPRESSIF_ESP32
	bool

config SOC_FAMILY
	default "espressif_esp32" if SOC_FAMILY_ESPRESSIF_ESP32

source "soc/espressif/esp32/Kconfig.soc"
source "soc/espressif/esp32c2/Kconfig.soc"
source "soc/espressif/esp32c3/Kconfig.soc"
source "soc/espressif/esp32c6/Kconfig.soc"
source "soc/espressif/esp32s2/Kconfig.soc"
source "soc/espressif/esp32s3/Kconfig.soc"
```

## transform_projects/transform_zrtos/ZRTOS_demo1_output/soc/gd/gd32/gd32e10x/Kconfig.defconfig.series
```kconfig
# Copyright (c) 2021 YuLong Yao <feilongphone@gmail.com>
# SPDX-License-Identifier: Apache-2.0

if SOC_SERIES_GD32E10X

source "soc/gd/gd32/gd32e10x/Kconfig.defconfig.gd32e103"

endif # SOC_SERIES_GD32E10X
```

## transform_projects/transform_zrtos/ZRTOS_demo1_output/soc/gd/gd32/gd32e50x/Kconfig.defconfig.series
```kconfig
# Copyright (c) 2022, Teslabs Engineering S.L.
# SPDX-License-Identifier: Apache-2.0

if SOC_SERIES_GD32E50X

source "soc/gd/gd32/gd32e50x/Kconfig.defconfig.gd32e507"

endif # SOC_SERIES_GD32E50X
```

## transform_projects/transform_zrtos/ZRTOS_demo1_output/soc/gd/gd32/gd32f3x0/Kconfig.defconfig.series
```kconfig
# Copyright (c) 2021 BrainCo Inc.
# SPDX-License-Identifier: Apache-2.0

if SOC_SERIES_GD32F3X0

source "soc/gd/gd32/gd32f3x0/Kconfig.defconfig.gd32f350"

endif # SOC_SERIES_GD32F3X0
```

## transform_projects/transform_zrtos/ZRTOS_demo1_output/soc/gd/gd32/gd32f4xx/Kconfig.defconfig.series
```kconfig
# Copyright (c) 2021, Teslabs Engineering S.L.
# SPDX-License-Identifier: Apache-2.0

if SOC_SERIES_GD32F4XX

source "soc/gd/gd32/gd32f4xx/Kconfig.defconfig.gd32f405"
source "soc/gd/gd32/gd32f4xx/Kconfig.defconfig.gd32f407"
source "soc/gd/gd32/gd32f4xx/Kconfig.defconfig.gd32f450"
source "soc/gd/gd32/gd32f4xx/Kconfig.defconfig.gd32f470"

endif # SOC_SERIES_GD32F4XX
```

## transform_projects/transform_zrtos/ZRTOS_demo1_output/soc/gd/gd32/gd32l23x/Kconfig.defconfig.series
```kconfig
# Copyright (c) 2022 BrainCo Inc.
# SPDX-License-Identifier: Apache-2.0

if SOC_SERIES_GD32L23X

source "soc/gd/gd32/gd32l23x/Kconfig.defconfig.gd32l233"

endif # SOC_SERIES_GD32L23X
```

## transform_projects/transform_zrtos/ZRTOS_demo1_output/soc/infineon/cat1a/Kconfig.defconfig
```kconfig
# PSOC CAT1A Configuration

# Copyright (c) 2024 Cypress Semiconductor Corporation.
# SPDX-License-Identifier: Apache-2.0

if SOC_FAMILY_INFINEON_CAT1A

source "soc/infineon/cat1a/psoc6_01/Kconfig.defconfig"
source "soc/infineon/cat1a/psoc6_02/Kconfig.defconfig"
source "soc/infineon/cat1a/psoc6_03/Kconfig.defconfig"
source "soc/infineon/cat1a/psoc6_04/Kconfig.defconfig"
source "soc/infineon/cat1a/psoc6_legacy/Kconfig.defconfig"

endif # SOC_FAMILY_INFINEON_CAT1A
```

## transform_projects/transform_zrtos/ZRTOS_demo1_output/soc/infineon/cat1b/Kconfig.defconfig
```kconfig
# PSOC CAT1B Configuration

# Copyright (c) 2024 Cypress Semiconductor Corporation.
# SPDX-License-Identifier: Apache-2.0

if SOC_FAMILY_INFINEON_CAT1B

source "soc/infineon/cat1b/cyw20829/Kconfig.defconfig"

endif # SOC_FAMILY_INFINEON_CAT1B
```
