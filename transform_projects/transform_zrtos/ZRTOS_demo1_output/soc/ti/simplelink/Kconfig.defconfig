## transform_projects/transform_zrtos/ZRTOS_demo1_output/soc/ti/simplelink/Kconfig.defconfig
```kconfig
# SPDX-License-Identifier: Apache-2.0
# Copyright (c) 2017 Zephyr Contributors

if SOC_FAMILY_TI_SIMPLELINK

source "soc/ti/simplelink/cc13x2_cc26x2/Kconfig.defconfig"
source "soc/ti/simplelink/cc13x2x7_cc26x2x7/Kconfig.defconfig"
source "soc/ti/simplelink/cc23x0/Kconfig.defconfig"

endif # SOC_FAMILY_TI_SIMPLELINK
```

## transform_projects/transform_zrtos/ZRTOS_demo1_output/soc/ti/simplelink/cc32xx/Kconfig.defconfig
```kconfig
# TI SimpleLink Family
# SPDX-License-Identifier: Apache-2.0
# Copyright (c) 2016-2017, Texas Instruments Incorporated

if SOC_SERIES_CC32XX

source "soc/ti/simplelink/cc32xx/Kconfig.defconfig.cc3220sf"
source "soc/ti/simplelink/cc32xx/Kconfig.defconfig.cc3235sf"

endif # SOC_SERIES_CC32XX
```

## transform_projects/transform_zrtos/ZRTOS_demo1_output/soc/ti/simplelink/msp432p4xx/Kconfig.defconfig
```kconfig
# TI SimpleLink MSP432P4XX
# Copyright (c) 2017, Linaro Ltd
# SPDX-License-Identifier: Apache-2.0

if SOC_SERIES_MSP432P4XX

source "soc/ti/simplelink/msp432p4xx/Kconfig.defconfig.msp432p401r"

endif # SOC_SERIES_MSP432P4XX
```

## transform_projects/transform_zrtos/ZRTOS_demo1_output/soc/wch/ch32v/Kconfig.defconfig
```kconfig
# Copyright (c) 2024 Michael Hope
# Copyright (c) 2024 Jianxiong Gu
# SPDX-License-Identifier: Apache-2.0

if SOC_FAMILY_CH32V

source "soc/wch/ch32v/ch32v00x/Kconfig.defconfig"
source "soc/wch/ch32v/qingke_v2a/Kconfig.defconfig"
source "soc/wch/ch32v/qingke_v4b/Kconfig.defconfig"
source "soc/wch/ch32v/qingke_v4c/Kconfig.defconfig"
source "soc/wch/ch32v/qingke_v4f/Kconfig.defconfig"

endif # SOC_FAMILY_CH32V
```

## transform_projects/transform_zrtos/ZRTOS_demo1_output/soc/wch/ch32v/ch32v00x/Kconfig.defconfig
```kconfig
# Copyright (c) 2025 Michael Hope <michaelh@juju.nz>
# SPDX-License-Identifier: Apache-2.0

if SOC_SERIES_CH32V00X

config SYS_CLOCK_HW_CYCLES_PER_SEC
	default $(dt_node_int_prop_int,/cpus/cpu@0,clock-frequency)

config CLOCK_CONTROL
	default y

source "soc/wch/ch32v/ch32v00x/Kconfig.defconfig.ch32v006"

endif # SOC_SERIES_CH32V00X
```

## transform_projects/transform_zrtos/ZRTOS_demo1_output/subsys/logging/Kconfig
```kconfig
# Copyright (c) 2016 Intel Corporation
# SPDX-License-Identifier: Apache-2.0

menu "Logging"

config LOG
	bool "Logging"
	select PRINTK if USERSPACE
	help
	  Global switch for the logger, when turned off log calls will not be
	  compiled in.

if LOG

config LOG_CORE_INIT_PRIORITY
	int "Log Core Initialization Priority"
	range 0 99
	default 0

source "subsys/logging/Kconfig.mode"

source "subsys/logging/Kconfig.filtering"

source "subsys/logging/Kconfig.processing"

if !LOG_MODE_MINIMAL

source "subsys/logging/Kconfig.formatting"

if !LOG_FRONTEND_ONLY

source "subsys/logging/backends/Kconfig"

endif # !LOG_FRONTEND_ONLY

endif # !LOG_MODE_MINIMAL

if LOG_FRONTEND

source "subsys/logging/frontends/Kconfig"

endif #LOG_FRONTEND

if LOG_MULTIDOMAIN

source "subsys/logging/Kconfig.links"

endif

source "subsys/logging/Kconfig.misc"

endif # LOG

config LOG_OUTPUT
	bool "Formatter helper"
	help
	  Module which provides formatting of log messages to a human-readable
	  strings.

endmenu
```

## transform_projects/transform_zrtos/ZRTOS_demo1_output/subsys/logging/Kconfig.mode
```kconfig
# Copyright (c) 2021 Nordic Semiconductor ASA
# SPDX-License-Identifier: Apache-2.0

config LOG_FRONTEND
	bool "Frontend"
	help
	  When enabled, logs are redirected to a custom frontend which is the
	  fastest way of getting logs out. The logs are redirected at the function
	  level. To redirect logs at the macro level, see LOG_CUSTOM_HEADER.

config LOG_FRONTEND_ONLY
	bool "No backends"
	depends on LOG_FRONTEND
	help
	  Option indicates that there are no backends intended to be used.
	  Code asserts if any backend is enabled.

config LOG_FRONTEND_OPT_API
	bool "Frontend optimized API"
	help
	  When enabled, frontend implements functions which are optimized versions
	  used for the most common log messages.

config LOG_CUSTOM_HEADER
	bool "Include Custom Log Header"
	help
	  When enabled, a custom application provided header, named
	  "zephyr_custom_log.h", is included at the end of log.h. This enables
	  extension of the LOG_* APIs at the macro level. Please use cautiously!
	  The internal LOG API may change in future releases.

config LOG_DEFAULT_MINIMAL
	bool

config LOG_MULTIDOMAIN
	bool "Multi-domain logger"
	select LOG_TIMESTAMP_64BIT

if LOG_MODE_DEFERRED

config LOG_FLUSH_SLEEP_US
	int "Sleep time when flushing the log queue, microseconds"
	range 100 100000
	default 10000
	help
	  In deferred logging mode this is the time, used in
	  log_flush() on each sleep iteration in microseconds.

endif # LOG_MODE_DEFERRED
```

## transform_projects/transform_zrtos/ZRTOS_demo1_output/subsys/mgmt/mcumgr/grp/Kconfig
```kconfig
# Copyright Runtime.io 2018. All rights reserved.
# Copyright Nordic Semiconductor ASA 2020-2022. All rights reserved.
# SPDX-License-Identifier: Apache-2.0

source "subsys/mgmt/mcumgr/grp/fs_mgmt/Kconfig"

source "subsys/mgmt/mcumgr/grp/img_mgmt/Kconfig"

source "subsys/mgmt/mcumgr/grp/img_mgmt_client/Kconfig"

source "subsys/mgmt/mcumgr/grp/os_mgmt/Kconfig"

source "subsys/mgmt/mcumgr/grp/os_mgmt_client/Kconfig"

source "subsys/mgmt/mcumgr/grp/shell_mgmt/Kconfig"

source "subsys/mgmt/mcumgr/grp/stat_mgmt/Kconfig"

source "subsys/mgmt/mcumgr/grp/zephyr_basic/Kconfig"

source "subsys/mgmt/mcumgr/grp/settings_mgmt/Kconfig"

source "subsys/mgmt/mcumgr/grp/enum_mgmt/Kconfig"
```

## transform_projects/transform_zrtos/ZRTOS_demo1_output/subsys/pm/policy/Kconfig
```kconfig
# Copyright (c) 2024 Nordic Semiconductor ASA
# SPDX-License-Identifier: Apache-2.0

if PM

config PM_POLICY_DEVICE_CONSTRAINTS
	bool "Power state constraints per device"
	help
	  This option allows devices to have a list of power states
	  that when the system transition to them, cause power loss in the device.
	  This used to set and release power state constraints when
	  it is needed by the device.

endif # PM

config PM_POLICY_LATENCY_STANDALONE
	bool "Allow gathering latency requirements in standalone mode"
	depends on !PM
	help
	  This option allows using the pm_policy_latency* APIs to gather latency
	  requirements on systems that do not support PM (e.g. systems whithout
	  CPU idle states). Because the API has a subscription mechanism, it can
	  be useful to perform system-level adjustments based on latency
	  requirements gathered from multiple system components.
```

## transform_projects/transform_zrtos/ZRTOS_demo1_output/subsys/random/Kconfig
```kconfig
# Random configuration options

# Copyright (c) 2017 Intel Corporation
# SPDX-License-Identifier: Apache-2.0

menu "Random Number Generators"

config TEST_RANDOM_GENERATOR
	bool "Allow non-random number generator"
	help
	  This option signifies that a non-random number generator is allowed to
	  be used and the kernel's random number APIs are permitted to return
	  values that are not truly random.

	  This capability is provided for testing purposes when a truly random
	  number generator is not available. The non-random number generator
	  should not be used in a production environment.

	  This option is intended to be selected only by application-level
	  configurations (e.g. in tests and samples) to indicate that the
	  application is allowed to run with a random number generator that is not
	  truly random. Board-level configurations must not select this option
	  unless the sole purpose of the board is testing (e.g. QEMU emulation
	  boards).

	  Note that this option does not imply that a non-random number generator
	  is selected -- that is indicated by RNG_GENERATOR_CHOICE. An entropy
	  device-backed random number generator, if available, will be selected by
	  default even when CONFIG_TEST_RANDOM_GENERATOR=y.

config TIMER_RANDOM_INITIAL_STATE
	int "Initial state used by clock based number generator"
	default 123456789
	help
	  Initial state value used by TIMER_RANDOM_GENERATOR and
	  early random number genenator.

DT_CHOSEN_Z_ENTROPY := zephyr,entropy
config CSPRNG_AVAILABLE
	bool
	default y if $(dt_chosen_enabled,$(DT_CHOSEN_Z_ENTROPY))
	help
	  Helper that can be used to check if the platform is capable of generating
	  CS random values. For this to be enabled, there must be the "zephyr,entropy"
	  chosen property defined in the devicetree. This means that there is an
	  HW entropy generator that can be used for this purpose.
	  Once CONFIG_CSPRNG_AVAILABLE is set, then CONFIG_ENTROPY_GENERATOR can
	  be enabled to enable the platform specific entropy driver.

#
# Implied dependency on a cryptographically secure entropy source when
# enabling CS generators. ENTROPY_HAS_DRIVER is the flag indicating the
# CS entropy source.
#
config CSPRNG_ENABLED
	bool
	default y
	depends on ENTROPY_HAS_DRIVER

config CS_CTR_DRBG_PERSONALIZATION
	string "CTR-DRBG Personalization string"
	default "zephyr ctr-drbg seed"
	depends on CTR_DRBG_CSPRNG_GENERATOR
	help
	  Personalization data can be provided in addition to the entropy
	  source to make the initialization of the CTR-DRBG as unique as
	  possible.

endmenu
```

## transform_projects/transform_zrtos/ZRTOS_demo1_output/subsys/usb/device_next/class/Kconfig
```kconfig
# Copyright (c) 2022 Nordic Semiconductor ASA
#
# SPDX-License-Identifier: Apache-2.0

source "subsys/usb/device_next/class/Kconfig.loopback"
source "subsys/usb/device_next/class/Kconfig.cdc_acm"
source "subsys/usb/device_next/class/Kconfig.cdc_ecm"
source "subsys/usb/device_next/class/Kconfig.cdc_ncm"
source "subsys/usb/device_next/class/Kconfig.bt"
source "subsys/usb/device_next/class/Kconfig.msc"
source "subsys/usb/device_next/class/Kconfig.uac2"
source "subsys/usb/device_next/class/Kconfig.hid"
source "subsys/usb/device_next/class/Kconfig.midi2"
source "subsys/usb/device_next/class/Kconfig.dfu"
source "subsys/usb/device_next/class/Kconfig.uvc"
```
