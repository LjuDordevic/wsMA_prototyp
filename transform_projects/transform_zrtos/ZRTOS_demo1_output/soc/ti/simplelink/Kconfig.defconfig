## transform_projects/transform_zrtos/ZRTOS_demo2_output/soc/atmel/sam0/Kconfig
```kconfig
# Atmel SAM0 MCU family configuration options

# Copyright (c) 2017 Google LLC.
# Copyright (c) 2024 Gerson Fernando Budke <nandojve@gmail.com>
# SPDX-License-Identifier: Apache-2.0

config SOC_FAMILY_ATMEL_SAM0
	select ASF
	select HAS_SEGGER_RTT if ZEPHYR_SEGGER_MODULE

if SOC_FAMILY_ATMEL_SAM0

source "soc/atmel/sam0/common/Kconfig.samd2x"
source "soc/atmel/sam0/common/Kconfig.samd5x"
source "soc/atmel/sam0/common/Kconfig.saml2x"
source "soc/atmel/sam0/samc20/Kconfig"
source "soc/atmel/sam0/samc21/Kconfig"
source "soc/atmel/sam0/samd20/Kconfig"
source "soc/atmel/sam0/samd21/Kconfig"
source "soc/atmel/sam0/samd51/Kconfig"
source "soc/atmel/sam0/same51/Kconfig"
source "soc/atmel/sam0/same53/Kconfig"
source "soc/atmel/sam0/same54/Kconfig"
source "soc/atmel/sam0/saml21/Kconfig"
source "soc/atmel/sam0/samr21/Kconfig"
source "soc/atmel/sam0/samr34/Kconfig"
source "soc/atmel/sam0/samr35/Kconfig"

endif # SOC_FAMILY_ATMEL_SAM0
```

## transform_projects/transform_zrtos/ZRTOS_demo2_output/soc/bflb/Kconfig
```kconfig
# Copyright (c) 2021-2025 ATL Electronics
#
# SPDX-License-Identifier: Apache-2.0

config SOC_FAMILY_BFLB
	select HAS_BFLB_HAL

if SOC_FAMILY_BFLB

source "soc/bflb/bl60x/Kconfig"

endif # SOC_FAMILY_BFLB
```

## transform_projects/transform_zrtos/ZRTOS_demo2_output/soc/common/Kconfig
```kconfig
# Copyright (c) 2024 Nordic Semiconductor ASA
# SPDX-License-Identifier: Apache-2.0

if RISCV_PRIVILEGED

source "soc/common/riscv-privileged/Kconfig"

endif # RISCV_PRIVILEGED
```
