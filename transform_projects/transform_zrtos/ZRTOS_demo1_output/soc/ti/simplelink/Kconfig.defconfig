## transform_projects/transform_zrtos/ZRTOS_demo2_output/build/Kconfig/Kconfig.modules
```kconfig
menu "acpica (/home/ljd/wsMA_prototyp/ZRTOS_demo1_without_defconfig/modules/lib/acpica)"
source "modules/acpica/Kconfig"
config ZEPHYR_ACPICA_MODULE
	bool
	default y
endmenu
menu "cmsis (/home/ljd/wsMA_prototyp/ZRTOS_demo1_without_defconfig/modules/hal/cmsis)"
source "modules/cmsis/Kconfig"
config ZEPHYR_CMSIS_MODULE
	bool
	default y
endmenu
menu "cmsis-dsp (/home/ljd/wsMA_prototyp/ZRTOS_demo1_without_defconfig/modules/lib/cmsis-dsp)"
source "modules/cmsis-dsp/Kconfig"
config ZEPHYR_CMSIS_DSP_MODULE
	bool
	default y
endmenu
menu "cmsis-nn (/home/ljd/wsMA_prototyp/ZRTOS_demo1_without_defconfig/modules/lib/cmsis-nn)"
source "modules/cmsis-nn/Kconfig"
config ZEPHYR_CMSIS_NN_MODULE
	bool
	default y
endmenu
menu "cmsis_6 (/home/ljd/wsMA_prototyp/ZRTOS_demo1_without_defconfig/modules/hal/cmsis_6)"
source "modules/cmsis_6/Kconfig"
config ZEPHYR_CMSIS_6_MODULE
	bool
	default y
endmenu
menu "fatfs (/home/ljd/wsMA_prototyp/ZRTOS_demo1_without_defconfig/modules/fs/fatfs)"
source "modules/fatfs/Kconfig"
config ZEPHYR_FATFS_MODULE
	bool
	default y
endmenu
config ZEPHYR_ADI_MODULE
	bool
	default y
menu "hal_afbr (/home/ljd/wsMA_prototyp/ZRTOS_demo1_without_defconfig/modules/hal/afbr)"
source "modules/hal_afbr/Kconfig"
config ZEPHYR_HAL_AFBR_MODULE
	bool
	default y

config ZEPHYR_HAL_AFBR_MODULE_BLOBS
	bool
endmenu
menu "hal_ambiq (/home/ljd/wsMA_prototyp/ZRTOS_demo1_without_defconfig/modules/hal/ambiq)"
config ZEPHYR_HAL_AMBIQ_MODULE
	bool
	default y
endmenu
config ZEPHYR_ATMEL_MODULE
	bool
	default y
menu "hal_bouffalolab (/home/ljd/wsMA_prototyp/ZRTOS_demo1_without_defconfig/modules/hal/bouffalolab)"
source "modules/hal_bouffalolab/Kconfig"
config ZEPHYR_HAL_BOUFFALOLAB_MODULE
	bool
	default y
endmenu
menu "hal_espressif (/home/ljd/wsMA_prototyp/ZRTOS_demo1_without_defconfig/modules/hal/espressif)"
source "/home/ljd/wsMA_prototyp/ZRTOS_demo1_without_defconfig/modules/hal/espressif/zephyr/Kconfig"
config ZEPHYR_HAL_ESPRESSIF_MODULE
	bool
	default y

config ZEPHYR_HAL_ESPRESSIF_MODULE_BLOBS
	bool
endmenu
menu "hal_ethos_u (/home/ljd/wsMA_prototyp/ZRTOS_demo1_without_defconfig/modules/hal/ethos_u)"
source "modules/hal_ethos_u/Kconfig"
config ZEPHYR_HAL_ETHOS_U_MODULE
	bool
	default y
endmenu
menu "hal_gigadevice (/home/ljd/wsMA_prototyp/ZRTOS_demo1_without_defconfig/modules/hal/gigadevice)"
source "modules/hal_gigadevice/Kconfig"
config ZEPHYR_HAL_GIGADEVICE_MODULE
	bool
	default y
endmenu
menu "hal_infineon (/home/ljd/wsMA_prototyp/ZRTOS_demo1_without_defconfig/modules/hal/infineon)"
source "modules/hal_infineon/Kconfig"
config ZEPHYR_HAL_INFINEON_MODULE
	bool
	default y

config ZEPHYR_HAL_INFINEON_MODULE_BLOBS
	bool
endmenu
menu "hal_intel (/home/ljd/wsMA_prototyp/ZRTOS_demo1_without_defconfig/modules/hal/intel)"
source "/home/ljd/wsMA_prototyp/ZRTOS_demo1_without_defconfig/modules/hal/intel/zephyr/Kconfig"
config ZEPHYR_HAL_INTEL_MODULE
	bool
	default y
endmenu
config ZEPHYR_MICROCHIP_MODULE
	bool
	default y
menu "hal_nordic (/home/ljd/wsMA_prototyp/ZRTOS_demo1_without_defconfig/modules/hal/nordic)"
source "modules/hal_nordic/Kconfig"
config ZEPHYR_HAL_NORDIC_MODULE
	bool
	default y

config ZEPHYR_HAL_NORDIC_MODULE_BLOBS
	bool
endmenu
config ZEPHYR_NUVOTON_MODULE
	bool
	default y
menu "hal_nxp (/home/ljd/wsMA_prototyp/ZRTOS_demo1_without_defconfig/modules/hal/nxp)"
source "modules/hal_nxp/Kconfig"
config ZEPHYR_HAL_NXP_MODULE
	bool
	default y

config ZEPHYR_HAL_NXP_MODULE_BLOBS
	bool
endmenu
config ZEPHYR_OPENISA_MODULE
	bool
	default y
config ZEPHYR_QUICKLOGIC_MODULE
	bool
	default y
config ZEPHYR_HAL_RENESAS_MODULE
	bool
	default y

config ZEPHYR_HAL_RENESAS_MODULE_BLOBS
	bool
menu "hal_rpi_pico (/home/ljd/wsMA_prototyp/ZRTOS_demo1_without_defconfig/modules/hal/rpi_pico)"
source "modules/hal_rpi_pico/Kconfig"
config ZEPHYR_HAL_RPI_PICO_MODULE
	bool
	default y
endmenu
menu "hal_silabs (/home/ljd/wsMA_prototyp/ZRTOS_demo1_without_defconfig/modules/hal/silabs)"
source "modules/hal_silabs/Kconfig"
config ZEPHYR_HAL_SILABS_MODULE
	bool
	default y

config ZEPHYR_HAL_SILABS_MODULE_BLOBS
	bool
endmenu
menu "hal_st (/home/ljd/wsMA_prototyp/ZRTOS_demo1_without_defconfig/modules/hal/st)"
source "modules/hal_st/Kconfig"
config ZEPHYR_HAL_ST_MODULE
	bool
	default y
endmenu
config ZEPHYR_HAL_STM32_MODULE
	bool
	default y

config ZEPHYR_HAL_STM32_MODULE_BLOBS
	bool
menu "hal_tdk (/home/ljd/wsMA_prototyp/ZRTOS_demo1_without_defconfig/modules/hal/tdk)"
source "modules/hal_tdk/Kconfig"
config ZEPHYR_HAL_TDK_MODULE
	bool
	default y
endmenu
menu "hal_telink (/home/ljd/wsMA_prototyp/ZRTOS_demo1_without_defconfig/modules/hal/telink)"
config ZEPHYR_HAL_TELINK_MODULE
	bool
	default y
endmenu
config ZEPHYR_TI_MODULE
	bool
	default y
menu "hal_wch (/home/ljd/wsMA_prototyp/ZRTOS_demo1_without_defconfig/modules/hal/wch)"
config ZEPHYR_HAL_WCH_MODULE
	bool
	default y
endmenu
config ZEPHYR_HAL_WURTHELEKTRONIK_MODULE
	bool
	default y
config ZEPHYR_XTENSA_MODULE
	bool
	default y
menu "hostap (/home/ljd/wsMA_prototyp/ZRTOS_demo1_without_defconfig/modules/lib/hostap)"
source "modules/hostap/Kconfig"
config ZEPHYR_HOSTAP_MODULE
	bool
	default y
endmenu
menu "liblc3 (/home/ljd/wsMA_prototyp/ZRTOS_demo1_without_defconfig/modules/lib/liblc3)"
source "modules/liblc3/Kconfig"
config ZEPHYR_LIBLC3_MODULE
	bool
	default y
endmenu
config ZEPHYR_LIBMCTP_MODULE
	bool
	default y
config ZEPHYR_LIBMETAL_MODULE
	bool
	default y
menu "littlefs (/home/ljd/wsMA_prototyp/ZRTOS_demo1_without_defconfig/modules/fs/littlefs)"
source "modules/littlefs/Kconfig"
config ZEPHYR_LITTLEFS_MODULE
	bool
	default y
endmenu
menu "loramac-node (/home/ljd/wsMA_prototyp/ZRTOS_demo1_without_defconfig/modules/lib/loramac-node)"
source "modules/loramac-node/Kconfig"
config ZEPHYR_LORAMAC_NODE_MODULE
	bool
	default y
endmenu
menu "lvgl (/home/ljd/wsMA_prototyp/ZRTOS_demo1_without_defconfig/modules/lib/gui/lvgl)"
config ZEPHYR_LVGL_MODULE
	bool
	default y
endmenu
menu "mbedtls (/home/ljd/wsMA_prototyp/ZRTOS_demo1_without_defconfig/modules/crypto/mbedtls)"
source "modules/mbedtls/Kconfig"
config ZEPHYR_MBEDTLS_MODULE
	bool
	default y
endmenu
config ZEPHYR_MCUBOOT_MODULE
	bool
	default y
config ZEPHYR_MIPI_SYS_T_MODULE
	bool
	default y
menu "nrf_wifi (/home/ljd/wsMA_prototyp/ZRTOS_demo1_without_defconfig/modules/lib/nrf_wifi)"
source "modules/nrf_wifi/Kconfig"
config ZEPHYR_NRF_WIFI_MODULE
	bool
	default y

config ZEPHYR_NRF_WIFI_MODULE_BLOBS
	bool
endmenu
config ZEPHYR_OPEN_AMP_MODULE
	bool
	default y
menu "openthread (/home/ljd/wsMA_prototyp/ZRTOS_demo1_without_defconfig/modules/lib/openthread)"
source "modules/openthread/Kconfig"
config ZEPHYR_OPENTHREAD_MODULE
	bool
	default y
endmenu
menu "percepio (/home/ljd/wsMA_prototyp/ZRTOS_demo1_without_defconfig/modules/debug/percepio)"
source "/home/ljd/wsMA_prototyp/ZRTOS_demo1_without_defconfig/modules/debug/percepio/zephyr/Kconfig"
config ZEPHYR_PERCEPIO_MODULE
	bool
	default y
endmenu
menu "picolibc (/home/ljd/wsMA_prototyp/ZRTOS_demo1_without_defconfig/modules/lib/picolibc)"
source "/home/ljd/wsMA_prototyp/ZRTOS_demo1_without_defconfig/modules/lib/picolibc/zephyr/Kconfig"
config ZEPHYR_PICOLIBC_MODULE
	bool
	default y
endmenu
menu "segger (/home/ljd/wsMA_prototyp/ZRTOS_demo1_without_defconfig/modules/debug/segger)"
source "modules/segger/Kconfig"
config ZEPHYR_SEGGER_MODULE
	bool
	default y
endmenu
config ZEPHYR_TINYCRYPT_MODULE
	bool
	default y
menu "trusted-firmware-a (/home/ljd/wsMA_prototyp/ZRTOS_demo1_without_defconfig/modules/tee/tf-a/trusted-firmware-a)"
source "modules/trusted-firmware-a/Kconfig"
config ZEPHYR_TRUSTED_FIRMWARE_A_MODULE
	bool
	default y
endmenu
menu "trusted-firmware-m (/home/ljd/wsMA_prototyp/ZRTOS_demo1_without_defconfig/modules/tee/tf-m/trusted-firmware-m)"
config ZEPHYR_TRUSTED_FIRMWARE_M_MODULE
	bool
	default y
endmenu
menu "uoscore-uedhoc (/home/ljd/wsMA_prototyp/ZRTOS_demo1_without_defconfig/modules/lib/uoscore-uedhoc)"
source "modules/uoscore-uedhoc/Kconfig"
config ZEPHYR_UOSCORE_UEDHOC_MODULE
	bool
	default y
endmenu
menu "zcbor (/home/ljd/wsMA_prototyp/ZRTOS_demo1_without_defconfig/modules/lib/zcbor)"
source "modules/zcbor/Kconfig"
config ZEPHYR_ZCBOR_MODULE
	bool
	default y
endmenu
config ZEPHYR_NRF_HW_MODELS_MODULE
	bool
	default y
```

## transform_projects/transform_zrtos/ZRTOS_demo2_output/build/Kconfig/arch/Kconfig
```kconfig
# Load Zephyr Arch Kconfig descriptions.
source "arch/rx/Kconfig"
source "arch/x86/Kconfig"
source "arch/xtensa/Kconfig"
source "arch/sparc/Kconfig"
source "arch/riscv/Kconfig"
source "arch/posix/Kconfig"
source "arch/mips/Kconfig"
source "arch/arm64/Kconfig"
source "arch/arm/Kconfig"
source "arch/arc/Kconfig"
```

## transform_projects/transform_zrtos/ZRTOS_demo2_output/build/Kconfig/boards/Kconfig
```kconfig
# Load Zephyr board Kconfig descriptions.
source "boards/native/native_sim/Kconfig"
```

## transform_projects/transform_zrtos/ZRTOS_demo2_output/build/Kconfig/boards/Kconfig.native_sim
```kconfig
# Load board Kconfig descriptions.
source "boards/native/native_sim/Kconfig.native_sim"
```

## transform_projects/transform_zrtos/ZRTOS_demo2_output/build/Kconfig/soc/Kconfig
```kconfig
# Load Zephyr SoC Kconfig descriptions.
source "soc/xlnx/zynqmp/Kconfig"
source "soc/xlnx/versalnet/Kconfig"
source "soc/xlnx/versal2/Kconfig"
source "soc/xen/Kconfig"
source "soc/wch/ch32v/Kconfig"
source "soc/ti/simplelink/Kconfig"
source "soc/ti/mspm0/Kconfig"
source "soc/ti/lm3s6965/Kconfig"
source "soc/starfive/jh71xx/Kconfig"
source "soc/st/stm32/Kconfig"
source "soc/snps/qemu_arc/Kconfig"
source "soc/snps/hsdk4xd/Kconfig"
source "soc/snps/hsdk/Kconfig"
source "soc/snps/emsk/Kconfig"
source "soc/snps/emsdp/Kconfig"
source "soc/snps/arc_iot/Kconfig"
source "soc/silabs/Kconfig"
source "soc/renode/riscv_virtual/Kconfig"
source "soc/renode/cortex_r8_virtual/Kconfig"
source "soc/renesas/rz/Kconfig"
source "soc/renesas/rx/Kconfig"
source "soc/renesas/ra/Kconfig"
source "soc/realtek/ec/Kconfig"
source "soc/quicklogic/eos_s3/Kconfig"
source "soc/qemu/virt_riscv/Kconfig"
source "soc/qemu/malta/Kconfig"
source "soc/openisa/rv32m1/Kconfig"
source "soc/oct/osd32mp15x/Kconfig"
source "soc/nxp/rw/Kconfig"
source "soc/nxp/lpc/Kconfig"
source "soc/nxp/kinetis/Kconfig"
source "soc/nxp/imxrt/Kconfig"
source "soc/nxp/imx/Kconfig"
source "soc/nuvoton/numicro/Kconfig"
source "soc/nuvoton/numaker/Kconfig"
source "soc/nuvoton/npcx/Kconfig"
source "soc/nordic/Kconfig"
source "soc/neorv32/Kconfig"
source "soc/native/inf_clock/Kconfig"
source "soc/microchip/sam/Kconfig"
source "soc/microchip/mec/Kconfig"
source "soc/mediatek/mt8xxx/Kconfig"
source "soc/lowrisc/opentitan/Kconfig"
source "soc/litex/litex_vexriscv/Kconfig"
source "soc/intel/raptor_lake/Kconfig"
source "soc/intel/lakemont/Kconfig"
source "soc/intel/intel_ish/Kconfig"
source "soc/intel/intel_adsp/Kconfig"
source "soc/intel/elkhart_lake/Kconfig"
source "soc/intel/atom/Kconfig"
source "soc/intel/apollo_lake/Kconfig"
source "soc/intel/alder_lake/Kconfig"
source "soc/infineon/cat3/Kconfig"
source "soc/infineon/cat1a/Kconfig"
source "soc/gd/gd32/Kconfig"
source "soc/gaisler/leon3/Kconfig"
source "soc/gaisler/gr716a/Kconfig"
source "soc/espressif/Kconfig"
source "soc/ene/kb1200/Kconfig"
source "soc/ene/kb106x/Kconfig"
source "soc/efinix/sapphire/Kconfig"
source "soc/cdns/xtensa_sample_controller/Kconfig"
source "soc/cdns/sample_controller32/Kconfig"
source "soc/cdns/dc233c/Kconfig"
source "soc/brcm/bcm2712/Kconfig"
source "soc/brcm/bcm2711/Kconfig"
source "soc/bflb/Kconfig"
source "soc/atmel/sam0/Kconfig"
source "soc/atmel/sam/Kconfig"
source "soc/aspeed/Kconfig"
source "soc/arm/beetle/Kconfig"
source "soc/antmicro/myra/Kconfig"
source "soc/amd/acp_6_0/Kconfig"
source "soc/adi/max32/Kconfig"
```

## transform_projects/transform_zrtos/ZRTOS_demo2_output/drivers/comparator/Kconfig
```kconfig
# Copyright (c) 2024 Nordic Semiconductor ASA
# SPDX-License-Identifier: Apache-2.0

menuconfig COMPARATOR
	bool "Comparator drivers"
	help
	  Enable comparator driver configuration.

if COMPARATOR

module = COMPARATOR
module-str = comparator
source "subsys/logging/Kconfig.template.log_config"

config COMPARATOR_INIT_PRIORITY
	int "COMPARATOR init priority"
	default KERNEL_INIT_PRIORITY_DEVICE
	help
	  Comparator device driver initialization priority.

source "drivers/comparator/Kconfig.fake_comp"
source "drivers/comparator/Kconfig.silabs_acmp"
source "drivers/comparator/Kconfig.it51xxx_vcmp"
source "drivers/comparator/Kconfig.mcux_acmp"
source "drivers/comparator/Kconfig.nrf_comp"
source "drivers/comparator/Kconfig.nrf_lpcomp"
source "drivers/comparator/Kconfig.shell"
source "drivers/comparator/Kconfig.renesas_ra"

endif # COMPARATOR
```

## transform_projects/transform_zrtos/ZRTOS_demo2_output/lib/hash/Kconfig
```kconfig
# Copyright (c) 2022 Meta
#
# SPDX-License-Identifier: Apache-2.0
source "lib/hash/Kconfig.hash_func"
source "lib/hash/Kconfig.hash_map"
```

## transform_projects/transform_zrtos/ZRTOS_demo2_output/lib/posix/Kconfig
```kconfig
# Copyright (c) 2024 Meta
#
# SPDX-License-Identifier: Apache-2.0

menu "POSIX API Support"

source "lib/posix/options/Kconfig"
source "lib/posix/shell/Kconfig"

endmenu # "POSIX API Support"
```

## transform_projects/transform_zrtos/ZRTOS_demo2_output/lib/posix/options/Kconfig
```kconfig
# Copyright (c) 2018 Intel Corporation
# Copyright (c) 2023 Meta
# Copyright (c) 2024 Tenstorrent AI ULC
#
# SPDX-License-Identifier: Apache-2.0

menu "POSIX Options"

source "lib/posix/options/Kconfig.profile"

source "lib/posix/options/Kconfig.aio"
source "lib/posix/options/Kconfig.barrier"
source "lib/posix/options/Kconfig.c_lang_r"
source "lib/posix/options/Kconfig.c_lib_ext"
source "lib/posix/options/Kconfig.device_io"
source "lib/posix/options/Kconfig.fd_mgmt"
source "lib/posix/options/Kconfig.file_system_r"
source "lib/posix/options/Kconfig.fs"
source "lib/posix/options/Kconfig.mem"
source "lib/posix/options/Kconfig.mqueue"
source "lib/posix/options/Kconfig.net"
source "lib/posix/options/Kconfig.proc1"
source "lib/posix/options/Kconfig.procN"
source "lib/posix/options/Kconfig.pthread"
source "lib/posix/options/Kconfig.rwlock"
source "lib/posix/options/Kconfig.sched"
source "lib/posix/options/Kconfig.semaphore"
source "lib/posix/options/Kconfig.signal"
source "lib/posix/options/Kconfig.spinlock"
source "lib/posix/options/Kconfig.sync_io"
source "lib/posix/options/Kconfig.timer"

menu "X/Open system interfaces"

source "lib/posix/options/Kconfig.xsi_realtime"
source "lib/posix/options/Kconfig.xsi_single_process"
source "lib/posix/options/Kconfig.xsi_streams"
source "lib/posix/options/Kconfig.xsi_system_logging"
source "lib/posix/options/Kconfig.xsi_threads_ext"

endmenu # "X/Open system interfaces"

source "lib/posix/options/Kconfig.compat"

source "lib/posix/options/Kconfig.toolchain"

endmenu # "POSIX Options"
```

## transform_projects/transform_zrtos/ZRTOS_demo2_output/soc/aesc/Kconfig.soc
```kconfig
# Copyright (c) 2025 Aesc Silicon
# SPDX-License-Identifier: Apache-2.0

source "soc/aesc/nitrogen/Kconfig.soc"
```

## transform_projects/transform_zrtos/ZRTOS_demo2_output/soc/andestech/Kconfig.soc
```kconfig
# Copyright (c) 2024 Nordic Semiconductor ASA
# SPDX-License-Identifier: Apache-2.0

config SOC_FAMILY_ANDES_V5
	bool

config SOC_FAMILY
	default "andes_v5" if SOC_FAMILY_ANDES_V5

source "soc/andestech/ae350/Kconfig.soc"
```
