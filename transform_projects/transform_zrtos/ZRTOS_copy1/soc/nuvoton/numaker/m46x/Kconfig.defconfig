## transform_projects/transform_zrtos/ZRTOS_demo1_output/boards/shields/ls0xx_generic/Kconfig.defconfig
```kconfig
# Copyright (c) 2020 Rohit Gujarathi
# SPDX-License-Identifier: Apache-2.0

if SHIELD_LS013B7DH03

if DISPLAY

if LVGL

config LV_Z_VDB_SIZE
	default 16

config LV_DPI_DEF
	default 150

config LV_Z_BITS_PER_PIXEL
	default 1


endif # LVGL

endif # DISPLAY

endif # SHIELD_LS013B7DH03
```

## transform_projects/transform_zrtos/ZRTOS_demo1_output/boards/shields/m5stack_cardputer/Kconfig.defconfig
```kconfig
# Copyright (c) 2025 Linaro Limited
# SPDX-License-Identifier: Apache-2.0

if SHIELD_M5STACK_CARDPUTER

config INPUT
	default y

if DISK_DRIVERS

config DISK_DRIVER_SDMMC
	default y

endif # DISK_DRIVERS

if DISPLAY

choice
	default ST7789V_RGB565
endchoice
endchoice

if LVGL

config LV_Z_BITS_PER_PIXEL
	default 16



endif # LVGL

endif # DISPLAY

endif # SHIELD_M5STACK_CARDPUTER
```

## transform_projects/transform_zrtos/ZRTOS_demo1_output/boards/shields/nxp_m2_wifi_bt/Kconfig.defconfig
```kconfig
# Copyright 2025 NXP
# SPDX-License-Identifier: Apache-2.0

if SHIELD_NXP_M2_1XK_WIFI_BT

if BT

choice
	default BT_NXP_IW416
endchoice
endchoice

endif # BT

if WIFI

config WIFI_NXP
	default y

config WIFI_NM_WPA_SUPPLICANT_11AX
	default n

config WIFI_NM_WPA_SUPPLICANT_11AC
	default n

choice
	default NXP_IW416
endchoice
endchoice

choice
	default NXP_IW416_MURATA_1XK_M2
endchoice
endchoice

if WIFI_NM_HOSTAPD_AP

config WIFI_NM_HOSTAPD_REGULATORY_REGION
	default "WW"

endif # WIFI_NM_HOSTAPD_AP

endif # WIFI

endif # SHIELD_NXP_M2_1XK_WIFI_BT

if SHIELD_NXP_M2_2EL_WIFI_BT

if BT


endif # BT

if WIFI

config WIFI_NXP
	default y


choice
	default NXP_IW612_MURATA_2EL_M2
endchoice
endchoice

if WIFI_NM_HOSTAPD_AP

config WIFI_NM_HOSTAPD_REGULATORY_REGION
	default "WW"

endif # WIFI_NM_HOSTAPD_AP

endif # WIFI

endif # SHIELD_NXP_M2_2EL_WIFI_BT

if SHIELD_NXP_M2_2LL_WIFI_BT

if BT


endif # BT

if WIFI

config WIFI_NXP
	default y


choice
	default NXP_IW610_MURATA_2LL_M2
endchoice
endchoice

if WIFI_NM_HOSTAPD_AP

config WIFI_NM_HOSTAPD_REGULATORY_REGION
	default "US"

endif # WIFI_NM_HOSTAPD_AP

endif # WIFI

endif # SHIELD_NXP_M2_2LL_WIFI_BT

if (BT_NXP_IW416) || (BT_NXP_NW612) || (BT_NXP_IW610) || (NXP_IW416) || (NXP_IW61X) || (NXP_IW610)

if BT

config SYSTEM_WORKQUEUE_STACK_SIZE
	default 2048

config BT_LONG_WQ_STACK_SIZE
	default 2560

config MAIN_STACK_SIZE
	default 2560

if SHELL

config SHELL_STACK_SIZE
	default 4096

endif # SHELL

endif # BT

if WIFI_NXP

if SHELL

config NXP_WIFI_SHELL
	default y

endif # SHELL

endif # WIFI_NXP

endif
```
