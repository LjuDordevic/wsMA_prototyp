## transform_projects/transform_zrtos/ZRTOS_demo2_output/soc/gd/gd32/Kconfig
```kconfig
# Copyright (c) 2021, ATL Electronics
# SPDX-License-Identifier: Apache-2.0

config SOC_FAMILY_GD_GD32
	select HAS_GD32_HAL
	select BUILD_OUTPUT_HEX
	select HAS_SEGGER_RTT if ZEPHYR_SEGGER_MODULE

if SOC_FAMILY_GD_GD32

source "soc/gd/gd32/gd32a50x/Kconfig"
source "soc/gd/gd32/gd32e10x/Kconfig"
source "soc/gd/gd32/gd32e50x/Kconfig"
source "soc/gd/gd32/gd32f3x0/Kconfig"
source "soc/gd/gd32/gd32f403/Kconfig"
source "soc/gd/gd32/gd32f4xx/Kconfig"
source "soc/gd/gd32/gd32l23x/Kconfig"
source "soc/gd/gd32/gd32vf103/Kconfig"

endif # SOC_FAMILY_GD_GD32
```

## transform_projects/transform_zrtos/ZRTOS_demo2_output/soc/gd/gd32/Kconfig.soc
```kconfig
# Copyright (c) 2021, ATL Electronics
# SPDX-License-Identifier: Apache-2.0

config SOC_FAMILY_GD_GD32
	bool

config SOC_FAMILY
	default "gd_gd32" if SOC_FAMILY_GD_GD32

source "soc/gd/gd32/gd32a50x/Kconfig.soc"
source "soc/gd/gd32/gd32e10x/Kconfig.soc"
source "soc/gd/gd32/gd32e50x/Kconfig.soc"
source "soc/gd/gd32/gd32f3x0/Kconfig.soc"
source "soc/gd/gd32/gd32f403/Kconfig.soc"
source "soc/gd/gd32/gd32f4xx/Kconfig.soc"
source "soc/gd/gd32/gd32l23x/Kconfig.soc"
source "soc/gd/gd32/gd32vf103/Kconfig.soc"
```

## transform_projects/transform_zrtos/ZRTOS_demo2_output/soc/intel/intel_socfpga/Kconfig
```kconfig
# Copyright (c) 2021-2024 Intel Corporation
# SPDX-License-Identifier: Apache-2.0

if SOC_FAMILY_INTEL_SOCFPGA

source "soc/intel/intel_socfpga/agilex/Kconfig"
source "soc/intel/intel_socfpga/agilex5/Kconfig"

endif # SOC_FAMILY_INTEL_SOCFPGA
```

## transform_projects/transform_zrtos/ZRTOS_demo2_output/soc/intel/intel_socfpga/Kconfig.soc
```kconfig
# Copyright (c) 2021-2024 Intel Corporation
# SPDX-License-Identifier: Apache-2.0

config SOC_FAMILY_INTEL_SOCFPGA
	bool

config SOC_FAMILY
	default "intel_socfpga" if SOC_FAMILY_INTEL_SOCFPGA

source "soc/intel/intel_socfpga/agilex/Kconfig.soc"
source "soc/intel/intel_socfpga/agilex5/Kconfig.soc"
```

## transform_projects/transform_zrtos/ZRTOS_demo2_output/soc/ite/ec/Kconfig.soc
```kconfig
# Copyright (c) 2020 ITE Corporation. All Rights Reserved.
# SPDX-License-Identifier: Apache-2.0

config SOC_FAMILY_ITE_EC
	bool

config SOC_FAMILY
	default "ite_ec" if SOC_FAMILY_ITE_EC

source "soc/ite/ec/it51xxx/Kconfig.soc"
source "soc/ite/ec/it8xxx2/Kconfig.soc"
```

## transform_projects/transform_zrtos/ZRTOS_demo2_output/soc/nuvoton/npcm/Kconfig
```kconfig
# Copyright (c) 2024 Nuvoton Technology Corporation.
#
# SPDX-License-Identifier: Apache-2.0

if SOC_FAMILY_NPCM

source "soc/nuvoton/npcm/npcm4/Kconfig"

endif # SOC_FAMILY_NPCM
```

## transform_projects/transform_zrtos/ZRTOS_demo2_output/soc/nuvoton/numaker/Kconfig.soc
```kconfig
# Copyright (c) 2023 Nuvoton Technology Corporation.
#
# SPDX-License-Identifier: Apache-2.0

config SOC_FAMILY_NUMAKER
	bool

config SOC_FAMILY
	default "numaker" if SOC_FAMILY_NUMAKER

source "soc/nuvoton/numaker/m2l31x/Kconfig.soc"
source "soc/nuvoton/numaker/m46x/Kconfig.soc"
source "soc/nuvoton/numaker/m55m1x/Kconfig.soc"
```

## transform_projects/transform_zrtos/ZRTOS_demo2_output/soc/nxp/kinetis/Kconfig.soc
```kconfig
# Copyright 2024 NXP
# SPDX-License-Identifier: Apache-2.0

config SOC_FAMILY_KINETIS
	bool

config SOC_FAMILY
	default "nxp_kinetis" if SOC_FAMILY_KINETIS

source "soc/nxp/kinetis/k2x/Kconfig.soc"
source "soc/nxp/kinetis/k32lx/Kconfig.soc"
source "soc/nxp/kinetis/k6x/Kconfig.soc"
source "soc/nxp/kinetis/k8x/Kconfig.soc"
source "soc/nxp/kinetis/ke1xf/Kconfig.soc"
source "soc/nxp/kinetis/ke1xz/Kconfig.soc"
source "soc/nxp/kinetis/kl2x/Kconfig.soc"
source "soc/nxp/kinetis/kv5x/Kconfig.soc"
source "soc/nxp/kinetis/kwx/Kconfig.soc"
```

## transform_projects/transform_zrtos/ZRTOS_demo2_output/soc/nxp/s32/Kconfig
```kconfig
# Copyright 2022-2024 NXP
# SPDX-License-Identifier: Apache-2.0

if SOC_FAMILY_NXP_S32

source "soc/nxp/s32/s32k1/Kconfig"
source "soc/nxp/s32/s32k3/Kconfig"
source "soc/nxp/s32/s32ze/Kconfig"

endif # SOC_FAMILY_NXP_S32
```

## transform_projects/transform_zrtos/ZRTOS_demo2_output/soc/raspberrypi/rpi_pico/Kconfig
```kconfig
# Raspberry Pi (RP) MCU line

# Copyright (c) 2021 Nordic Semiconductor ASA
# Copyright (c) 2021 Yonatan Schachter
# SPDX-License-Identifier: Apache-2.0

if SOC_FAMILY_RPI_PICO

source "soc/raspberrypi/rpi_pico/rp2040/Kconfig"
source "soc/raspberrypi/rpi_pico/rp2350/Kconfig"

endif # SOC_FAMILY_RPI_PICO
```

## transform_projects/transform_zrtos/ZRTOS_demo2_output/soc/renesas/ra/Kconfig
```kconfig
# Copyright (c) 2023 TOKITA Hiroshi <tokita.hiroshi@fujitsu.com>
# SPDX-License-Identifier: Apache-2.0

config SOC_FAMILY_RENESAS_RA
	select HAS_SEGGER_RTT if ZEPHYR_SEGGER_MODULE

if SOC_FAMILY_RENESAS_RA

config SERIES_SPECIFIC_SOC_INIT
	bool "Use series specific initialize"

source "soc/renesas/ra/ra2a1/Kconfig"
source "soc/renesas/ra/ra2l1/Kconfig"
source "soc/renesas/ra/ra4e1/Kconfig"
source "soc/renesas/ra/ra4e2/Kconfig"
source "soc/renesas/ra/ra4l1/Kconfig"
source "soc/renesas/ra/ra4m1/Kconfig"
source "soc/renesas/ra/ra4m2/Kconfig"
source "soc/renesas/ra/ra4m3/Kconfig"
source "soc/renesas/ra/ra4w1/Kconfig"
source "soc/renesas/ra/ra6e1/Kconfig"
source "soc/renesas/ra/ra6e2/Kconfig"
source "soc/renesas/ra/ra6m1/Kconfig"
source "soc/renesas/ra/ra6m2/Kconfig"
source "soc/renesas/ra/ra6m3/Kconfig"
source "soc/renesas/ra/ra6m4/Kconfig"
source "soc/renesas/ra/ra6m5/Kconfig"
source "soc/renesas/ra/ra8d1/Kconfig"
source "soc/renesas/ra/ra8m1/Kconfig"
source "soc/renesas/ra/ra8p1/Kconfig"
source "soc/renesas/ra/ra8t1/Kconfig"

endif # SOC_FAMILY_RENESAS_RA
```

## transform_projects/transform_zrtos/ZRTOS_demo2_output/soc/renesas/rcar/Kconfig
```kconfig
# Renesas R-Car SoC line
# Copyright (c) 2021 IoT.bzh
# SPDX-License-Identifier: Apache-2.0

if SOC_FAMILY_RENESAS_RCAR

source "soc/renesas/rcar/rcar_gen3/Kconfig"
source "soc/renesas/rcar/rcar_gen4/Kconfig"

endif # SOC_FAMILY_RENESAS_RCAR
```

## transform_projects/transform_zrtos/ZRTOS_demo2_output/soc/renesas/smartbond/Kconfig
```kconfig
# Copyright (c) 2022 Renesas Electronics Corporation
# SPDX-License-Identifier: Apache-2.0

if SOC_FAMILY_RENESAS_SMARTBOND

source "soc/renesas/smartbond/da1469x/Kconfig"

endif # SOC_FAMILY_RENESAS_SMARTBOND
```

## transform_projects/transform_zrtos/ZRTOS_demo2_output/soc/renesas/smartbond/Kconfig.soc
```kconfig
# Copyright (c) 2022 Renesas Electronics Corporation
# SPDX-License-Identifier: Apache-2.0

config SOC_FAMILY_RENESAS_SMARTBOND
	bool

config SOC_FAMILY
	default "renesas_smartbond" if SOC_FAMILY_RENESAS_SMARTBOND

source "soc/renesas/smartbond/da1469x/Kconfig.soc"
```

## transform_projects/transform_zrtos/ZRTOS_demo2_output/soc/rockchip/Kconfig
```kconfig
#
# Copyright 2021 Huawei France Technologies SASU
#
# SPDX-License-Identifier: Apache-2.0
#

if SOC_FAMILY_ROCKCHIP

source "soc/rockchip/rk3399/Kconfig"

endif # SOC_FAMILY_ROCKCHIP
```

## transform_projects/transform_zrtos/ZRTOS_demo2_output/soc/rockchip/Kconfig.soc
```kconfig
#
# Copyright 2021 Huawei France Technologies SASU
#
# SPDX-License-Identifier: Apache-2.0
#

config SOC_FAMILY_ROCKCHIP
	bool

config SOC_FAMILY
	default "rockchip" if SOC_FAMILY_ROCKCHIP

source "soc/rockchip/rk3399/Kconfig.soc"
source "soc/rockchip/rk35/Kconfig.soc"
```

## transform_projects/transform_zrtos/ZRTOS_demo2_output/soc/rockchip/rk35/Kconfig
```kconfig
#
# Copyright 2021 Huawei France Technologies SASU
#
# SPDX-License-Identifier: Apache-2.0
#

if SOC_FAMILY_ROCKCHIP

source "soc/rockchip/rk35/rk3568/Kconfig"
source "soc/rockchip/rk35/rk3588s/Kconfig"

endif # SOC_FAMILY_ROCKCHIP
```

## transform_projects/transform_zrtos/ZRTOS_demo2_output/soc/sensry/Kconfig
```kconfig
# SPDX-License-Identifier: Apache-2.0
# Copyright (c) 2024 sensry.io

if SOC_FAMILY_GANYMED

source "soc/sensry/ganymed/Kconfig"

endif # SOC_FAMILY_GANYMED
```

## transform_projects/transform_zrtos/ZRTOS_demo2_output/soc/sensry/ganymed/Kconfig
```kconfig
# SPDX-License-Identifier: Apache-2.0
# Copyright (c) 2024 sensry.io

config SOC_FAMILY_GANYMED
	select BUILD_OUTPUT_BIN

if SOC_SERIES_SY1XX

source "soc/sensry/ganymed/sy1xx/Kconfig"

endif # SOC_SERIES_SY1XX
```

## transform_projects/transform_zrtos/ZRTOS_demo2_output/soc/silabs/Kconfig.soc
```kconfig
# Copyright (c) 2017 Christian Taedcke
# SPDX-License-Identifier: Apache-2.0

config SOC_FAMILY
	default "silabs_s0" if SOC_FAMILY_SILABS_S0
	default "silabs_s1" if SOC_FAMILY_SILABS_S1
	default "silabs_s2" if SOC_FAMILY_SILABS_S2
	default "silabs_siwx91x" if SOC_FAMILY_SILABS_SIWX91X
	default "silabs_sim3" if SOC_FAMILY_SILABS_SIM3

source "soc/silabs/silabs_s0/Kconfig.soc"
source "soc/silabs/silabs_s1/Kconfig.soc"
source "soc/silabs/silabs_s2/Kconfig.soc"
source "soc/silabs/silabs_sim3/Kconfig.soc"
source "soc/silabs/silabs_siwx91x/Kconfig.soc"
```

## transform_projects/transform_zrtos/ZRTOS_demo2_output/soc/silabs/silabs_s1/Kconfig
```kconfig
# Copyright (c) 2024 GARDENA GmbH
# SPDX-License-Identifier: Apache-2.0

if SOC_FAMILY_SILABS_S1

config SOC_FAMILY_SILABS_S1
	select HAS_SEGGER_RTT if ZEPHYR_SEGGER_MODULE
	select BUILD_OUTPUT_HEX
	select SOC_EARLY_INIT_HOOK

source "soc/silabs/silabs_s1/efm32gg11b/Kconfig"
source "soc/silabs/silabs_s1/efm32gg12b/Kconfig"
source "soc/silabs/silabs_s1/efm32jg12b/Kconfig"
source "soc/silabs/silabs_s1/efm32pg12b/Kconfig"
source "soc/silabs/silabs_s1/efm32pg1b/Kconfig"
source "soc/silabs/silabs_s1/efr32bg13p/Kconfig"
source "soc/silabs/silabs_s1/efr32fg13p/Kconfig"
source "soc/silabs/silabs_s1/efr32fg1p/Kconfig"
source "soc/silabs/silabs_s1/efr32mg12p/Kconfig"

endif
```

## transform_projects/transform_zrtos/ZRTOS_demo2_output/soc/silabs/silabs_s2/Kconfig.soc
```kconfig
# Copyright (c) 2017 Christian Taedcke
# SPDX-License-Identifier: Apache-2.0

config SOC_FAMILY_SILABS_S2
	bool

source "soc/silabs/silabs_s2/efr32bg22/Kconfig.soc"
source "soc/silabs/silabs_s2/efr32bg27/Kconfig.soc"
source "soc/silabs/silabs_s2/efr32mg21/Kconfig.soc"
source "soc/silabs/silabs_s2/efr32zg23/Kconfig.soc"
source "soc/silabs/silabs_s2/xg24/Kconfig.soc"
source "soc/silabs/silabs_s2/xg29/Kconfig.soc"
```
