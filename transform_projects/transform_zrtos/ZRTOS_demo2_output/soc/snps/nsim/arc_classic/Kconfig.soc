## transform_projects/transform_zrtos/ZRTOS_demo2_output/soc/snps/nsim/arc_classic/Kconfig.soc
```kconfig
# Copyright (c) 2024 Synopsys, Inc.
# SPDX-License-Identifier: Apache-2.0

config SOC_FAMILY_NSIM_ARC_CLASSIC
	bool

config SOC_FAMILY
	default "nsim_arc_classic" if SOC_FAMILY_NSIM_ARC_CLASSIC

source "soc/snps/nsim/arc_classic/em/Kconfig.soc"
source "soc/snps/nsim/arc_classic/hs/Kconfig.soc"
source "soc/snps/nsim/arc_classic/sem/Kconfig.soc"
source "soc/snps/nsim/arc_classic/vpx5/Kconfig.soc"
```

## transform_projects/transform_zrtos/ZRTOS_demo2_output/soc/st/stm32/Kconfig.soc
```kconfig
# ST Microelectronics STM32 MCU line

# Copyright (c) 2016 Open-RnD Sp. z o.o.
# SPDX-License-Identifier: Apache-2.0

config SOC_FAMILY_STM32
	bool

config SOC_FAMILY
	default "stm32" if SOC_FAMILY_STM32

source "soc/st/stm32/stm32c0x/Kconfig.soc"
source "soc/st/stm32/stm32f0x/Kconfig.soc"
source "soc/st/stm32/stm32f1x/Kconfig.soc"
source "soc/st/stm32/stm32f2x/Kconfig.soc"
source "soc/st/stm32/stm32f3x/Kconfig.soc"
source "soc/st/stm32/stm32f4x/Kconfig.soc"
source "soc/st/stm32/stm32f7x/Kconfig.soc"
source "soc/st/stm32/stm32g0x/Kconfig.soc"
source "soc/st/stm32/stm32g4x/Kconfig.soc"
source "soc/st/stm32/stm32h5x/Kconfig.soc"
source "soc/st/stm32/stm32h7rsx/Kconfig.soc"
source "soc/st/stm32/stm32h7x/Kconfig.soc"
source "soc/st/stm32/stm32l0x/Kconfig.soc"
source "soc/st/stm32/stm32l1x/Kconfig.soc"
source "soc/st/stm32/stm32l4x/Kconfig.soc"
source "soc/st/stm32/stm32l5x/Kconfig.soc"
source "soc/st/stm32/stm32mp13x/Kconfig.soc"
source "soc/st/stm32/stm32mp1x/Kconfig.soc"
source "soc/st/stm32/stm32mp2x/Kconfig.soc"
source "soc/st/stm32/stm32n6x/Kconfig.soc"
source "soc/st/stm32/stm32u0x/Kconfig.soc"
source "soc/st/stm32/stm32u3x/Kconfig.soc"
source "soc/st/stm32/stm32u5x/Kconfig.soc"
source "soc/st/stm32/stm32wb0x/Kconfig.soc"
source "soc/st/stm32/stm32wbax/Kconfig.soc"
source "soc/st/stm32/stm32wbx/Kconfig.soc"
source "soc/st/stm32/stm32wlx/Kconfig.soc"
```

## transform_projects/transform_zrtos/ZRTOS_demo2_output/soc/ti/simplelink/Kconfig
```kconfig
# Texas Instruments SimpleLink Family
# SPDX-License-Identifier: Apache-2.0
# Copyright (c) 2017 Zephyr Contributors

if SOC_FAMILY_TI_SIMPLELINK

source "soc/ti/simplelink/cc13x2_cc26x2/Kconfig"
source "soc/ti/simplelink/cc13x2x7_cc26x2x7/Kconfig"
source "soc/ti/simplelink/cc23x0/Kconfig"
source "soc/ti/simplelink/cc32xx/Kconfig"
source "soc/ti/simplelink/msp432p4xx/Kconfig"

config HAS_TI_CCFG
	bool
	help
	  Selected when CCFG (Customer Configuration) registers
	  appear at the end of flash

config TI_SIMPLELINK_DYNAMIC_DPL_OBJECTS
	bool
	help
	  Turn on dynamic memory allocation for DPL objects. Reserves
	  extra memory for this.

endif # SOC_FAMILY_TI_SIMPLELINK
```

## transform_projects/transform_zrtos/ZRTOS_demo2_output/soc/ti/simplelink/Kconfig.soc
```kconfig
# Texas Instruments SimpleLink Family
# SPDX-License-Identifier: Apache-2.0
# Copyright (c) 2017 Zephyr Contributors

config SOC_FAMILY_TI_SIMPLELINK
	bool

config SOC_FAMILY
	default "ti_simplelink" if SOC_FAMILY_TI_SIMPLELINK

source "soc/ti/simplelink/cc13x2_cc26x2/Kconfig.soc"
source "soc/ti/simplelink/cc13x2x7_cc26x2x7/Kconfig.soc"
source "soc/ti/simplelink/cc23x0/Kconfig.soc"
source "soc/ti/simplelink/cc32xx/Kconfig.soc"
source "soc/ti/simplelink/msp432p4xx/Kconfig.soc"
```

## transform_projects/transform_zrtos/ZRTOS_demo2_output/soc/xlnx/zynq7000/Kconfig
```kconfig
#
# Copyright (c) 2021 Weidmueller Interface GmbH & Co. KG
# SPDX-License-Identifier: Apache-2.0
#

if SOC_FAMILY_XILINX_ZYNQ7000

source "soc/xlnx/zynq7000/xc7zxxx/Kconfig"
source "soc/xlnx/zynq7000/xc7zxxxs/Kconfig"

endif # SOC_FAMILY_XILINX_ZYNQ7000
```

## transform_projects/transform_zrtos/ZRTOS_demo2_output/subsys/bluetooth/services/Kconfig
```kconfig
# GATT Services

# Copyright (c) 2018 Nordic Semiconductor ASA
# SPDX-License-Identifier: Apache-2.0

menu "GATT Services"
	depends on BT_CONN

source "subsys/bluetooth/host/../services/Kconfig.dis"

source "subsys/bluetooth/host/../services/Kconfig.cts"

source "subsys/bluetooth/host/../services/Kconfig.hrs"

source "subsys/bluetooth/host/../services/Kconfig.tps"

source "subsys/bluetooth/host/../services/nus/Kconfig.nus"

source "subsys/bluetooth/host/../services/ias/Kconfig.ias"

source "subsys/bluetooth/host/../services/ots/Kconfig"

source "subsys/bluetooth/host/../services/bas/Kconfig.bas"

endmenu
```

## transform_projects/transform_zrtos/ZRTOS_demo2_output/subsys/logging/backends/Kconfig
```kconfig
# Copyright (c) 2021 Nordic Semiconductor ASA
# SPDX-License-Identifier: Apache-2.0

menu "Backends"

source "subsys/logging/backends/Kconfig.adsp"
source "subsys/logging/backends/Kconfig.adsp_mtrace"
source "subsys/logging/backends/Kconfig.ble"
source "subsys/logging/backends/Kconfig.efi_console"
source "subsys/logging/backends/Kconfig.fs"
source "subsys/logging/backends/Kconfig.mqtt"
source "subsys/logging/backends/Kconfig.native_posix"
source "subsys/logging/backends/Kconfig.net"
source "subsys/logging/backends/Kconfig.ws"
source "subsys/logging/backends/Kconfig.rtt"
source "subsys/logging/backends/Kconfig.spinel"
source "subsys/logging/backends/Kconfig.swo"
source "subsys/logging/backends/Kconfig.uart"
source "subsys/logging/backends/Kconfig.xtensa_sim"
source "subsys/logging/backends/Kconfig.multidomain"
source "subsys/logging/backends/Kconfig.semihost"

endmenu
```

## transform_projects/transform_zrtos/ZRTOS_log/output_analysis/exp_zep/Kconfig
```kconfig
choice SEGGER_RTT_MODE
config A
	bool "A"

endchoice

choice SEGGER_RTT_SECTION
	default B
	config B
		bool "B"
endchoice


choice SEGGER_RTT_INIT_MODE
config A
	bool "A"
endchoice

source "u1/Kconfig*"
```

## transform_projects/transform_zrtos/ZRTOS_log/output_analysis/exp_zep_output/Kconfig
```kconfig
choice
  default SEGGER_RTT_MODE_NO_BLOCK_SKIP
	prompt "Mode for pre-initialized terminal channel (buffer 0)"
  config A
	bool "A"

config SEGGER_RTT_MODE_NO_BLOCK_SKIP
	bool "Skip. Do not block, output nothing."

config SEGGER_RTT_MODE_NO_BLOCK_TRIM
	bool "Trim: Do not block, output as much as fits."

config SEGGER_RTT_MODE_BLOCK_IF_FIFO_FULL
	bool "Block: Wait until there is space in the buffer."

endchoice

choice
  default B
  default SEGGER_RTT_SECTION_CUSTOM if ZZZ && USE_SEGGER_RTT
  prompt "Choose RTT data linker section" if ZZZ && USE_SEGGER_RTT
  config B
    bool "B"
config SEGGER_RTT_SECTION_NONE
	bool "Place RTT data in the default linker section"

config SEGGER_RTT_SECTION_DTCM
	bool "Place RTT data in the DTCM linker section"

config SEGGER_RTT_SECTION_CCM
	bool "Place RTT data in the CCM linker section"

if CPU_CORTEX_M

config SEGGER_RTT_SECTION_CUSTOM
	bool "Place RTT data in custom linker section at RAM start"

config SEGGER_RTT_SECTION_CUSTOM_DTS_REGION
	bool "Place RTT data in custom linker section defined by a memory region in DTS"

endif
endchoice


choice
  default SEGGER_RTT_INIT_MODE_STRONG_CHECK if SEGGER_RTT_SECTION_CUSTOM && USE_SEGGER_RTT
  default SEGGER_RTT_INIT_MODE_STRONG_CHECK if USE_SEGGER_RTT
  prompt "RTT Initialization mode" if USE_SEGGER_RTT && USE_SEGGER_RTT
	help
		RTT initialization function can avoid re-init of Control Block
		if another program (e.g. bootloader) has already initialized it.
  config C
	bool "C"
config SEGGER_RTT_INIT_MODE_ALWAYS
	bool "RTT Initialization done without conditions"

config SEGGER_RTT_INIT_MODE_STRONG_CHECK
	bool "RTT Initialization done if full check on Control Block ID fails"

config SEGGER_RTT_INIT_MODE_WEAK_CHECK
	bool "RTT Initialization done if partial check on Control Block ID fails"

endchoice

source "u1/Kconfig.segg"
```

## transform_projects/transform_zrtos/old/ZRTOS_copy/boards/shields/adafruit_lis3dh/Kconfig.shield
```kconfig
# Copyright (c) 2025 Jonas Berg
# SPDX-License-Identifier: Apache-2.0

config SHIELD_ADAFRUIT_LIS3DH
 bool
 default $(shields_list_contains,adafruit_lis3dh)
```

## transform_projects/transform_zrtos/old/ZRTOS_copy/boards/shields/adafruit_pca9685/Kconfig.shield
```kconfig
# Copyright (c) 2022 Nick Ward <nix.ward@gmail.com>
# SPDX-License-Identifier: Apache-2.0

config SHIELD_ADAFRUIT_PCA9685
 bool
 default $(shields_list_contains,adafruit_pca9685)
```

## transform_projects/transform_zrtos/old/ZRTOS_copy/boards/shields/arduino_modulino_pixels/Kconfig.shield
```kconfig
# Copyright 2025 Google LLC
# SPDX-License-Identifier: Apache-2.0

config SHIELD_ARDUINO_MODULINO_PIXELS
 bool
 default $(shields_list_contains,arduino_modulino_pixels)
```

## transform_projects/transform_zrtos/old/ZRTOS_copy/boards/shields/canis_canpico/Kconfig.shield
```kconfig
# Copyright (c) 2025 Steve Boylan
# SPDX-License-Identifier: Apache-2.0

config SHIELD_CANIS_CANPICO
 bool
 default $(shields_list_contains,canis_canpico)
```

## transform_projects/transform_zrtos/old/ZRTOS_copy/boards/shields/esp_8266/Kconfig.shield
```kconfig
# Copyright (c) 2020 Gerson Fernando Budke <nandojve@gmail.com>
# SPDX-License-Identifier: Apache-2.0

config SHIELD_ESP_8266
 bool
 default $(shields_list_contains,esp_8266)

config SHIELD_ESP_8266_ARDUINO
 bool
 default $(shields_list_contains,esp_8266_arduino)

config SHIELD_ESP_8266_MIKROBUS
 bool
 default $(shields_list_contains,esp_8266_mikrobus)
```

## transform_projects/transform_zrtos/old/ZRTOS_copy/boards/shields/frdm_cr20a/Kconfig.defconfig
```kconfig
#
# Copyright (c) 2019, NXP
# Copyright (c) 2019 Linaro Limited
# SPDX-License-Identifier: Apache-2.0
#

if SHIELD_FRDM_CR20A

if IEEE802154

rsource "/home/ljd/wsMA_prototyp/ZRTOS_demo/zephyr/boards/shields/frdm_cr20a/boards/shields/frdm_cr20a/boards/frdm_k64f.defconfig"

endif # IEEE802154

endif # SHIELD_FRDM_CR20A
```

## transform_projects/transform_zrtos/old/ZRTOS_copy/boards/shields/mikroe_eth3_click/Kconfig.shield
```kconfig
# Copyright (c) 2024 Mario Paja
# SPDX-License-Identifier: Apache-2.0

config SHIELD_MIKROE_ETH3_CLICK
 bool
 default $(shields_list_contains,mikroe_eth3_click)
```

## transform_projects/transform_zrtos/old/ZRTOS_copy/boards/shields/mikroe_h_bridge_4_click/Kconfig.shield
```kconfig
# Copyright (c) 2025 Jilay Sandeep Pandya
# SPDX-License-Identifier: Apache-2.0

config SHIELD_MIKROE_H_BRIDGE_4_CLICK
 bool
 default $(shields_list_contains,mikroe_h_bridge_4_click)
```

## transform_projects/transform_zrtos/old/ZRTOS_copy/boards/shields/mikroe_stepper_18_click/Kconfig.shield
```kconfig
# Copyright (c) 2025 Navimatix GmbH
# SPDX-License-Identifier: Apache-2.0

config SHIELD_MIKROE_STEPPER_18_CLICK
 bool
 default $(shields_list_contains,mikroe_stepper_18_click)
```

## transform_projects/transform_zrtos/old/ZRTOS_copy/boards/shields/rk055hdmipi4m/Kconfig.shield
```kconfig
# Copyright 2023 NXP
# SPDX-License-Identifier: Apache-2.0

config SHIELD_RK055HDMIPI4M
 bool
 default $(shields_list_contains,rk055hdmipi4m)
```

## transform_projects/transform_zrtos/old/ZRTOS_copy/boards/shields/rtkmipilcdb00000be/Kconfig.shield
```kconfig
# Copyright (c) 2024 Renesas Electronics Corporation
# SPDX-License-Identifier: Apache-2.0

config SHIELD_RTKMIPILCDB00000BE
 bool
 default $(shields_list_contains,rtkmipilcdb00000be)
```

## transform_projects/transform_zrtos/old/ZRTOS_copy/boards/shields/seeed_xiao_expansion_board/Kconfig.shield
```kconfig
# Copyright (c) 2024 Charles Dias <charlesdias.cd@outlook.com>
# SPDX-License-Identifier: Apache-2.0

config SHIELD_SEEED_XIAO_EXPANSION_BOARD
 bool
 default $(shields_list_contains,seeed_xiao_expansion_board)
```

## transform_projects/transform_zrtos/old/ZRTOS_copy/boards/shields/st_stm32f4dis_cam/Kconfig.shield
```kconfig
# Copyright (c) 2025 STMicroelectronics

# SPDX-License-Identifier: Apache-2.0

config SHIELD_ST_STM32F4DIS_CAM
 bool
 default $(shields_list_contains,st_stm32f4dis_cam)
```

## transform_projects/transform_zrtos/old/ZRTOS_copy/boards/shields/v2c_daplink/Kconfig.shield
```kconfig
# Copyright (c) 2020 Henrik Brix Andersen <henrik@brixandersen.dk>
# SPDX-License-Identifier: Apache-2.0

config SHIELD_V2C_DAPLINK
 bool
 default $(shields_list_contains,v2c_daplink)

config SHIELD_V2C_DAPLINK_CFG
 bool
 default $(shields_list_contains,v2c_daplink_cfg)
```

## transform_projects/transform_zrtos/old/ZRTOS_copy/boards/shields/waveshare_ups/Kconfig.shield
```kconfig
# Copyright (c) 2023 Joseph Yates
# SPDX-License-Identifier: Apache-2.0

config SHIELD_WAVESHARE_PICO_UPS_B
 bool
 default $(shields_list_contains,waveshare_pico_ups_b)
```
