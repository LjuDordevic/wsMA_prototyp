## transform_projects/transform_zrtos/old/ZRTOS_copy1/soc/nxp/mcx/mcxe/Kconfig
```kconfig
# Copyright 2025 NXP
# SPDX-License-Identifier: Apache-2.0

if SOC_FAMILY_MCXE

source "soc/nxp/mcx/mcxe/mcxe24x/Kconfig"
source "soc/nxp/mcx/mcxe/mcxe31x/Kconfig"

endif # SOC_FAMILY_MCXE
```

## transform_projects/transform_zrtos/old/ZRTOS_copy1/soc/nxp/mcx/mcxe/Kconfig.soc
```kconfig
# Copyright 2025 NXP
# SPDX-License-Identifier: Apache-2.0

config SOC_FAMILY_MCXE
	bool

config SOC_FAMILY
	default "mcxe" if SOC_FAMILY_MCXE

source "soc/nxp/mcx/mcxe/mcxe24x/Kconfig.soc"
source "soc/nxp/mcx/mcxe/mcxe31x/Kconfig.soc"
```

## transform_projects/transform_zrtos/old/ZRTOS_copy1/soc/realtek/ec/rts5912/Kconfig.defconfig.series
```kconfig
# SPDX-License-Identifier: Apache-2.0
#
# Copyright (c) 2024 Realtek Semiconductor Corporation, SIBG-SD7
#

if SOC_SERIES_RTS5912

config NUM_IRQS
	default 240

endif # SOC_SERIES_RTS5912
```

## transform_projects/transform_zrtos/old/ZRTOS_copy1/soc/sifli/sf32/Kconfig
```kconfig
# Copyright (c) 2025 Core Devices LLC
# SPDX-License-Identifier: Apache-2.0

config SOC_FAMILY_SF32
	select HAS_SIFLI_HAL

if SOC_FAMILY_SF32

source "soc/sifli/sf32/sf32lb52x/Kconfig"

endif # SOC_FAMILY_SF32
```

## transform_projects/transform_zrtos/old/ZRTOS_copy1/soc/sifli/sf32/Kconfig.defconfig
```kconfig
# Copyright (c) 2025 Core Devices LLC
# SPDX-License-Identifier: Apache-2.0

if SOC_FAMILY_SF32

config BUILD_OUTPUT_HEX
	default y

source "soc/sifli/sf32/sf32lb52x/Kconfig.defconfig"

endif # SOC_FAMILY_SF32
```
