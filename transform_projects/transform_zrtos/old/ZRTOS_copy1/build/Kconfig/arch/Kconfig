## transform_projects/transform_zrtos/old/ZRTOS_copy1/lib/posix/Kconfig
```kconfig
# Copyright (c) 2024 Meta
# Copyright (c) 2025 Tenstorrent AI ULC
#
# SPDX-License-Identifier: Apache-2.0

menu "POSIX API Support"

# POSIX Subprofile Definitions

# Toolchain hooks for external implementations

# POSIX C Library Extensions
# This menu is for POSIX Option Groups that do not require OS support.
menu "POSIX C Library Extensions"
endmenu

# POSIX System Interfaces
menuconfig POSIX_SYSTEM_INTERFACES
	bool "POSIX System Interfaces"
	select NATIVE_LIBC_INCOMPATIBLE
	help
	  Select 'y' here to support POSIX System Interfaces within Zephyr.

	  Options in this menu are organized by POSIX subprofiling Option Group.

	  For more information, see
	  https://pubs.opengroup.org/onlinepubs/9699919799/xrat/V4_subprofiles.html

if POSIX_SYSTEM_INTERFACES

# POSIX Shell utilities
endif

endmenu

# Eventfd Support (not officially POSIX)
```

## transform_projects/transform_zrtos/old/ZRTOS_copy1/modules/hal_nxp/Kconfig
```kconfig
#
# Copyright (c) 2021 Linaro, Limited
# Copyright 2025 NXP
#
# SPDX-License-Identifier: Apache-2.0

config ZEPHYR_HAL_NXP_MODULE
	bool
```

## transform_projects/transform_zrtos/old/ZRTOS_copy1/soc/arm/mps2/Kconfig.defconfig
```kconfig
# Copyright (c) 2017 Linaro Limited
# SPDX-License-Identifier: Apache-2.0

if SOC_SERIES_MPS2

config SYS_CLOCK_HW_CYCLES_PER_SEC
	default 25000000

endif # SOC_SERIES_MPS2
```

## transform_projects/transform_zrtos/old/ZRTOS_copy1/soc/arm/mps3/Kconfig.defconfig
```kconfig
# Copyright (c) 2021 Linaro Limited
# SPDX-License-Identifier: Apache-2.0

if SOC_SERIES_MPS3

config SYS_CLOCK_HW_CYCLES_PER_SEC
	default 25000000

endif # SOC_SERIES_MPS3
```

## transform_projects/transform_zrtos/old/ZRTOS_copy1/soc/egis/Kconfig.defconfig
```kconfig
# Copyright (c) 2025 Egis Technology Inc.
# SPDX-License-Identifier: Apache-2.0

if SOC_EGIS_ET171

source "soc/egis/et171/Kconfig.defconfig"

endif # SOC_EGIS_ET171
```

## transform_projects/transform_zrtos/old/ZRTOS_copy1/soc/egis/Kconfig.soc
```kconfig
# Copyright (c) 2025 Egis Technology Inc.
# SPDX-License-Identifier: Apache-2.0

source "soc/egis/et171/Kconfig.soc"
```

## transform_projects/transform_zrtos/old/ZRTOS_copy1/soc/gd/gd32/Kconfig.defconfig
```kconfig
# Copyright (c) 2021, ATL Electronics
# SPDX-License-Identifier: Apache-2.0

if SOC_FAMILY_GD_GD32

config RESET
	default y

config CLOCK_CONTROL
	default y

endif # SOC_FAMILY_GD_GD32
```
