## transform_projects/transform_zrtos/old/ZRTOS_copy/boards/shields/zc143ac72mipi/Kconfig.shield
```kconfig
# Copyright 2025 NXP
# SPDX-License-Identifier: Apache-2.0

config SHIELD_ZC143AC72MIPI
 bool
 default $(shields_list_contains,zc143ac72mipi)
```

## transform_projects/transform_zrtos/old/ZRTOS_copy/build/Kconfig/boards/Kconfig.native_sim
```kconfig
# Load board Kconfig descriptions.
osource "/home/ljd/wsMA_prototyp/ZRTOS_demo/zephyr/build/Kconfig/boards/boards/native/native_sim/Kconfig.native_sim"
```

## transform_projects/transform_zrtos/old/ZRTOS_copy/build/Kconfig/soc/Kconfig
```kconfig
# Load Zephyr SoC Kconfig descriptions.
osource "/home/ljd/wsMA_prototyp/ZRTOS_demo/zephyr/build/Kconfig/soc/soc/xlnx/zynqmp/Kconfig"
#osource "/home/ljd/wsMA_prototyp/ZRTOS_demo/zephyr/soc/xlnx/zynq7000/Kconfig"
osource "/home/ljd/wsMA_prototyp/ZRTOS_demo/zephyr/build/Kconfig/soc/soc/xlnx/versalnet/Kconfig"
osource "/home/ljd/wsMA_prototyp/ZRTOS_demo/zephyr/build/Kconfig/soc/soc/xlnx/versal2/Kconfig"
osource "/home/ljd/wsMA_prototyp/ZRTOS_demo/zephyr/build/Kconfig/soc/soc/xen/Kconfig"
osource "/home/ljd/wsMA_prototyp/ZRTOS_demo/zephyr/build/Kconfig/soc/soc/wch/ch32v/Kconfig"
osource "/home/ljd/wsMA_prototyp/ZRTOS_demo/zephyr/build/Kconfig/soc/soc/ti/simplelink/Kconfig"
osource "/home/ljd/wsMA_prototyp/ZRTOS_demo/zephyr/build/Kconfig/soc/soc/ti/mspm0/Kconfig"
osource "/home/ljd/wsMA_prototyp/ZRTOS_demo/zephyr/build/Kconfig/soc/soc/ti/lm3s6965/Kconfig"
#osource "/home/ljd/wsMA_prototyp/ZRTOS_demo/zephyr/soc/ti/k3/Kconfig"
#osource "/home/ljd/wsMA_prototyp/ZRTOS_demo/zephyr/soc/telink/tlsr/Kconfig"
osource "/home/ljd/wsMA_prototyp/ZRTOS_demo/zephyr/build/Kconfig/soc/soc/starfive/jh71xx/Kconfig"
osource "/home/ljd/wsMA_prototyp/ZRTOS_demo/zephyr/build/Kconfig/soc/soc/st/stm32/Kconfig"
osource "/home/ljd/wsMA_prototyp/ZRTOS_demo/zephyr/build/Kconfig/soc/soc/snps/qemu_arc/Kconfig"
#osource "/home/ljd/wsMA_prototyp/ZRTOS_demo/zephyr/soc/snps/nsim/arc_v/Kconfig"
#osource "/home/ljd/wsMA_prototyp/ZRTOS_demo/zephyr/soc/snps/nsim/arc_classic/Kconfig"
osource "/home/ljd/wsMA_prototyp/ZRTOS_demo/zephyr/build/Kconfig/soc/soc/snps/hsdk4xd/Kconfig"
osource "/home/ljd/wsMA_prototyp/ZRTOS_demo/zephyr/build/Kconfig/soc/soc/snps/hsdk/Kconfig"
osource "/home/ljd/wsMA_prototyp/ZRTOS_demo/zephyr/build/Kconfig/soc/soc/snps/emsk/Kconfig"
osource "/home/ljd/wsMA_prototyp/ZRTOS_demo/zephyr/build/Kconfig/soc/soc/snps/emsdp/Kconfig"
osource "/home/ljd/wsMA_prototyp/ZRTOS_demo/zephyr/build/Kconfig/soc/soc/snps/arc_iot/Kconfig"
osource "/home/ljd/wsMA_prototyp/ZRTOS_demo/zephyr/build/Kconfig/soc/soc/silabs/Kconfig"
osource "/home/ljd/wsMA_prototyp/ZRTOS_demo/zephyr/build/Kconfig/soc/soc/sifli/sf32/Kconfig"
#osource "/home/ljd/wsMA_prototyp/ZRTOS_demo/zephyr/soc/sifive/sifive_freedom/Kconfig"
#osource "/home/ljd/wsMA_prototyp/ZRTOS_demo/zephyr/soc/sensry/Kconfig"
#osource "/home/ljd/wsMA_prototyp/ZRTOS_demo/zephyr/soc/rockchip/Kconfig"
osource "/home/ljd/wsMA_prototyp/ZRTOS_demo/zephyr/build/Kconfig/soc/soc/renode/riscv_virtual/Kconfig"
osource "/home/ljd/wsMA_prototyp/ZRTOS_demo/zephyr/build/Kconfig/soc/soc/renode/cortex_r8_virtual/Kconfig"
#osource "/home/ljd/wsMA_prototyp/ZRTOS_demo/zephyr/soc/renesas/smartbond/Kconfig"
osource "/home/ljd/wsMA_prototyp/ZRTOS_demo/zephyr/build/Kconfig/soc/soc/renesas/rz/Kconfig"
osource "/home/ljd/wsMA_prototyp/ZRTOS_demo/zephyr/build/Kconfig/soc/soc/renesas/rx/Kconfig"
#osource "/home/ljd/wsMA_prototyp/ZRTOS_demo/zephyr/soc/renesas/rcar/Kconfig"
osource "/home/ljd/wsMA_prototyp/ZRTOS_demo/zephyr/build/Kconfig/soc/soc/renesas/ra/Kconfig"
osource "/home/ljd/wsMA_prototyp/ZRTOS_demo/zephyr/build/Kconfig/soc/soc/realtek/ec/Kconfig"
osource "/home/ljd/wsMA_prototyp/ZRTOS_demo/zephyr/build/Kconfig/soc/soc/raspberrypi/rpi_pico/Kconfig"
osource "/home/ljd/wsMA_prototyp/ZRTOS_demo/zephyr/build/Kconfig/soc/soc/quicklogic/eos_s3/Kconfig"
osource "/home/ljd/wsMA_prototyp/ZRTOS_demo/zephyr/build/Kconfig/soc/soc/qemu/virt_riscv/Kconfig"
osource "/home/ljd/wsMA_prototyp/ZRTOS_demo/zephyr/build/Kconfig/soc/soc/qemu/malta/Kconfig"
osource "/home/ljd/wsMA_prototyp/ZRTOS_demo/zephyr/build/Kconfig/soc/soc/openisa/rv32m1/Kconfig"
#osource "/home/ljd/wsMA_prototyp/ZRTOS_demo/zephyr/soc/openhwgroup/cva6/Kconfig"
osource "/home/ljd/wsMA_prototyp/ZRTOS_demo/zephyr/build/Kconfig/soc/soc/oct/osd32mp15x/Kconfig"
#osource "/home/ljd/wsMA_prototyp/ZRTOS_demo/zephyr/soc/nxp/s32/Kconfig"
osource "/home/ljd/wsMA_prototyp/ZRTOS_demo/zephyr/build/Kconfig/soc/soc/nxp/rw/Kconfig"
#osource "/home/ljd/wsMA_prototyp/ZRTOS_demo/zephyr/soc/nxp/mcx/Kconfig"
osource "/home/ljd/wsMA_prototyp/ZRTOS_demo/zephyr/build/Kconfig/soc/soc/nxp/lpc/Kconfig"
#osource "/home/ljd/wsMA_prototyp/ZRTOS_demo/zephyr/soc/nxp/layerscape/Kconfig"
osource "/home/ljd/wsMA_prototyp/ZRTOS_demo/zephyr/build/Kconfig/soc/soc/nxp/kinetis/Kconfig"
osource "/home/ljd/wsMA_prototyp/ZRTOS_demo/zephyr/build/Kconfig/soc/soc/nxp/imxrt/Kconfig"
osource "/home/ljd/wsMA_prototyp/ZRTOS_demo/zephyr/build/Kconfig/soc/soc/nxp/imx/Kconfig"
osource "/home/ljd/wsMA_prototyp/ZRTOS_demo/zephyr/build/Kconfig/soc/soc/nuvoton/numicro/Kconfig"
osource "/home/ljd/wsMA_prototyp/ZRTOS_demo/zephyr/build/Kconfig/soc/soc/nuvoton/numaker/Kconfig"
osource "/home/ljd/wsMA_prototyp/ZRTOS_demo/zephyr/build/Kconfig/soc/soc/nuvoton/npcx/Kconfig"
#osource "/home/ljd/wsMA_prototyp/ZRTOS_demo/zephyr/soc/nuvoton/npcm/Kconfig"
osource "/home/ljd/wsMA_prototyp/ZRTOS_demo/zephyr/build/Kconfig/soc/soc/nordic/Kconfig"
osource "/home/ljd/wsMA_prototyp/ZRTOS_demo/zephyr/build/Kconfig/soc/soc/neorv32/Kconfig"
osource "/home/ljd/wsMA_prototyp/ZRTOS_demo/zephyr/build/Kconfig/soc/soc/native/inf_clock/Kconfig"
osource "/home/ljd/wsMA_prototyp/ZRTOS_demo/zephyr/build/Kconfig/soc/soc/microchip/sam/Kconfig"
osource "/home/ljd/wsMA_prototyp/ZRTOS_demo/zephyr/build/Kconfig/soc/soc/microchip/sam/sama7/Kconfig"
osource "/home/ljd/wsMA_prototyp/ZRTOS_demo/zephyr/build/Kconfig/soc/soc/microchip/sam/sam_d5x_e5x/Kconfig"
osource "/home/ljd/wsMA_prototyp/ZRTOS_demo/zephyr/build/Kconfig/soc/soc/microchip/pic32c/pic32cz_ca/Kconfig"
osource "/home/ljd/wsMA_prototyp/ZRTOS_demo/zephyr/build/Kconfig/soc/soc/microchip/pic32c/pic32cx_sg/Kconfig"
osource "/home/ljd/wsMA_prototyp/ZRTOS_demo/zephyr/build/Kconfig/soc/soc/microchip/pic32c/pic32cm_jh/Kconfig"
#osource "/home/ljd/wsMA_prototyp/ZRTOS_demo/zephyr/soc/microchip/miv/Kconfig"
osource "/home/ljd/wsMA_prototyp/ZRTOS_demo/zephyr/build/Kconfig/soc/soc/microchip/mec/Kconfig"
osource "/home/ljd/wsMA_prototyp/ZRTOS_demo/zephyr/build/Kconfig/soc/soc/mediatek/mt8xxx/Kconfig"
osource "/home/ljd/wsMA_prototyp/ZRTOS_demo/zephyr/build/Kconfig/soc/soc/lowrisc/opentitan/Kconfig"
osource "/home/ljd/wsMA_prototyp/ZRTOS_demo/zephyr/build/Kconfig/soc/soc/litex/litex_vexriscv/Kconfig"
#osource "/home/ljd/wsMA_prototyp/ZRTOS_demo/zephyr/soc/ite/ec/Kconfig"
osource "/home/ljd/wsMA_prototyp/ZRTOS_demo/zephyr/build/Kconfig/soc/soc/intel/raptor_lake/Kconfig"
osource "/home/ljd/wsMA_prototyp/ZRTOS_demo/zephyr/build/Kconfig/soc/soc/intel/panther_lake/Kconfig"
osource "/home/ljd/wsMA_prototyp/ZRTOS_demo/zephyr/build/Kconfig/soc/soc/intel/lakemont/Kconfig"
#osource "/home/ljd/wsMA_prototyp/ZRTOS_demo/zephyr/soc/intel/intel_socfpga_std/Kconfig"
#osource "/home/ljd/wsMA_prototyp/ZRTOS_demo/zephyr/soc/intel/intel_socfpga/Kconfig"
#osource "/home/ljd/wsMA_prototyp/ZRTOS_demo/zephyr/soc/intel/intel_niosv/Kconfig"
osource "/home/ljd/wsMA_prototyp/ZRTOS_demo/zephyr/build/Kconfig/soc/soc/intel/intel_ish/Kconfig"
osource "/home/ljd/wsMA_prototyp/ZRTOS_demo/zephyr/build/Kconfig/soc/soc/intel/intel_adsp/Kconfig"
osource "/home/ljd/wsMA_prototyp/ZRTOS_demo/zephyr/build/Kconfig/soc/soc/intel/elkhart_lake/Kconfig"
osource "/home/ljd/wsMA_prototyp/ZRTOS_demo/zephyr/build/Kconfig/soc/soc/intel/atom/Kconfig"
osource "/home/ljd/wsMA_prototyp/ZRTOS_demo/zephyr/build/Kconfig/soc/soc/intel/apollo_lake/Kconfig"
osource "/home/ljd/wsMA_prototyp/ZRTOS_demo/zephyr/build/Kconfig/soc/soc/intel/alder_lake/Kconfig"
#osource "/home/ljd/wsMA_prototyp/ZRTOS_demo/zephyr/soc/infineon/edge/Kconfig"
osource "/home/ljd/wsMA_prototyp/ZRTOS_demo/zephyr/build/Kconfig/soc/soc/infineon/cat3/Kconfig"
#osource "/home/ljd/wsMA_prototyp/ZRTOS_demo/zephyr/soc/infineon/cat1c/Kconfig"
#osource "/home/ljd/wsMA_prototyp/ZRTOS_demo/zephyr/soc/infineon/cat1b/Kconfig"
osource "/home/ljd/wsMA_prototyp/ZRTOS_demo/zephyr/build/Kconfig/soc/soc/infineon/cat1a/Kconfig"
osource "/home/ljd/wsMA_prototyp/ZRTOS_demo/zephyr/build/Kconfig/soc/soc/gd/gd32/Kconfig"
osource "/home/ljd/wsMA_prototyp/ZRTOS_demo/zephyr/build/Kconfig/soc/soc/gaisler/leon3/Kconfig"
osource "/home/ljd/wsMA_prototyp/ZRTOS_demo/zephyr/build/Kconfig/soc/soc/gaisler/gr716a/Kconfig"
osource "/home/ljd/wsMA_prototyp/ZRTOS_demo/zephyr/build/Kconfig/soc/soc/espressif/Kconfig"
osource "/home/ljd/wsMA_prototyp/ZRTOS_demo/zephyr/build/Kconfig/soc/soc/ene/kb1200/Kconfig"
osource "/home/ljd/wsMA_prototyp/ZRTOS_demo/zephyr/build/Kconfig/soc/soc/ene/kb106x/Kconfig"
#osource "/home/ljd/wsMA_prototyp/ZRTOS_demo/zephyr/soc/egis/Kconfig"
osource "/home/ljd/wsMA_prototyp/ZRTOS_demo/zephyr/build/Kconfig/soc/soc/efinix/sapphire/Kconfig"
osource "/home/ljd/wsMA_prototyp/ZRTOS_demo/zephyr/build/Kconfig/soc/soc/cdns/xtensa_sample_controller/Kconfig"
osource "/home/ljd/wsMA_prototyp/ZRTOS_demo/zephyr/build/Kconfig/soc/soc/cdns/sample_controller32/Kconfig"
osource "/home/ljd/wsMA_prototyp/ZRTOS_demo/zephyr/build/Kconfig/soc/soc/cdns/dc233c/Kconfig"
#osource "/home/ljd/wsMA_prototyp/ZRTOS_demo/zephyr/soc/brcm/bcmvk/Kconfig"
osource "/home/ljd/wsMA_prototyp/ZRTOS_demo/zephyr/build/Kconfig/soc/soc/brcm/bcm2712/Kconfig"
osource "/home/ljd/wsMA_prototyp/ZRTOS_demo/zephyr/build/Kconfig/soc/soc/brcm/bcm2711/Kconfig"
#osource "/home/ljd/wsMA_prototyp/ZRTOS_demo/zephyr/soc/bflb/Kconfig"
osource "/home/ljd/wsMA_prototyp/ZRTOS_demo/zephyr/build/Kconfig/soc/soc/atmel/sam0/Kconfig"
osource "/home/ljd/wsMA_prototyp/ZRTOS_demo/zephyr/build/Kconfig/soc/soc/atmel/sam/Kconfig"
osource "/home/ljd/wsMA_prototyp/ZRTOS_demo/zephyr/build/Kconfig/soc/soc/aspeed/Kconfig"
#osource "/home/ljd/wsMA_prototyp/ZRTOS_demo/zephyr/soc/arm/Kconfig"
osource "/home/ljd/wsMA_prototyp/ZRTOS_demo/zephyr/build/Kconfig/soc/soc/arm/beetle/Kconfig"
osource "/home/ljd/wsMA_prototyp/ZRTOS_demo/zephyr/build/Kconfig/soc/soc/antmicro/myra/Kconfig"
#osource "/home/ljd/wsMA_prototyp/ZRTOS_demo/zephyr/soc/andestech/Kconfig"
osource "/home/ljd/wsMA_prototyp/ZRTOS_demo/zephyr/build/Kconfig/soc/soc/amd/acp_6_0/Kconfig"
#osource "/home/ljd/wsMA_prototyp/ZRTOS_demo/zephyr/soc/ambiq/Kconfig"
#osource "/home/ljd/wsMA_prototyp/ZRTOS_demo/zephyr/soc/aesc/Kconfig"
osource "/home/ljd/wsMA_prototyp/ZRTOS_demo/zephyr/build/Kconfig/soc/soc/adi/max32/Kconfig"
```

## transform_projects/transform_zrtos/old/ZRTOS_copy/drivers/i2s/Kconfig
```kconfig
# I2S (Inter-IC Sound) driver configuration options

# Copyright (c) 2017 Piotr Mienkowski
# SPDX-License-Identifier: Apache-2.0

#
# I2S Drivers
#
menuconfig I2S
	bool "Inter-IC Sound (I2S) bus drivers"
	help
	  Enable support for the I2S (Inter-IC Sound) hardware bus.

if I2S

config I2S_INIT_PRIORITY
	int "Init priority"
	default KERNEL_INIT_PRIORITY_DEVICE
	help
	  Device driver initialization priority.

module = I2S
module-str = i2s
source "subsys/logging/Kconfig.template.log_config"

comment "Device Drivers"

source "drivers/i2s/Kconfig.ambiq"
source "drivers/i2s/Kconfig.esp32"
source "drivers/i2s/Kconfig.litex"
source "drivers/i2s/Kconfig.mcux"
source "drivers/i2s/Kconfig.mcux_flexcomm"
source "drivers/i2s/Kconfig.nrfx"
source "drivers/i2s/Kconfig.renesas_ra"
source "drivers/i2s/Kconfig.sam_ssc"
source "drivers/i2s/Kconfig.siwx91x"
source "drivers/i2s/Kconfig.stm32"
source "drivers/i2s/Kconfig.test"

endif # I2S
```

## transform_projects/transform_zrtos/old/ZRTOS_copy/drivers/opamp/Kconfig
```kconfig
# Copyright 2025 NXP
# SPDX-License-Identifier: Apache-2.0

menuconfig OPAMP
	bool "Operational Amplifier (opamp) drivers"
	help
	  Enable opamp driver configuration.

if OPAMP

module = OPAMP
module-str = opamp
source "subsys/logging/Kconfig.template.log_config"

config OPAMP_INIT_PRIORITY
	int "OPAMP init priority"
	default KERNEL_INIT_PRIORITY_DEVICE
	help
	  Opamp device driver initialization priority.

# zephyr-keep-sorted-start
rsource "/home/ljd/wsMA_prototyp/ZRTOS_demo/zephyr/drivers/opamp/drivers/opamp/Kconfig.mcux_opamp"
rsource "/home/ljd/wsMA_prototyp/ZRTOS_demo/zephyr/drivers/opamp/drivers/opamp/Kconfig.mcux_opamp_fast"
# zephyr-keep-sorted-stop

endif # OPAMP
```
