## transform_projects/transform_zrtos/old/ZRTOS_copy/lib/posix/options/Kconfig
```kconfig
# Copyright (c) 2018 Intel Corporation
# Copyright (c) 2023 Meta
# Copyright (c) 2024 Tenstorrent AI ULC
#
# SPDX-License-Identifier: Apache-2.0

# zephyr-keep-sorted-start
rsource "/home/ljd/wsMA_prototyp/ZRTOS_demo/zephyr/lib/posix/options/lib/posix/options/Kconfig.aio"
rsource "/home/ljd/wsMA_prototyp/ZRTOS_demo/zephyr/lib/posix/options/lib/posix/options/Kconfig.barrier"
rsource "/home/ljd/wsMA_prototyp/ZRTOS_demo/zephyr/lib/posix/options/lib/posix/options/Kconfig.device_io"
rsource "/home/ljd/wsMA_prototyp/ZRTOS_demo/zephyr/lib/posix/options/lib/posix/options/Kconfig.fd_mgmt"
rsource "/home/ljd/wsMA_prototyp/ZRTOS_demo/zephyr/lib/posix/options/lib/posix/options/Kconfig.file_system_r"
rsource "/home/ljd/wsMA_prototyp/ZRTOS_demo/zephyr/lib/posix/options/lib/posix/options/Kconfig.fs"
rsource "/home/ljd/wsMA_prototyp/ZRTOS_demo/zephyr/lib/posix/options/lib/posix/options/Kconfig.mem"
rsource "/home/ljd/wsMA_prototyp/ZRTOS_demo/zephyr/lib/posix/options/lib/posix/options/Kconfig.mqueue"
rsource "/home/ljd/wsMA_prototyp/ZRTOS_demo/zephyr/lib/posix/options/lib/posix/options/Kconfig.net"
rsource "/home/ljd/wsMA_prototyp/ZRTOS_demo/zephyr/lib/posix/options/lib/posix/options/Kconfig.proc1"
rsource "/home/ljd/wsMA_prototyp/ZRTOS_demo/zephyr/lib/posix/options/lib/posix/options/Kconfig.procN"
rsource "/home/ljd/wsMA_prototyp/ZRTOS_demo/zephyr/lib/posix/options/lib/posix/options/Kconfig.pthread"
rsource "/home/ljd/wsMA_prototyp/ZRTOS_demo/zephyr/lib/posix/options/lib/posix/options/Kconfig.rwlock"
rsource "/home/ljd/wsMA_prototyp/ZRTOS_demo/zephyr/lib/posix/options/lib/posix/options/Kconfig.sched"
rsource "/home/ljd/wsMA_prototyp/ZRTOS_demo/zephyr/lib/posix/options/lib/posix/options/Kconfig.semaphore"
rsource "/home/ljd/wsMA_prototyp/ZRTOS_demo/zephyr/lib/posix/options/lib/posix/options/Kconfig.signal"
rsource "/home/ljd/wsMA_prototyp/ZRTOS_demo/zephyr/lib/posix/options/lib/posix/options/Kconfig.spinlock"
rsource "/home/ljd/wsMA_prototyp/ZRTOS_demo/zephyr/lib/posix/options/lib/posix/options/Kconfig.sync_io"
rsource "/home/ljd/wsMA_prototyp/ZRTOS_demo/zephyr/lib/posix/options/lib/posix/options/Kconfig.timer"
# zephyr-keep-sorted-stop

menu "X/Open system interfaces"

# zephyr-keep-sorted-start
rsource "/home/ljd/wsMA_prototyp/ZRTOS_demo/zephyr/lib/posix/options/lib/posix/options/Kconfig.xsi_realtime"
rsource "/home/ljd/wsMA_prototyp/ZRTOS_demo/zephyr/lib/posix/options/lib/posix/options/Kconfig.xsi_single_process"
rsource "/home/ljd/wsMA_prototyp/ZRTOS_demo/zephyr/lib/posix/options/lib/posix/options/Kconfig.xsi_streams"
rsource "/home/ljd/wsMA_prototyp/ZRTOS_demo/zephyr/lib/posix/options/lib/posix/options/Kconfig.xsi_system_logging"
rsource "/home/ljd/wsMA_prototyp/ZRTOS_demo/zephyr/lib/posix/options/lib/posix/options/Kconfig.xsi_threads_ext"
# zephyr-keep-sorted-stop

endmenu # "X/Open system interfaces"
```

## transform_projects/transform_zrtos/old/ZRTOS_copy/modules/hal_nxp/Kconfig
```kconfig
#
# Copyright (c) 2021 Linaro, Limited
# Copyright 2025 NXP
#
# SPDX-License-Identifier: Apache-2.0

config ZEPHYR_HAL_NXP_MODULE
	bool

rsource "/home/ljd/wsMA_prototyp/ZRTOS_demo/zephyr/modules/hal_nxp/modules/hal_nxp/imx/Kconfig.imx"
rsource "/home/ljd/wsMA_prototyp/ZRTOS_demo/zephyr/modules/hal_nxp/modules/hal_nxp/s32/Kconfig.nxp_s32"
rsource "/home/ljd/wsMA_prototyp/ZRTOS_demo/zephyr/modules/hal_nxp/modules/hal_nxp/mcux/Kconfig.mcux"
```

## transform_projects/transform_zrtos/old/ZRTOS_copy/soc/adi/max32/Kconfig.defconfig
```kconfig
# Analog Devices MAX32xxx MCU family

# Copyright (c) 2023-2024 Analog Devices, Inc.
# SPDX-License-Identifier: Apache-2.0

if SOC_FAMILY_MAX32

rsource "/home/ljd/wsMA_prototyp/ZRTOS_demo/zephyr/soc/adi/max32/soc/adi/max32/Kconfig.defconfig.max32650"
rsource "/home/ljd/wsMA_prototyp/ZRTOS_demo/zephyr/soc/adi/max32/soc/adi/max32/Kconfig.defconfig.max32655"
rsource "/home/ljd/wsMA_prototyp/ZRTOS_demo/zephyr/soc/adi/max32/soc/adi/max32/Kconfig.defconfig.max32657"
rsource "/home/ljd/wsMA_prototyp/ZRTOS_demo/zephyr/soc/adi/max32/soc/adi/max32/Kconfig.defconfig.max32660"
rsource "/home/ljd/wsMA_prototyp/ZRTOS_demo/zephyr/soc/adi/max32/soc/adi/max32/Kconfig.defconfig.max32662"
rsource "/home/ljd/wsMA_prototyp/ZRTOS_demo/zephyr/soc/adi/max32/soc/adi/max32/Kconfig.defconfig.max32666"
rsource "/home/ljd/wsMA_prototyp/ZRTOS_demo/zephyr/soc/adi/max32/soc/adi/max32/Kconfig.defconfig.max32670"
rsource "/home/ljd/wsMA_prototyp/ZRTOS_demo/zephyr/soc/adi/max32/soc/adi/max32/Kconfig.defconfig.max32672"
rsource "/home/ljd/wsMA_prototyp/ZRTOS_demo/zephyr/soc/adi/max32/soc/adi/max32/Kconfig.defconfig.max32675"
rsource "/home/ljd/wsMA_prototyp/ZRTOS_demo/zephyr/soc/adi/max32/soc/adi/max32/Kconfig.defconfig.max32680"
rsource "/home/ljd/wsMA_prototyp/ZRTOS_demo/zephyr/soc/adi/max32/soc/adi/max32/Kconfig.defconfig.max32690"
rsource "/home/ljd/wsMA_prototyp/ZRTOS_demo/zephyr/soc/adi/max32/soc/adi/max32/Kconfig.defconfig.max78000"
rsource "/home/ljd/wsMA_prototyp/ZRTOS_demo/zephyr/soc/adi/max32/soc/adi/max32/Kconfig.defconfig.max78002"

choice PM_PREWAKEUP_CONV_MODE
	default PM_PREWAKEUP_CONV_MODE_CEIL

endchoice # PM_PREWAKEUP_CONV_MODE

endif # SOC_FAMILY_MAX32
```

## transform_projects/transform_zrtos/old/ZRTOS_copy/soc/arm/Kconfig
```kconfig
# Copyright (c) 2024 Nordic Semiconductor ASA
# SPDX-License-Identifier: Apache-2.0

if SOC_FAMILY_ARM || SOC_FAMILY_ARM64

rsource "/home/ljd/wsMA_prototyp/ZRTOS_demo/zephyr/soc/arm/soc/arm/beetle/Kconfig"
rsource "/home/ljd/wsMA_prototyp/ZRTOS_demo/zephyr/soc/arm/soc/arm/designstart/Kconfig"
rsource "/home/ljd/wsMA_prototyp/ZRTOS_demo/zephyr/soc/arm/soc/arm/fvp_aem/Kconfig"
rsource "/home/ljd/wsMA_prototyp/ZRTOS_demo/zephyr/soc/arm/soc/arm/fvp_aemv8r/Kconfig"
rsource "/home/ljd/wsMA_prototyp/ZRTOS_demo/zephyr/soc/arm/soc/arm/mps2/Kconfig"
rsource "/home/ljd/wsMA_prototyp/ZRTOS_demo/zephyr/soc/arm/soc/arm/mps3/Kconfig"
rsource "/home/ljd/wsMA_prototyp/ZRTOS_demo/zephyr/soc/arm/soc/arm/mps4/Kconfig"
rsource "/home/ljd/wsMA_prototyp/ZRTOS_demo/zephyr/soc/arm/soc/arm/musca/Kconfig"
rsource "/home/ljd/wsMA_prototyp/ZRTOS_demo/zephyr/soc/arm/soc/arm/qemu_cortex_a53/Kconfig"
rsource "/home/ljd/wsMA_prototyp/ZRTOS_demo/zephyr/soc/arm/soc/arm/qemu_virt_arm64/Kconfig"

endif # SOC_FAMILY_ARM || SOC_FAMILY_ARM64
```

## transform_projects/transform_zrtos/old/ZRTOS_copy/soc/arm/mps4/Kconfig.defconfig
```kconfig
# Copyright 2025 Arm Limited and/or its affiliates <open-source-office@arm.com>
# SPDX-License-Identifier: Apache-2.0

if SOC_SERIES_MPS4

config SYS_CLOCK_HW_CYCLES_PER_SEC
	default $(dt_node_int_prop_int,$(dt_nodelabel_path,sysclk),clock-frequency)

rsource "/home/ljd/wsMA_prototyp/ZRTOS_demo/zephyr/soc/arm/mps4/soc/arm/mps4/Kconfig.defconfig.mps4_corstone315"
rsource "/home/ljd/wsMA_prototyp/ZRTOS_demo/zephyr/soc/arm/mps4/soc/arm/mps4/Kconfig.defconfig.mps4_corstone320"

endif # SOC_SERIES_MPS4
```

## transform_projects/transform_zrtos/old/ZRTOS_copy/soc/atmel/sam0/Kconfig.defconfig
```kconfig
# Atmel SAM0 MCU family default configuration options

# Copyright (c) 2017 Google LLC.
# Copyright (c) 2024 Gerson Fernando Budke <nandojve@gmail.com>
# SPDX-License-Identifier: Apache-2.0

if SOC_FAMILY_ATMEL_SAM0

rsource "/home/ljd/wsMA_prototyp/ZRTOS_demo/zephyr/soc/atmel/sam0/soc/atmel/sam0/samc20/Kconfig.defconfig"
rsource "/home/ljd/wsMA_prototyp/ZRTOS_demo/zephyr/soc/atmel/sam0/soc/atmel/sam0/samc21/Kconfig.defconfig"
rsource "/home/ljd/wsMA_prototyp/ZRTOS_demo/zephyr/soc/atmel/sam0/soc/atmel/sam0/samd20/Kconfig.defconfig"
rsource "/home/ljd/wsMA_prototyp/ZRTOS_demo/zephyr/soc/atmel/sam0/soc/atmel/sam0/samd21/Kconfig.defconfig"
rsource "/home/ljd/wsMA_prototyp/ZRTOS_demo/zephyr/soc/atmel/sam0/soc/atmel/sam0/samd51/Kconfig.defconfig"
rsource "/home/ljd/wsMA_prototyp/ZRTOS_demo/zephyr/soc/atmel/sam0/soc/atmel/sam0/same51/Kconfig.defconfig"
rsource "/home/ljd/wsMA_prototyp/ZRTOS_demo/zephyr/soc/atmel/sam0/soc/atmel/sam0/same53/Kconfig.defconfig"
rsource "/home/ljd/wsMA_prototyp/ZRTOS_demo/zephyr/soc/atmel/sam0/soc/atmel/sam0/same54/Kconfig.defconfig"
rsource "/home/ljd/wsMA_prototyp/ZRTOS_demo/zephyr/soc/atmel/sam0/soc/atmel/sam0/saml21/Kconfig.defconfig"
rsource "/home/ljd/wsMA_prototyp/ZRTOS_demo/zephyr/soc/atmel/sam0/soc/atmel/sam0/samr21/Kconfig.defconfig"
rsource "/home/ljd/wsMA_prototyp/ZRTOS_demo/zephyr/soc/atmel/sam0/soc/atmel/sam0/samr34/Kconfig.defconfig"
rsource "/home/ljd/wsMA_prototyp/ZRTOS_demo/zephyr/soc/atmel/sam0/soc/atmel/sam0/samr35/Kconfig.defconfig"

config GPIO
	default y

config HWINFO_SAM0
	default HWINFO

config SYS_CLOCK_HW_CYCLES_PER_SEC
	default $(dt_node_int_prop_int,/cpus/cpu@0,clock-frequency)

if USB_DEVICE_DRIVER

config HEAP_MEM_POOL_ADD_SIZE_SOC
 int
 default 1024

endif # USB_DEVICE_DRIVER

endif # SOC_FAMILY_ATMEL_SAM0
```

## transform_projects/transform_zrtos/old/ZRTOS_copy/soc/common/Kconfig
```kconfig
# Copyright (c) 2024 Nordic Semiconductor ASA
# SPDX-License-Identifier: Apache-2.0

if RISCV_PRIVILEGED

rsource "/home/ljd/wsMA_prototyp/ZRTOS_demo/zephyr/soc/common/soc/common/riscv-privileged/Kconfig"

endif # RISCV_PRIVILEGED
```

## transform_projects/transform_zrtos/old/ZRTOS_copy/soc/ene/kb106x/Kconfig.defconfig
```kconfig
# Copyright (c) 2025 ENE Technology Inc.
# SPDX-License-Identifier: Apache-2.0

if SOC_FAMILY_KB106X

rsource "/home/ljd/wsMA_prototyp/ZRTOS_demo/zephyr/soc/ene/kb106x/soc/ene/kb106x/kb106x/Kconfig.defconfig"

endif # SOC_FAMILY_KB106X
```

## transform_projects/transform_zrtos/old/ZRTOS_copy/soc/ene/kb106x/Kconfig.soc
```kconfig
# Copyright (c) 2025 ENE Technology Inc.
# SPDX-License-Identifier: Apache-2.0

config SOC_FAMILY_KB106X
	bool

config SOC_FAMILY
	default "kb106x" if SOC_FAMILY_KB106X

rsource "/home/ljd/wsMA_prototyp/ZRTOS_demo/zephyr/soc/ene/kb106x/soc/ene/kb106x/kb106x/Kconfig.soc"
```

## transform_projects/transform_zrtos/old/ZRTOS_copy/soc/espressif/Kconfig.defconfig
```kconfig
# Copyright (c) 2023 Espressif Systems (Shanghai) Co., Ltd.
# SPDX-License-Identifier: Apache-2.0

if SOC_FAMILY_ESPRESSIF_ESP32

rsource "/home/ljd/wsMA_prototyp/ZRTOS_demo/zephyr/soc/espressif/soc/espressif/common/Kconfig.defconfig"
rsource "/home/ljd/wsMA_prototyp/ZRTOS_demo/zephyr/soc/espressif/soc/espressif/esp32/Kconfig.defconfig"
rsource "/home/ljd/wsMA_prototyp/ZRTOS_demo/zephyr/soc/espressif/soc/espressif/esp32c2/Kconfig.defconfig"
rsource "/home/ljd/wsMA_prototyp/ZRTOS_demo/zephyr/soc/espressif/soc/espressif/esp32c3/Kconfig.defconfig"
rsource "/home/ljd/wsMA_prototyp/ZRTOS_demo/zephyr/soc/espressif/soc/espressif/esp32c6/Kconfig.defconfig"
rsource "/home/ljd/wsMA_prototyp/ZRTOS_demo/zephyr/soc/espressif/soc/espressif/esp32h2/Kconfig.defconfig"
rsource "/home/ljd/wsMA_prototyp/ZRTOS_demo/zephyr/soc/espressif/soc/espressif/esp32s2/Kconfig.defconfig"
rsource "/home/ljd/wsMA_prototyp/ZRTOS_demo/zephyr/soc/espressif/soc/espressif/esp32s3/Kconfig.defconfig"

config HAS_FLASH_LOAD_OFFSET
	default y

config FLASH_LOAD_OFFSET
	default $(dt_node_reg_addr_hex,$(dt_nodelabel_path,boot_partition)) if ESP_SIMPLE_BOOT

endif # SOC_FAMILY_ESPRESSIF_ESP32
```

## transform_projects/transform_zrtos/old/ZRTOS_copy/soc/gaisler/gr716a/Kconfig.soc
```kconfig
# Copyright (c) 2019-2020 Cobham Gaisler AB
# SPDX-License-Identifier: Apache-2.0

config SOC_GR716A
	bool

config SOC
	default "gr716a" if SOC_GR716A

rsource "/home/ljd/wsMA_prototyp/ZRTOS_demo/zephyr/soc/gaisler/gr716a/soc/gaisler/Kconfig.soc"
```

## transform_projects/transform_zrtos/old/ZRTOS_copy/soc/gd/gd32/gd32f3x0/Kconfig.defconfig.series
```kconfig
# Copyright (c) 2021 BrainCo Inc.
# SPDX-License-Identifier: Apache-2.0

if SOC_SERIES_GD32F3X0

rsource "/home/ljd/wsMA_prototyp/ZRTOS_demo/zephyr/soc/gd/gd32/gd32f3x0/soc/gd/gd32/gd32f3x0/Kconfig.defconfig.gd32f350"

endif # SOC_SERIES_GD32F3X0
```

## transform_projects/transform_zrtos/old/ZRTOS_copy/soc/gd/gd32/gd32f4xx/Kconfig.defconfig.series
```kconfig
# Copyright (c) 2021, Teslabs Engineering S.L.
# SPDX-License-Identifier: Apache-2.0

if SOC_SERIES_GD32F4XX

rsource "/home/ljd/wsMA_prototyp/ZRTOS_demo/zephyr/soc/gd/gd32/gd32f4xx/soc/gd/gd32/gd32f4xx/Kconfig.defconfig.gd32f405"
rsource "/home/ljd/wsMA_prototyp/ZRTOS_demo/zephyr/soc/gd/gd32/gd32f4xx/soc/gd/gd32/gd32f4xx/Kconfig.defconfig.gd32f407"
rsource "/home/ljd/wsMA_prototyp/ZRTOS_demo/zephyr/soc/gd/gd32/gd32f4xx/soc/gd/gd32/gd32f4xx/Kconfig.defconfig.gd32f450"
rsource "/home/ljd/wsMA_prototyp/ZRTOS_demo/zephyr/soc/gd/gd32/gd32f4xx/soc/gd/gd32/gd32f4xx/Kconfig.defconfig.gd32f470"

endif # SOC_SERIES_GD32F4XX
```

## transform_projects/transform_zrtos/old/ZRTOS_copy/soc/gd/gd32/gd32l23x/Kconfig.defconfig.series
```kconfig
# Copyright (c) 2022 BrainCo Inc.
# SPDX-License-Identifier: Apache-2.0

if SOC_SERIES_GD32L23X

rsource "/home/ljd/wsMA_prototyp/ZRTOS_demo/zephyr/soc/gd/gd32/gd32l23x/soc/gd/gd32/gd32l23x/Kconfig.defconfig.gd32l233"

endif # SOC_SERIES_GD32L23X
```

## transform_projects/transform_zrtos/old/ZRTOS_copy/soc/infineon/edge/Kconfig.defconfig
```kconfig
# Copyright (c) 2025 Infineon Technologies AG,
# or an affiliate of Infineon Technologies AG.
#
# SPDX-License-Identifier: Apache-2.0

# PSOC CAT1B Configuration

if SOC_FAMILY_INFINEON_EDGE

rsource "/home/ljd/wsMA_prototyp/ZRTOS_demo/zephyr/soc/infineon/edge/soc/infineon/edge/pse84/Kconfig.defconfig"

endif # SOC_FAMILY_INFINEON_EDGE
```

## transform_projects/transform_zrtos/old/ZRTOS_copy/soc/intel/intel_socfpga/Kconfig.soc
```kconfig
# Copyright (c) 2021-2024 Intel Corporation
# SPDX-License-Identifier: Apache-2.0

config SOC_FAMILY_INTEL_SOCFPGA
	bool

config SOC_FAMILY
	default "intel_socfpga" if SOC_FAMILY_INTEL_SOCFPGA

rsource "/home/ljd/wsMA_prototyp/ZRTOS_demo/zephyr/soc/intel/intel_socfpga/soc/intel/intel_socfpga/agilex/Kconfig.soc"
rsource "/home/ljd/wsMA_prototyp/ZRTOS_demo/zephyr/soc/intel/intel_socfpga/soc/intel/intel_socfpga/agilex5/Kconfig.soc"
```

## transform_projects/transform_zrtos/old/ZRTOS_copy/soc/microchip/mec/Kconfig.defconfig
```kconfig
# Copyright (c) 2024, Microchip Technology Inc.
# SPDX-License-Identifier: Apache-2.0

if SOC_FAMILY_MICROCHIP_MEC

rsource "/home/ljd/wsMA_prototyp/ZRTOS_demo/zephyr/soc/microchip/mec/soc/microchip/mec/mec15xx/Kconfig.defconfig.series"
rsource "/home/ljd/wsMA_prototyp/ZRTOS_demo/zephyr/soc/microchip/mec/soc/microchip/mec/mec172x/Kconfig.defconfig.series"
rsource "/home/ljd/wsMA_prototyp/ZRTOS_demo/zephyr/soc/microchip/mec/soc/microchip/mec/mec174x/Kconfig.defconfig.series"
rsource "/home/ljd/wsMA_prototyp/ZRTOS_demo/zephyr/soc/microchip/mec/soc/microchip/mec/mec175x/Kconfig.defconfig.series"
rsource "/home/ljd/wsMA_prototyp/ZRTOS_demo/zephyr/soc/microchip/mec/soc/microchip/mec/mech172x/Kconfig.defconfig.series"

endif # SOC_FAMILY_MICROCHIP_MEC
```
