## transform_projects/transform_zrtos/old/ZRTOS_copy/drivers/serial/Kconfig
```kconfig
# Serial driver configuration options

# Copyright (c) 2014-2015 Wind River Systems, Inc.
# SPDX-License-Identifier: Apache-2.0

menuconfig SERIAL
	bool "Serial drivers"
	help
	  Enable options for serial drivers.

if SERIAL

comment "Capabilities"

config SERIAL_HAS_DRIVER
	bool
	help
	  This is an option to be enabled by individual serial driver
	  to signal that there is a serial driver. This is being used
	  by other drivers which are dependent on serial.

config SERIAL_SUPPORT_ASYNC
	bool
	help
	  This is an option to be enabled by individual serial driver
	  to signal that the driver and hardware supports async operation.

config SERIAL_SUPPORT_INTERRUPT
	bool
	help
	  This is an option to be enabled by individual serial driver
	  to signal that the driver and hardware supports interrupts.

config SERIAL_INIT_PRIORITY
	int "Serial init priority"
	default KERNEL_INIT_PRIORITY_DEVICE
	help
	  Serial driver device initialization priority.

module = UART
module-str = uart
source "subsys/logging/Kconfig.template.log_config"

config SERIAL_SUPPORT_WIDE_DATA
	bool
	help
	  This is an option to be enabled by individual serial driver
	  to signal that the driver and hardware support data longer
	  than 8-bit.

config UART_USE_RUNTIME_CONFIGURE
	bool "Runtime configuration for UART controllers"
	default y
	help
	  Enable runtime configuration of UART controllers.
	  This allows applications to call uart_configure() to
	  configure the UART controllers at runtime, and calling
	  uart_config_get() to retrieve configuration. If this is
	  disabled, UART controllers rely on UART driver's
	  initialization function to properly configure
	  the controller.

	  Say y if unsure. Disable this to reduce footprint for
	  applications that do not require runtime UART configuration.

config UART_ASYNC_API
	bool "Asynchronous UART API"
	depends on SERIAL_SUPPORT_ASYNC
	help
	  This option enables asynchronous UART API.

config UART_INTERRUPT_DRIVEN
	bool "UART Interrupt support"
	depends on SERIAL_SUPPORT_INTERRUPT
	help
	  This option enables interrupt support for UART allowing console
	  input and other UART based drivers.

config UART_EXCLUSIVE_API_CALLBACKS
	bool "Use exclusive callbacks for multiple APIs"
	depends on UART_ASYNC_API && UART_INTERRUPT_DRIVEN
	default y
	help
	  When multiple set of APIs support callbacks, enabling this
	  option will result in only the callbacks of one set of API
	  being active at a time. Setting a new callback to one set of
	  API will remove callbacks to other set of APIs. For example,
	  calling uart_callback_set() would disable the callback
	  previously set via uart_irq_callback_set().

	  Says yes unless you are absolutely sure you know what you are
	  doing and promise not to file bug when things do not work out.

config UART_LINE_CTRL
	bool "Serial Line Control API"
	help
	  This enables the API for apps to control the serial line,
	  such as baud rate, CTS and RTS.

	  Implementation is up to individual driver.

	  Says no if not sure.

config UART_DRV_CMD
	bool "Driver commands API"
	help
	  This enables the API to send extra commands to drivers.
	  This allows drivers to expose hardware specific functions.

	  Says no if not sure.

config UART_WIDE_DATA
	bool "API to support data longer than 8-bit"
	help
	  This enables the API to process data longer than 8-bit.
	  This is up to the driver to implement the necessary functions
	  to properly support this.

config UART_PIPE
	bool "Pipe UART driver"
	select UART_INTERRUPT_DRIVEN
	help
	  Enable pipe UART driver. This driver allows application to communicate
	  over UART with custom defined protocol. Driver doesn't inspect received
	  data (as contrary to console UART driver) and all aspects of received
	  protocol data are handled by application provided callback.

config UART_ASYNC_RX_HELPER
	bool "Helper for UART asynchronous reception"
	help
	  Module implements handling of reception of variable length data using
	  Asynchronous UART API. It can be used in cases where received data processing
	  is delayed. Module implements zero-copy approach with multiple reception
	  buffers.

config UART_ASYNC_TO_INT_DRIVEN_API
	bool
	select UART_ASYNC_RX_HELPER
	help
	  Asynchronous to Interrupt driven adaptation layer. When enabled device
	  which implements only asynchronous API can be used with interrupt driven
	  API implemented by the generic adaptation layer.

config UART_ASYNC_TO_INT_DRIVEN_RX_TIMEOUT
	int "Receiver timeout (in bauds)"
	depends on UART_ASYNC_TO_INT_DRIVEN_API
	default 100
	help
	  Receiver inactivity timeout. It is used to calculate timeout in microseconds.

config UART_SHELL
	bool "UART Shell commands"
	depends on SHELL
	help
	  UART Shell commands

comment "Serial Drivers"

# zephyr-keep-sorted-start
rsource "/home/ljd/wsMA_prototyp/ZRTOS_demo/zephyr/drivers/serial/drivers/serial/Kconfig.aesc"
rsource "/home/ljd/wsMA_prototyp/ZRTOS_demo/zephyr/drivers/serial/drivers/serial/Kconfig.altera"
rsource "/home/ljd/wsMA_prototyp/ZRTOS_demo/zephyr/drivers/serial/drivers/serial/Kconfig.altera_jtag"
rsource "/home/ljd/wsMA_prototyp/ZRTOS_demo/zephyr/drivers/serial/drivers/serial/Kconfig.ambiq"
rsource "/home/ljd/wsMA_prototyp/ZRTOS_demo/zephyr/drivers/serial/drivers/serial/Kconfig.apbuart"
rsource "/home/ljd/wsMA_prototyp/ZRTOS_demo/zephyr/drivers/serial/drivers/serial/Kconfig.b91"
rsource "/home/ljd/wsMA_prototyp/ZRTOS_demo/zephyr/drivers/serial/drivers/serial/Kconfig.bcm2711"
rsource "/home/ljd/wsMA_prototyp/ZRTOS_demo/zephyr/drivers/serial/drivers/serial/Kconfig.bflb"
rsource "/home/ljd/wsMA_prototyp/ZRTOS_demo/zephyr/drivers/serial/drivers/serial/Kconfig.bitbang"
rsource "/home/ljd/wsMA_prototyp/ZRTOS_demo/zephyr/drivers/serial/drivers/serial/Kconfig.bridge"
rsource "/home/ljd/wsMA_prototyp/ZRTOS_demo/zephyr/drivers/serial/drivers/serial/Kconfig.bt"
rsource "/home/ljd/wsMA_prototyp/ZRTOS_demo/zephyr/drivers/serial/drivers/serial/Kconfig.cc13xx_cc26xx"
rsource "/home/ljd/wsMA_prototyp/ZRTOS_demo/zephyr/drivers/serial/drivers/serial/Kconfig.cc23x0"
rsource "/home/ljd/wsMA_prototyp/ZRTOS_demo/zephyr/drivers/serial/drivers/serial/Kconfig.cc32xx"
rsource "/home/ljd/wsMA_prototyp/ZRTOS_demo/zephyr/drivers/serial/drivers/serial/Kconfig.cdns"
rsource "/home/ljd/wsMA_prototyp/ZRTOS_demo/zephyr/drivers/serial/drivers/serial/Kconfig.cmsdk_apb"
rsource "/home/ljd/wsMA_prototyp/ZRTOS_demo/zephyr/drivers/serial/drivers/serial/Kconfig.efinix_sapphire"
rsource "/home/ljd/wsMA_prototyp/ZRTOS_demo/zephyr/drivers/serial/drivers/serial/Kconfig.emul"
rsource "/home/ljd/wsMA_prototyp/ZRTOS_demo/zephyr/drivers/serial/drivers/serial/Kconfig.ene"
rsource "/home/ljd/wsMA_prototyp/ZRTOS_demo/zephyr/drivers/serial/drivers/serial/Kconfig.esp32"
rsource "/home/ljd/wsMA_prototyp/ZRTOS_demo/zephyr/drivers/serial/drivers/serial/Kconfig.gd32"
rsource "/home/ljd/wsMA_prototyp/ZRTOS_demo/zephyr/drivers/serial/drivers/serial/Kconfig.gecko"
rsource "/home/ljd/wsMA_prototyp/ZRTOS_demo/zephyr/drivers/serial/drivers/serial/Kconfig.hostlink"
rsource "/home/ljd/wsMA_prototyp/ZRTOS_demo/zephyr/drivers/serial/drivers/serial/Kconfig.ifx_cat1"
rsource "/home/ljd/wsMA_prototyp/ZRTOS_demo/zephyr/drivers/serial/drivers/serial/Kconfig.imx"
rsource "/home/ljd/wsMA_prototyp/ZRTOS_demo/zephyr/drivers/serial/drivers/serial/Kconfig.intel_lw"
rsource "/home/ljd/wsMA_prototyp/ZRTOS_demo/zephyr/drivers/serial/drivers/serial/Kconfig.it51xxx"
rsource "/home/ljd/wsMA_prototyp/ZRTOS_demo/zephyr/drivers/serial/drivers/serial/Kconfig.it8xxx2"
rsource "/home/ljd/wsMA_prototyp/ZRTOS_demo/zephyr/drivers/serial/drivers/serial/Kconfig.leuart_gecko"
rsource "/home/ljd/wsMA_prototyp/ZRTOS_demo/zephyr/drivers/serial/drivers/serial/Kconfig.litex"
rsource "/home/ljd/wsMA_prototyp/ZRTOS_demo/zephyr/drivers/serial/drivers/serial/Kconfig.lpc11u6x"
rsource "/home/ljd/wsMA_prototyp/ZRTOS_demo/zephyr/drivers/serial/drivers/serial/Kconfig.max32"
rsource "/home/ljd/wsMA_prototyp/ZRTOS_demo/zephyr/drivers/serial/drivers/serial/Kconfig.mchp"
rsource "/home/ljd/wsMA_prototyp/ZRTOS_demo/zephyr/drivers/serial/drivers/serial/Kconfig.mcux"
rsource "/home/ljd/wsMA_prototyp/ZRTOS_demo/zephyr/drivers/serial/drivers/serial/Kconfig.mcux_flexcomm"
rsource "/home/ljd/wsMA_prototyp/ZRTOS_demo/zephyr/drivers/serial/drivers/serial/Kconfig.mcux_iuart"
rsource "/home/ljd/wsMA_prototyp/ZRTOS_demo/zephyr/drivers/serial/drivers/serial/Kconfig.mcux_lpsci"
rsource "/home/ljd/wsMA_prototyp/ZRTOS_demo/zephyr/drivers/serial/drivers/serial/Kconfig.mcux_lpuart"
rsource "/home/ljd/wsMA_prototyp/ZRTOS_demo/zephyr/drivers/serial/drivers/serial/Kconfig.mec5"
rsource "/home/ljd/wsMA_prototyp/ZRTOS_demo/zephyr/drivers/serial/drivers/serial/Kconfig.miv"
rsource "/home/ljd/wsMA_prototyp/ZRTOS_demo/zephyr/drivers/serial/drivers/serial/Kconfig.msp432p4xx"
rsource "/home/ljd/wsMA_prototyp/ZRTOS_demo/zephyr/drivers/serial/drivers/serial/Kconfig.mspm0"
rsource "/home/ljd/wsMA_prototyp/ZRTOS_demo/zephyr/drivers/serial/drivers/serial/Kconfig.native_pty"
rsource "/home/ljd/wsMA_prototyp/ZRTOS_demo/zephyr/drivers/serial/drivers/serial/Kconfig.native_tty"
rsource "/home/ljd/wsMA_prototyp/ZRTOS_demo/zephyr/drivers/serial/drivers/serial/Kconfig.neorv32"
rsource "/home/ljd/wsMA_prototyp/ZRTOS_demo/zephyr/drivers/serial/drivers/serial/Kconfig.npcx"
rsource "/home/ljd/wsMA_prototyp/ZRTOS_demo/zephyr/drivers/serial/drivers/serial/Kconfig.nrfx"
rsource "/home/ljd/wsMA_prototyp/ZRTOS_demo/zephyr/drivers/serial/drivers/serial/Kconfig.ns16550"
rsource "/home/ljd/wsMA_prototyp/ZRTOS_demo/zephyr/drivers/serial/drivers/serial/Kconfig.numaker"
rsource "/home/ljd/wsMA_prototyp/ZRTOS_demo/zephyr/drivers/serial/drivers/serial/Kconfig.numicro"
rsource "/home/ljd/wsMA_prototyp/ZRTOS_demo/zephyr/drivers/serial/drivers/serial/Kconfig.nxp_s32"
rsource "/home/ljd/wsMA_prototyp/ZRTOS_demo/zephyr/drivers/serial/drivers/serial/Kconfig.opentitan"
rsource "/home/ljd/wsMA_prototyp/ZRTOS_demo/zephyr/drivers/serial/drivers/serial/Kconfig.pl011"
rsource "/home/ljd/wsMA_prototyp/ZRTOS_demo/zephyr/drivers/serial/drivers/serial/Kconfig.psoc6"
rsource "/home/ljd/wsMA_prototyp/ZRTOS_demo/zephyr/drivers/serial/drivers/serial/Kconfig.ql_usbserialport_s3b"
rsource "/home/ljd/wsMA_prototyp/ZRTOS_demo/zephyr/drivers/serial/drivers/serial/Kconfig.rcar"
rsource "/home/ljd/wsMA_prototyp/ZRTOS_demo/zephyr/drivers/serial/drivers/serial/Kconfig.realtek_rts5912"
rsource "/home/ljd/wsMA_prototyp/ZRTOS_demo/zephyr/drivers/serial/drivers/serial/Kconfig.renesas_ra"
rsource "/home/ljd/wsMA_prototyp/ZRTOS_demo/zephyr/drivers/serial/drivers/serial/Kconfig.renesas_ra8"
rsource "/home/ljd/wsMA_prototyp/ZRTOS_demo/zephyr/drivers/serial/drivers/serial/Kconfig.renesas_rx"
rsource "/home/ljd/wsMA_prototyp/ZRTOS_demo/zephyr/drivers/serial/drivers/serial/Kconfig.renesas_rx_qemu"
rsource "/home/ljd/wsMA_prototyp/ZRTOS_demo/zephyr/drivers/serial/drivers/serial/Kconfig.renesas_rz"
rsource "/home/ljd/wsMA_prototyp/ZRTOS_demo/zephyr/drivers/serial/drivers/serial/Kconfig.rpi_pico"
rsource "/home/ljd/wsMA_prototyp/ZRTOS_demo/zephyr/drivers/serial/drivers/serial/Kconfig.rtt"
rsource "/home/ljd/wsMA_prototyp/ZRTOS_demo/zephyr/drivers/serial/drivers/serial/Kconfig.rv32m1_lpuart"
rsource "/home/ljd/wsMA_prototyp/ZRTOS_demo/zephyr/drivers/serial/drivers/serial/Kconfig.rzt2m"
rsource "/home/ljd/wsMA_prototyp/ZRTOS_demo/zephyr/drivers/serial/drivers/serial/Kconfig.sam0"
rsource "/home/ljd/wsMA_prototyp/ZRTOS_demo/zephyr/drivers/serial/drivers/serial/Kconfig.sedi"
rsource "/home/ljd/wsMA_prototyp/ZRTOS_demo/zephyr/drivers/serial/drivers/serial/Kconfig.sf32lb"
rsource "/home/ljd/wsMA_prototyp/ZRTOS_demo/zephyr/drivers/serial/drivers/serial/Kconfig.si32"
rsource "/home/ljd/wsMA_prototyp/ZRTOS_demo/zephyr/drivers/serial/drivers/serial/Kconfig.sifive"
rsource "/home/ljd/wsMA_prototyp/ZRTOS_demo/zephyr/drivers/serial/drivers/serial/Kconfig.silabs_eusart"
rsource "/home/ljd/wsMA_prototyp/ZRTOS_demo/zephyr/drivers/serial/drivers/serial/Kconfig.silabs_usart"
rsource "/home/ljd/wsMA_prototyp/ZRTOS_demo/zephyr/drivers/serial/drivers/serial/Kconfig.smartbond"
rsource "/home/ljd/wsMA_prototyp/ZRTOS_demo/zephyr/drivers/serial/drivers/serial/Kconfig.stellaris"
rsource "/home/ljd/wsMA_prototyp/ZRTOS_demo/zephyr/drivers/serial/drivers/serial/Kconfig.stm32"
rsource "/home/ljd/wsMA_prototyp/ZRTOS_demo/zephyr/drivers/serial/drivers/serial/Kconfig.sy1xx"
rsource "/home/ljd/wsMA_prototyp/ZRTOS_demo/zephyr/drivers/serial/drivers/serial/Kconfig.test"
rsource "/home/ljd/wsMA_prototyp/ZRTOS_demo/zephyr/drivers/serial/drivers/serial/Kconfig.uart_sam"
rsource "/home/ljd/wsMA_prototyp/ZRTOS_demo/zephyr/drivers/serial/drivers/serial/Kconfig.usart_sam"
rsource "/home/ljd/wsMA_prototyp/ZRTOS_demo/zephyr/drivers/serial/drivers/serial/Kconfig.virtio_console"
rsource "/home/ljd/wsMA_prototyp/ZRTOS_demo/zephyr/drivers/serial/drivers/serial/Kconfig.wch_usart"
rsource "/home/ljd/wsMA_prototyp/ZRTOS_demo/zephyr/drivers/serial/drivers/serial/Kconfig.xec"
rsource "/home/ljd/wsMA_prototyp/ZRTOS_demo/zephyr/drivers/serial/drivers/serial/Kconfig.xen"
rsource "/home/ljd/wsMA_prototyp/ZRTOS_demo/zephyr/drivers/serial/drivers/serial/Kconfig.xlnx"
rsource "/home/ljd/wsMA_prototyp/ZRTOS_demo/zephyr/drivers/serial/drivers/serial/Kconfig.xmc4xxx"
# zephyr-keep-sorted-stop

endif # SERIAL
```
