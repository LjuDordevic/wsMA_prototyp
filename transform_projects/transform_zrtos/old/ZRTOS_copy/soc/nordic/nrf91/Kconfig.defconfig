## transform_projects/transform_zrtos/old/ZRTOS_copy/soc/nordic/nrf91/Kconfig.defconfig
```kconfig
# Nordic Semiconductor nRF91 MCU line

# Copyright (c) 2018 Nordic Semiconductor ASA
# SPDX-License-Identifier: Apache-2.0

if SOC_SERIES_NRF91X

rsource "/home/ljd/wsMA_prototyp/ZRTOS_demo/zephyr/soc/nordic/nrf91/soc/nordic/nrf91/Kconfig.defconfig.nrf9131_LACA"
rsource "/home/ljd/wsMA_prototyp/ZRTOS_demo/zephyr/soc/nordic/nrf91/soc/nordic/nrf91/Kconfig.defconfig.nrf9151_LACA"
rsource "/home/ljd/wsMA_prototyp/ZRTOS_demo/zephyr/soc/nordic/nrf91/soc/nordic/nrf91/Kconfig.defconfig.nrf9160_SICA"
rsource "/home/ljd/wsMA_prototyp/ZRTOS_demo/zephyr/soc/nordic/nrf91/soc/nordic/nrf91/Kconfig.defconfig.nrf9161_LACA"

config SYS_CLOCK_HW_CYCLES_PER_SEC
	default $(dt_nodelabel_int_prop,rtc1,clock-frequency)

endif # SOC_SERIES_NRF91X
```

## transform_projects/transform_zrtos/old/ZRTOS_copy/soc/nuvoton/npcm/Kconfig.soc
```kconfig
# Copyright (c) 2024 Nuvoton Technology Corporation.
#
# SPDX-License-Identifier: Apache-2.0

config SOC_FAMILY_NPCM
	bool

config SOC_FAMILY
	default "npcm" if SOC_FAMILY_NPCM

rsource "/home/ljd/wsMA_prototyp/ZRTOS_demo/zephyr/soc/nuvoton/npcm/soc/nuvoton/npcm/npcm4/Kconfig.soc"
```

## transform_projects/transform_zrtos/old/ZRTOS_copy/soc/nuvoton/numicro/Kconfig
```kconfig
# SPDX-License-Identifier: Apache-2.0
#
# Copyright (c) 2020 Linumiz
# Author: Saravanan Sekar <saravanan@linumiz.com>

config SOC_FAMILY_NUMICRO
	select SOC_RESET_HOOK

if SOC_FAMILY_NUMICRO

rsource "/home/ljd/wsMA_prototyp/ZRTOS_demo/zephyr/soc/nuvoton/numicro/soc/nuvoton/numicro/m48x/Kconfig"

endif # SOC_FAMILY_NUMICRO
```

## transform_projects/transform_zrtos/old/ZRTOS_copy/soc/nxp/imxrt/imxrt7xx/Kconfig
```kconfig
# Copyright 2024-2025 NXP
# SPDX-License-Identifier: Apache-2.0

if SOC_SERIES_IMXRT7XX

rsource "/home/ljd/wsMA_prototyp/ZRTOS_demo/zephyr/soc/nxp/imxrt/imxrt7xx/soc/nxp/imxrt/imxrt7xx/cm33/Kconfig"
rsource "/home/ljd/wsMA_prototyp/ZRTOS_demo/zephyr/soc/nxp/imxrt/imxrt7xx/soc/nxp/imxrt/imxrt7xx/hifi1/Kconfig"
rsource "/home/ljd/wsMA_prototyp/ZRTOS_demo/zephyr/soc/nxp/imxrt/imxrt7xx/soc/nxp/imxrt/imxrt7xx/hifi4/Kconfig"

config IMAGE_VECTOR_TABLE_OFFSET
	default 0x4000 if NXP_IMXRT_BOOT_HEADER

config GLIKEY_MCUX_GLIKEY
	default y
	bool "Use glikey MCUX Driver"

endif # SOC_SERIES_IMXRT7XX
```

## transform_projects/transform_zrtos/old/ZRTOS_copy/soc/nxp/imxrt/imxrt7xx/Kconfig.defconfig
```kconfig
# Copyright 2024-2025 NXP
# SPDX-License-Identifier: Apache-2.0

rsource "/home/ljd/wsMA_prototyp/ZRTOS_demo/zephyr/soc/nxp/imxrt/imxrt7xx/soc/nxp/imxrt/imxrt7xx/cm33/Kconfig.defconfig"
rsource "/home/ljd/wsMA_prototyp/ZRTOS_demo/zephyr/soc/nxp/imxrt/imxrt7xx/soc/nxp/imxrt/imxrt7xx/hifi1/Kconfig.defconfig"
rsource "/home/ljd/wsMA_prototyp/ZRTOS_demo/zephyr/soc/nxp/imxrt/imxrt7xx/soc/nxp/imxrt/imxrt7xx/hifi4/Kconfig.defconfig"

config MFD
	default y if DT_HAS_NXP_LP_FLEXCOMM_ENABLED
```

## transform_projects/transform_zrtos/old/ZRTOS_copy/soc/nxp/mcx/Kconfig.defconfig
```kconfig
# Copyright 2024-2025 NXP
# SPDX-License-Identifier: Apache-2.0

rsource "/home/ljd/wsMA_prototyp/ZRTOS_demo/zephyr/soc/nxp/mcx/soc/nxp/mcx/mcxa/Kconfig.defconfig"
rsource "/home/ljd/wsMA_prototyp/ZRTOS_demo/zephyr/soc/nxp/mcx/soc/nxp/mcx/mcxc/Kconfig.defconfig"
rsource "/home/ljd/wsMA_prototyp/ZRTOS_demo/zephyr/soc/nxp/mcx/soc/nxp/mcx/mcxn/Kconfig.defconfig"
rsource "/home/ljd/wsMA_prototyp/ZRTOS_demo/zephyr/soc/nxp/mcx/soc/nxp/mcx/mcxw/Kconfig.defconfig"
```

## transform_projects/transform_zrtos/old/ZRTOS_copy/soc/nxp/mcx/mcxe/Kconfig.soc
```kconfig
# Copyright 2025 NXP
# SPDX-License-Identifier: Apache-2.0

config SOC_FAMILY_MCXE
	bool

config SOC_FAMILY
	default "mcxe" if SOC_FAMILY_MCXE

rsource "/home/ljd/wsMA_prototyp/ZRTOS_demo/zephyr/soc/nxp/mcx/mcxe/soc/nxp/mcx/mcxe/mcxe24x/Kconfig.soc"
rsource "/home/ljd/wsMA_prototyp/ZRTOS_demo/zephyr/soc/nxp/mcx/mcxe/soc/nxp/mcx/mcxe/mcxe31x/Kconfig.soc"
```

## transform_projects/transform_zrtos/old/ZRTOS_copy/soc/raspberrypi/rpi_pico/Kconfig
```kconfig
# Raspberry Pi (RP) MCU line

# Copyright (c) 2021 Nordic Semiconductor ASA
# Copyright (c) 2021 Yonatan Schachter
# SPDX-License-Identifier: Apache-2.0

if SOC_FAMILY_RPI_PICO

rsource "/home/ljd/wsMA_prototyp/ZRTOS_demo/zephyr/soc/raspberrypi/rpi_pico/soc/raspberrypi/rpi_pico/rp2040/Kconfig"
rsource "/home/ljd/wsMA_prototyp/ZRTOS_demo/zephyr/soc/raspberrypi/rpi_pico/soc/raspberrypi/rpi_pico/rp2350/Kconfig"

config RPI_PICO_ROM_BOOTLOADER
	bool
	default y
	depends on RETENTION_BOOT_MODE

endif # SOC_FAMILY_RPI_PICO
```

## transform_projects/transform_zrtos/old/ZRTOS_copy/soc/renesas/ra/Kconfig.defconfig
```kconfig
# Copyright (c) 2023 TOKITA Hiroshi <tokita.hiroshi@fujitsu.com>
# SPDX-License-Identifier: Apache-2.0

if SOC_FAMILY_RENESAS_RA

rsource "/home/ljd/wsMA_prototyp/ZRTOS_demo/zephyr/soc/renesas/ra/soc/renesas/ra/ra2a1/Kconfig.defconfig"
rsource "/home/ljd/wsMA_prototyp/ZRTOS_demo/zephyr/soc/renesas/ra/soc/renesas/ra/ra2l1/Kconfig.defconfig"
rsource "/home/ljd/wsMA_prototyp/ZRTOS_demo/zephyr/soc/renesas/ra/soc/renesas/ra/ra4c1/Kconfig.defconfig"
rsource "/home/ljd/wsMA_prototyp/ZRTOS_demo/zephyr/soc/renesas/ra/soc/renesas/ra/ra4e1/Kconfig.defconfig"
rsource "/home/ljd/wsMA_prototyp/ZRTOS_demo/zephyr/soc/renesas/ra/soc/renesas/ra/ra4e2/Kconfig.defconfig"
rsource "/home/ljd/wsMA_prototyp/ZRTOS_demo/zephyr/soc/renesas/ra/soc/renesas/ra/ra4l1/Kconfig.defconfig"
rsource "/home/ljd/wsMA_prototyp/ZRTOS_demo/zephyr/soc/renesas/ra/soc/renesas/ra/ra4m1/Kconfig.defconfig"
rsource "/home/ljd/wsMA_prototyp/ZRTOS_demo/zephyr/soc/renesas/ra/soc/renesas/ra/ra4m2/Kconfig.defconfig"
rsource "/home/ljd/wsMA_prototyp/ZRTOS_demo/zephyr/soc/renesas/ra/soc/renesas/ra/ra4m3/Kconfig.defconfig"
rsource "/home/ljd/wsMA_prototyp/ZRTOS_demo/zephyr/soc/renesas/ra/soc/renesas/ra/ra4w1/Kconfig.defconfig"
rsource "/home/ljd/wsMA_prototyp/ZRTOS_demo/zephyr/soc/renesas/ra/soc/renesas/ra/ra6e1/Kconfig.defconfig"
rsource "/home/ljd/wsMA_prototyp/ZRTOS_demo/zephyr/soc/renesas/ra/soc/renesas/ra/ra6e2/Kconfig.defconfig"
rsource "/home/ljd/wsMA_prototyp/ZRTOS_demo/zephyr/soc/renesas/ra/soc/renesas/ra/ra6m1/Kconfig.defconfig"
rsource "/home/ljd/wsMA_prototyp/ZRTOS_demo/zephyr/soc/renesas/ra/soc/renesas/ra/ra6m2/Kconfig.defconfig"
rsource "/home/ljd/wsMA_prototyp/ZRTOS_demo/zephyr/soc/renesas/ra/soc/renesas/ra/ra6m3/Kconfig.defconfig"
rsource "/home/ljd/wsMA_prototyp/ZRTOS_demo/zephyr/soc/renesas/ra/soc/renesas/ra/ra6m4/Kconfig.defconfig"
rsource "/home/ljd/wsMA_prototyp/ZRTOS_demo/zephyr/soc/renesas/ra/soc/renesas/ra/ra6m5/Kconfig.defconfig"
rsource "/home/ljd/wsMA_prototyp/ZRTOS_demo/zephyr/soc/renesas/ra/soc/renesas/ra/ra8d1/Kconfig.defconfig"
rsource "/home/ljd/wsMA_prototyp/ZRTOS_demo/zephyr/soc/renesas/ra/soc/renesas/ra/ra8d2/Kconfig.defconfig"
rsource "/home/ljd/wsMA_prototyp/ZRTOS_demo/zephyr/soc/renesas/ra/soc/renesas/ra/ra8m1/Kconfig.defconfig"
rsource "/home/ljd/wsMA_prototyp/ZRTOS_demo/zephyr/soc/renesas/ra/soc/renesas/ra/ra8m2/Kconfig.defconfig"
rsource "/home/ljd/wsMA_prototyp/ZRTOS_demo/zephyr/soc/renesas/ra/soc/renesas/ra/ra8p1/Kconfig.defconfig"
rsource "/home/ljd/wsMA_prototyp/ZRTOS_demo/zephyr/soc/renesas/ra/soc/renesas/ra/ra8t1/Kconfig.defconfig"
rsource "/home/ljd/wsMA_prototyp/ZRTOS_demo/zephyr/soc/renesas/ra/soc/renesas/ra/ra8t2/Kconfig.defconfig"

endif # SOC_FAMILY_RENESAS_RA
```

## transform_projects/transform_zrtos/old/ZRTOS_copy/soc/renesas/rz/Kconfig.defconfig
```kconfig
# Copyright (c) 2024 Renesas Electronics Corporation
# SPDX-License-Identifier: Apache-2.0

if SOC_FAMILY_RENESAS_RZ

rsource "/home/ljd/wsMA_prototyp/ZRTOS_demo/zephyr/soc/renesas/rz/soc/renesas/rz/rza2m/Kconfig.defconfig"
rsource "/home/ljd/wsMA_prototyp/ZRTOS_demo/zephyr/soc/renesas/rz/soc/renesas/rz/rza3ul/Kconfig.defconfig"
rsource "/home/ljd/wsMA_prototyp/ZRTOS_demo/zephyr/soc/renesas/rz/soc/renesas/rz/rzg2l/Kconfig.defconfig"
rsource "/home/ljd/wsMA_prototyp/ZRTOS_demo/zephyr/soc/renesas/rz/soc/renesas/rz/rzg2ul/Kconfig.defconfig"
rsource "/home/ljd/wsMA_prototyp/ZRTOS_demo/zephyr/soc/renesas/rz/soc/renesas/rz/rzg3s/Kconfig.defconfig"
rsource "/home/ljd/wsMA_prototyp/ZRTOS_demo/zephyr/soc/renesas/rz/soc/renesas/rz/rzn2l/Kconfig.defconfig"
rsource "/home/ljd/wsMA_prototyp/ZRTOS_demo/zephyr/soc/renesas/rz/soc/renesas/rz/rzt2l/Kconfig.defconfig"
rsource "/home/ljd/wsMA_prototyp/ZRTOS_demo/zephyr/soc/renesas/rz/soc/renesas/rz/rzt2m/Kconfig.defconfig"
rsource "/home/ljd/wsMA_prototyp/ZRTOS_demo/zephyr/soc/renesas/rz/soc/renesas/rz/rzv2l/Kconfig.defconfig"
rsource "/home/ljd/wsMA_prototyp/ZRTOS_demo/zephyr/soc/renesas/rz/soc/renesas/rz/rzv2n/Kconfig.defconfig"

endif # SOC_FAMILY_RENESAS_RZ
```

## transform_projects/transform_zrtos/old/ZRTOS_copy/soc/renesas/rz/Kconfig.soc
```kconfig
# Copyright (c) 2024 Renesas Electronics Corporation
# SPDX-License-Identifier: Apache-2.0

config SOC_FAMILY_RENESAS_RZ
	bool

config SOC_FAMILY
	default "renesas_rz" if SOC_FAMILY_RENESAS_RZ

rsource "/home/ljd/wsMA_prototyp/ZRTOS_demo/zephyr/soc/renesas/rz/soc/renesas/rz/rza2m/Kconfig.soc"
rsource "/home/ljd/wsMA_prototyp/ZRTOS_demo/zephyr/soc/renesas/rz/soc/renesas/rz/rza3ul/Kconfig.soc"
rsource "/home/ljd/wsMA_prototyp/ZRTOS_demo/zephyr/soc/renesas/rz/soc/renesas/rz/rzg2l/Kconfig.soc"
rsource "/home/ljd/wsMA_prototyp/ZRTOS_demo/zephyr/soc/renesas/rz/soc/renesas/rz/rzg2ul/Kconfig.soc"
rsource "/home/ljd/wsMA_prototyp/ZRTOS_demo/zephyr/soc/renesas/rz/soc/renesas/rz/rzg3s/Kconfig.soc"
rsource "/home/ljd/wsMA_prototyp/ZRTOS_demo/zephyr/soc/renesas/rz/soc/renesas/rz/rzn2l/Kconfig.soc"
rsource "/home/ljd/wsMA_prototyp/ZRTOS_demo/zephyr/soc/renesas/rz/soc/renesas/rz/rzt2l/Kconfig.soc"
rsource "/home/ljd/wsMA_prototyp/ZRTOS_demo/zephyr/soc/renesas/rz/soc/renesas/rz/rzt2m/Kconfig.soc"
rsource "/home/ljd/wsMA_prototyp/ZRTOS_demo/zephyr/soc/renesas/rz/soc/renesas/rz/rzv2h/Kconfig.soc"
rsource "/home/ljd/wsMA_prototyp/ZRTOS_demo/zephyr/soc/renesas/rz/soc/renesas/rz/rzv2l/Kconfig.soc"
rsource "/home/ljd/wsMA_prototyp/ZRTOS_demo/zephyr/soc/renesas/rz/soc/renesas/rz/rzv2n/Kconfig.soc"
```

## transform_projects/transform_zrtos/old/ZRTOS_copy/soc/rockchip/Kconfig.soc
```kconfig
#
# Copyright 2021 Huawei France Technologies SASU
#
# SPDX-License-Identifier: Apache-2.0
#

config SOC_FAMILY_ROCKCHIP
	bool

config SOC_FAMILY
	default "rockchip" if SOC_FAMILY_ROCKCHIP

rsource "/home/ljd/wsMA_prototyp/ZRTOS_demo/zephyr/soc/rockchip/soc/rockchip/rk3399/Kconfig.soc"
rsource "/home/ljd/wsMA_prototyp/ZRTOS_demo/zephyr/soc/rockchip/soc/rockchip/rk35/Kconfig.soc"
```

## transform_projects/transform_zrtos/old/ZRTOS_copy/soc/rockchip/rk35/rk3588s/Kconfig.defconfig
```kconfig
# Copyright 2024 Université Gustave Eiffel
# SPDX-License-Identifier: Apache-2.0

if SOC_RK3588S

rsource "/home/ljd/wsMA_prototyp/ZRTOS_demo/zephyr/soc/rockchip/rk35/rk3588s/soc/rockchip/rk35/rk3588s/Kconfig.defconfig.rk3588s"

endif # SOC_RK3588S
```

## transform_projects/transform_zrtos/old/ZRTOS_copy/soc/sensry/ganymed/Kconfig.soc
```kconfig
# SPDX-License-Identifier: Apache-2.0
# Copyright (c) 2024 sensry.io

rsource "/home/ljd/wsMA_prototyp/ZRTOS_demo/zephyr/soc/sensry/ganymed/soc/sensry/ganymed/sy1xx/Kconfig.soc"
```

## transform_projects/transform_zrtos/old/ZRTOS_copy/soc/sifive/sifive_freedom/Kconfig.defconfig
```kconfig
# Copyright (c) 2024 Nordic Semiconductor ASA
# Copyright (c) 2024 Antmicro <www.antmicro.com>
# SPDX-License-Identifier: Apache-2.0

if SOC_FAMILY_SIFIVE_FREEDOM

rsource "/home/ljd/wsMA_prototyp/ZRTOS_demo/zephyr/soc/sifive/sifive_freedom/soc/sifive/sifive_freedom/fe300/Kconfig.defconfig"
rsource "/home/ljd/wsMA_prototyp/ZRTOS_demo/zephyr/soc/sifive/sifive_freedom/soc/sifive/sifive_freedom/fu500/Kconfig.defconfig"
rsource "/home/ljd/wsMA_prototyp/ZRTOS_demo/zephyr/soc/sifive/sifive_freedom/soc/sifive/sifive_freedom/fu700/Kconfig.defconfig"

endif # SOC_FAMILY_SIFIVE_FREEDOM
```

## transform_projects/transform_zrtos/old/ZRTOS_copy/soc/silabs/silabs_sim3/Kconfig.soc
```kconfig
# Copyright (c) 2024 GARDENA GmbH
#
# SPDX-License-Identifier: Apache-2.0

config SOC_FAMILY_SILABS_SIM3
	bool

rsource "/home/ljd/wsMA_prototyp/ZRTOS_demo/zephyr/soc/silabs/silabs_sim3/soc/silabs/silabs_sim3/sim3u/Kconfig.soc"
```

## transform_projects/transform_zrtos/old/ZRTOS_copy/soc/silabs/silabs_siwx91x/Kconfig.soc
```kconfig
# Copyright (c) 2023 Antmicro
# SPDX-License-Identifier: Apache-2.0

config SOC_FAMILY_SILABS_SIWX91X
	bool

rsource "/home/ljd/wsMA_prototyp/ZRTOS_demo/zephyr/soc/silabs/silabs_siwx91x/soc/silabs/silabs_siwx91x/siwg917/Kconfig.soc"
```

## transform_projects/transform_zrtos/old/ZRTOS_copy/soc/snps/nsim/arc_classic/Kconfig.defconfig
```kconfig
# Copyright (c) 2024 Synopsys, Inc.
# SPDX-License-Identifier: Apache-2.0

if SOC_FAMILY_NSIM_ARC_CLASSIC

config XIP
	default n

rsource "/home/ljd/wsMA_prototyp/ZRTOS_demo/zephyr/soc/snps/nsim/arc_classic/soc/snps/nsim/arc_classic/sem/Kconfig.defconfig"
rsource "/home/ljd/wsMA_prototyp/ZRTOS_demo/zephyr/soc/snps/nsim/arc_classic/soc/snps/nsim/arc_classic/vpx5/Kconfig.defconfig"

endif # SOC_FAMILY_NSIM_ARC_CLASSIC
```

## transform_projects/transform_zrtos/old/ZRTOS_copy/soc/st/stm32/stm32h7x/Kconfig.defconfig
```kconfig
# ST Microelectronics STM32H7 MCU line

# Copyright (c) 2019 Linaro  Limited
# Copyright (c) 2022 SILA Embedded Solutions GmbH <office@embedded-solutions.at>
# SPDX-License-Identifier: Apache-2.0

# Kconfig symbols common to STM32H7 series

if SOC_SERIES_STM32H7X

rsource "/home/ljd/wsMA_prototyp/ZRTOS_demo/zephyr/soc/st/stm32/stm32h7x/soc/st/stm32/stm32h7x/Kconfig.defconfig.stm32h723xx"
rsource "/home/ljd/wsMA_prototyp/ZRTOS_demo/zephyr/soc/st/stm32/stm32h7x/soc/st/stm32/stm32h7x/Kconfig.defconfig.stm32h725xx"
rsource "/home/ljd/wsMA_prototyp/ZRTOS_demo/zephyr/soc/st/stm32/stm32h7x/soc/st/stm32/stm32h7x/Kconfig.defconfig.stm32h730xx"
rsource "/home/ljd/wsMA_prototyp/ZRTOS_demo/zephyr/soc/st/stm32/stm32h7x/soc/st/stm32/stm32h7x/Kconfig.defconfig.stm32h735xx"
rsource "/home/ljd/wsMA_prototyp/ZRTOS_demo/zephyr/soc/st/stm32/stm32h7x/soc/st/stm32/stm32h7x/Kconfig.defconfig.stm32h742xx"
rsource "/home/ljd/wsMA_prototyp/ZRTOS_demo/zephyr/soc/st/stm32/stm32h7x/soc/st/stm32/stm32h7x/Kconfig.defconfig.stm32h743xx"
rsource "/home/ljd/wsMA_prototyp/ZRTOS_demo/zephyr/soc/st/stm32/stm32h7x/soc/st/stm32/stm32h7x/Kconfig.defconfig.stm32h745xx"
rsource "/home/ljd/wsMA_prototyp/ZRTOS_demo/zephyr/soc/st/stm32/stm32h7x/soc/st/stm32/stm32h7x/Kconfig.defconfig.stm32h747xx"
rsource "/home/ljd/wsMA_prototyp/ZRTOS_demo/zephyr/soc/st/stm32/stm32h7x/soc/st/stm32/stm32h7x/Kconfig.defconfig.stm32h750xx"
rsource "/home/ljd/wsMA_prototyp/ZRTOS_demo/zephyr/soc/st/stm32/stm32h7x/soc/st/stm32/stm32h7x/Kconfig.defconfig.stm32h753xx"
rsource "/home/ljd/wsMA_prototyp/ZRTOS_demo/zephyr/soc/st/stm32/stm32h7x/soc/st/stm32/stm32h7x/Kconfig.defconfig.stm32h755xx"
rsource "/home/ljd/wsMA_prototyp/ZRTOS_demo/zephyr/soc/st/stm32/stm32h7x/soc/st/stm32/stm32h7x/Kconfig.defconfig.stm32h757xx"
rsource "/home/ljd/wsMA_prototyp/ZRTOS_demo/zephyr/soc/st/stm32/stm32h7x/soc/st/stm32/stm32h7x/Kconfig.defconfig.stm32h7a3xx"
rsource "/home/ljd/wsMA_prototyp/ZRTOS_demo/zephyr/soc/st/stm32/stm32h7x/soc/st/stm32/stm32h7x/Kconfig.defconfig.stm32h7b0xx"
rsource "/home/ljd/wsMA_prototyp/ZRTOS_demo/zephyr/soc/st/stm32/stm32h7x/soc/st/stm32/stm32h7x/Kconfig.defconfig.stm32h7b3xx"

config ROM_START_OFFSET
	default 0x400 if BOOTLOADER_MCUBOOT
	default 0x0   if !BOOTLOADER_MCUBOOT

config CACHE_MANAGEMENT
	default y if CPU_CORTEX_M7

if LVGL

config LV_DRAW_DMA2D_HAL_INCLUDE
	default "stm32h7xx.h"

endif # LVGL

endif # SOC_SERIES_STM32H7X
```
