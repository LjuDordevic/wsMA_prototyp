## transform_projects/transform_zrtos/old/ZRTOS_copy/soc/st/stm32/stm32l4x/Kconfig.defconfig
```kconfig
# ST Microelectronics STM32L4 MCU line

# Copyright (c) 2016 Open-RnD Sp. z o.o.
# Copyright (c) 2016 BayLibre, SAS
# SPDX-License-Identifier: Apache-2.0

# Kconfig symbols common to STM32L4 series

if SOC_SERIES_STM32L4X

rsource "/home/ljd/wsMA_prototyp/ZRTOS_demo/zephyr/soc/st/stm32/stm32l4x/soc/st/stm32/stm32l4x/Kconfig.defconfig.stm32l412xx"
rsource "/home/ljd/wsMA_prototyp/ZRTOS_demo/zephyr/soc/st/stm32/stm32l4x/soc/st/stm32/stm32l4x/Kconfig.defconfig.stm32l422xx"
rsource "/home/ljd/wsMA_prototyp/ZRTOS_demo/zephyr/soc/st/stm32/stm32l4x/soc/st/stm32/stm32l4x/Kconfig.defconfig.stm32l431xx"
rsource "/home/ljd/wsMA_prototyp/ZRTOS_demo/zephyr/soc/st/stm32/stm32l4x/soc/st/stm32/stm32l4x/Kconfig.defconfig.stm32l432xx"
rsource "/home/ljd/wsMA_prototyp/ZRTOS_demo/zephyr/soc/st/stm32/stm32l4x/soc/st/stm32/stm32l4x/Kconfig.defconfig.stm32l433xx"
rsource "/home/ljd/wsMA_prototyp/ZRTOS_demo/zephyr/soc/st/stm32/stm32l4x/soc/st/stm32/stm32l4x/Kconfig.defconfig.stm32l451xx"
rsource "/home/ljd/wsMA_prototyp/ZRTOS_demo/zephyr/soc/st/stm32/stm32l4x/soc/st/stm32/stm32l4x/Kconfig.defconfig.stm32l452xx"
rsource "/home/ljd/wsMA_prototyp/ZRTOS_demo/zephyr/soc/st/stm32/stm32l4x/soc/st/stm32/stm32l4x/Kconfig.defconfig.stm32l462xx"
rsource "/home/ljd/wsMA_prototyp/ZRTOS_demo/zephyr/soc/st/stm32/stm32l4x/soc/st/stm32/stm32l4x/Kconfig.defconfig.stm32l471xx"
rsource "/home/ljd/wsMA_prototyp/ZRTOS_demo/zephyr/soc/st/stm32/stm32l4x/soc/st/stm32/stm32l4x/Kconfig.defconfig.stm32l475xx"
rsource "/home/ljd/wsMA_prototyp/ZRTOS_demo/zephyr/soc/st/stm32/stm32l4x/soc/st/stm32/stm32l4x/Kconfig.defconfig.stm32l476xx"
rsource "/home/ljd/wsMA_prototyp/ZRTOS_demo/zephyr/soc/st/stm32/stm32l4x/soc/st/stm32/stm32l4x/Kconfig.defconfig.stm32l486xx"
rsource "/home/ljd/wsMA_prototyp/ZRTOS_demo/zephyr/soc/st/stm32/stm32l4x/soc/st/stm32/stm32l4x/Kconfig.defconfig.stm32l496xx"
rsource "/home/ljd/wsMA_prototyp/ZRTOS_demo/zephyr/soc/st/stm32/stm32l4x/soc/st/stm32/stm32l4x/Kconfig.defconfig.stm32l4a6xx"
rsource "/home/ljd/wsMA_prototyp/ZRTOS_demo/zephyr/soc/st/stm32/stm32l4x/soc/st/stm32/stm32l4x/Kconfig.defconfig.stm32l4p5xx"
rsource "/home/ljd/wsMA_prototyp/ZRTOS_demo/zephyr/soc/st/stm32/stm32l4x/soc/st/stm32/stm32l4x/Kconfig.defconfig.stm32l4q5xx"
rsource "/home/ljd/wsMA_prototyp/ZRTOS_demo/zephyr/soc/st/stm32/stm32l4x/soc/st/stm32/stm32l4x/Kconfig.defconfig.stm32l4r5xx"
rsource "/home/ljd/wsMA_prototyp/ZRTOS_demo/zephyr/soc/st/stm32/stm32l4x/soc/st/stm32/stm32l4x/Kconfig.defconfig.stm32l4r9xx"
rsource "/home/ljd/wsMA_prototyp/ZRTOS_demo/zephyr/soc/st/stm32/stm32l4x/soc/st/stm32/stm32l4x/Kconfig.defconfig.stm32l4s5xx"

endif # SOC_SERIES_STM32L4X
```

## transform_projects/transform_zrtos/old/ZRTOS_copy/soc/st/stm32/stm32mp1x/Kconfig.defconfig
```kconfig
# STMicroelectronics STM32MP1 MCU/MPU line

# Copyright (c) 2019 STMicroelectronics
# SPDX-License-Identifier: Apache-2.0

if SOC_SERIES_STM32MP1X

rsource "/home/ljd/wsMA_prototyp/ZRTOS_demo/zephyr/soc/st/stm32/stm32mp1x/soc/st/stm32/stm32mp1x/Kconfig.defconfig.stm32mp15_m4"

endif # SOC_SERIES_STM32MP1X
```

## transform_projects/transform_zrtos/old/ZRTOS_copy/soc/telink/tlsr/Kconfig
```kconfig
# Copyright (c) 2024 Nordic Semiconductor ASA
# SPDX-License-Identifier: Apache-2.0

if SOC_FAMILY_TELINK_TLSR

rsource "/home/ljd/wsMA_prototyp/ZRTOS_demo/zephyr/soc/telink/tlsr/soc/telink/tlsr/tlsr951x/Kconfig"

endif # SOC_FAMILY_TELINK_TLSR
```

## transform_projects/transform_zrtos/old/ZRTOS_copy/soc/ti/simplelink/msp432p4xx/Kconfig.defconfig
```kconfig
# TI SimpleLink MSP432P4XX
# Copyright (c) 2017, Linaro Ltd
# SPDX-License-Identifier: Apache-2.0

if SOC_SERIES_MSP432P4XX

rsource "/home/ljd/wsMA_prototyp/ZRTOS_demo/zephyr/soc/ti/simplelink/msp432p4xx/soc/ti/simplelink/msp432p4xx/Kconfig.defconfig.msp432p401r"

endif # SOC_SERIES_MSP432P4XX
```

## transform_projects/transform_zrtos/old/ZRTOS_copy/subsys/logging/backends/Kconfig
```kconfig
# Copyright (c) 2021 Nordic Semiconductor ASA
# SPDX-License-Identifier: Apache-2.0

menu "Backends"

rsource "/home/ljd/wsMA_prototyp/ZRTOS_demo/zephyr/subsys/logging/backends/subsys/logging/backends/Kconfig.adsp"
rsource "/home/ljd/wsMA_prototyp/ZRTOS_demo/zephyr/subsys/logging/backends/subsys/logging/backends/Kconfig.adsp_mtrace"
rsource "/home/ljd/wsMA_prototyp/ZRTOS_demo/zephyr/subsys/logging/backends/subsys/logging/backends/Kconfig.ble"
rsource "/home/ljd/wsMA_prototyp/ZRTOS_demo/zephyr/subsys/logging/backends/subsys/logging/backends/Kconfig.efi_console"
rsource "/home/ljd/wsMA_prototyp/ZRTOS_demo/zephyr/subsys/logging/backends/subsys/logging/backends/Kconfig.fs"
rsource "/home/ljd/wsMA_prototyp/ZRTOS_demo/zephyr/subsys/logging/backends/subsys/logging/backends/Kconfig.mqtt"
rsource "/home/ljd/wsMA_prototyp/ZRTOS_demo/zephyr/subsys/logging/backends/subsys/logging/backends/Kconfig.native_posix"
rsource "/home/ljd/wsMA_prototyp/ZRTOS_demo/zephyr/subsys/logging/backends/subsys/logging/backends/Kconfig.net"
rsource "/home/ljd/wsMA_prototyp/ZRTOS_demo/zephyr/subsys/logging/backends/subsys/logging/backends/Kconfig.ws"
rsource "/home/ljd/wsMA_prototyp/ZRTOS_demo/zephyr/subsys/logging/backends/subsys/logging/backends/Kconfig.rtt"
rsource "/home/ljd/wsMA_prototyp/ZRTOS_demo/zephyr/subsys/logging/backends/subsys/logging/backends/Kconfig.spinel"
rsource "/home/ljd/wsMA_prototyp/ZRTOS_demo/zephyr/subsys/logging/backends/subsys/logging/backends/Kconfig.swo"
rsource "/home/ljd/wsMA_prototyp/ZRTOS_demo/zephyr/subsys/logging/backends/subsys/logging/backends/Kconfig.uart"
rsource "/home/ljd/wsMA_prototyp/ZRTOS_demo/zephyr/subsys/logging/backends/subsys/logging/backends/Kconfig.xtensa_sim"
rsource "/home/ljd/wsMA_prototyp/ZRTOS_demo/zephyr/subsys/logging/backends/subsys/logging/backends/Kconfig.multidomain"
rsource "/home/ljd/wsMA_prototyp/ZRTOS_demo/zephyr/subsys/logging/backends/subsys/logging/backends/Kconfig.semihost"

endmenu
```
