## transform_projects/transform_riot/RIOT_output/examples/basic/hello-world/bin/native64/generated/Kconfig.dep
```kconfig
config USEMODULE_AUTO_INIT
	bool
	default y
config USEMODULE_BOARD
	bool
	default y
config USEMODULE_BOARD_COMMON_INIT
	bool
	default y
config USEMODULE_BOARDS_COMMON_NATIVE
	bool
	default y
config USEMODULE_CORE
	bool
	default y
config USEMODULE_CORE_IDLE_THREAD
	bool
	default y
config USEMODULE_CORE_INIT
	bool
	default y
config USEMODULE_CORE_LIB
	bool
	default y
config USEMODULE_CORE_MSG
	bool
	default y
config USEMODULE_CORE_PANIC
	bool
	default y
config USEMODULE_CORE_THREAD
	bool
	default y
config USEMODULE_CPU
	bool
	default y
config USEMODULE_FDCAN
	bool
	default y
config USEMODULE_LIBC
	bool
	default y
config USEMODULE_NATIVE_DRIVERS
	bool
	default y
config USEMODULE_PERIPH
	bool
	default y
config USEMODULE_PERIPH_COMMON
	bool
	default y
config USEMODULE_PERIPH_GPIO
	bool
	default y
config USEMODULE_PERIPH_GPIO_LINUX
	bool
	default y
config USEMODULE_PERIPH_INIT
	bool
	default y
config USEMODULE_PERIPH_INIT_BUTTONS
	bool
	default y
config USEMODULE_PERIPH_INIT_GPIO
	bool
	default y
config USEMODULE_PERIPH_INIT_GPIO_LINUX
	bool
	default y
config USEMODULE_PERIPH_INIT_LED0
	bool
	default y
config USEMODULE_PERIPH_INIT_LED1
	bool
	default y
config USEMODULE_PERIPH_INIT_LED2
	bool
	default y
config USEMODULE_PERIPH_INIT_LED3
	bool
	default y
config USEMODULE_PERIPH_INIT_LED4
	bool
	default y
config USEMODULE_PERIPH_INIT_LED5
	bool
	default y
config USEMODULE_PERIPH_INIT_LED6
	bool
	default y
config USEMODULE_PERIPH_INIT_LED7
	bool
	default y
config USEMODULE_PERIPH_INIT_LEDS
	bool
	default y
config USEMODULE_PERIPH_INIT_PM
	bool
	default y
config USEMODULE_PERIPH_INIT_UART
	bool
	default y
config USEMODULE_PERIPH_PM
	bool
	default y
config USEMODULE_PERIPH_UART
	bool
	default y
config USEMODULE_PREPROCESSOR
	bool
	default y
config USEMODULE_PREPROCESSOR_SUCCESSOR
	bool
	default y
config USEMODULE_STDIO
	bool
	default y
config USEMODULE_STDIO_DEFAULT
	bool
	default y
config USEMODULE_STDIO_NATIVE
	bool
	default y
config USEMODULE_SYS
	bool
	default y
```

## transform_projects/transform_rt_thread/RT_Thread_output/Kconfig
```kconfig
source "../../src/Kconfig"
source "../../libcpu/Kconfig"
source "../../components/Kconfig"
source "../../Kconfig.utestcases"
```

## transform_projects/transform_rt_thread/RT_Thread_output/Kconfig.utestcases
```kconfig
menu "RT-Thread Utestcases"

    config RT_USING_UTESTCASES
        bool "RT-Thread Utestcases"
        default n
        select RT_USING_UTEST
        select RT_USING_DEBUG if !RT_USING_ULOG

    if RT_USING_UTESTCASES

        source "../../src/utest/Kconfig"

        menu "Kernel Components"

            menu "Drivers"
                source "../../components/drivers/core/utest/Kconfig"
                source "../../components/drivers/audio/utest/Kconfig"
                source "../../components/drivers/ipc/utest/Kconfig"
                source "../../components/drivers/serial/utest/Kconfig"
                source "../../components/drivers/smp_call/utest/Kconfig"
            endmenu

            source "../../components/dfs/utest/Kconfig"
            source "../../components/libc/cplusplus/utest/Kconfig"
            source "../../components/net/utest/Kconfig"
            source "../../components/utilities/utest/utest/Kconfig"

        endmenu

        source "../../examples/utest/testcases/mm/Kconfig"
        source "../../examples/utest/testcases/tmpfs/Kconfig"

endif

endmenu
```

## transform_projects/transform_rt_thread/RT_Thread_output/components/Kconfig
```kconfig
menu "RT-Thread Components"

config RT_USING_COMPONENTS_INIT
    bool
    default n

config RT_USING_USER_MAIN
    bool
    default n

    if RT_USING_USER_MAIN
        config RT_MAIN_THREAD_STACK_SIZE
            int "Set main thread stack size"
            default 6144 if ARCH_CPU_64BIT
            default 2048

        config RT_MAIN_THREAD_PRIORITY
            int "Set main thread priority"
            default 4   if RT_THREAD_PRIORITY_8
            default 10  if RT_THREAD_PRIORITY_32
            default 85  if RT_THREAD_PRIORITY_256
    endif

config RT_USING_LEGACY
    bool "Support legacy version for compatibility"
    default n

if RT_USING_CONSOLE
source "../../components/finsh/Kconfig"
endif

if !RT_USING_NANO
source "../../components/dfs/Kconfig"
source "../../components/fal/Kconfig"
source "../../components/drivers/Kconfig"
source "../../components/libc/Kconfig"
source "../../components/net/Kconfig"
source "../../components/mprotect/Kconfig"
source "../../components/utilities/Kconfig"
endif

if ARCH_MM_MMU
source "../../components/mm/Kconfig"
endif

if RT_USING_SMART
source "../../components/lwp/Kconfig"
endif

source "../../components/rust/Kconfig"
endmenu
```

## transform_projects/transform_rt_thread/RT_Thread_output/components/drivers/Kconfig
```kconfig
menu "Device Drivers"

source "../../components/drivers/core/Kconfig"
source "../../components/drivers/ipc/Kconfig"

source "../../components/drivers/serial/Kconfig"
source "../../components/drivers/can/Kconfig"
source "../../components/drivers/cputime/Kconfig"
source "../../components/drivers/i2c/Kconfig"
source "../../components/drivers/phy/Kconfig"
source "../../components/drivers/misc/Kconfig"
source "../../components/drivers/mtd/Kconfig"
source "../../components/drivers/pm/Kconfig"
source "../../components/drivers/rtc/Kconfig"
source "../../components/drivers/sdio/Kconfig"
source "../../components/drivers/spi/Kconfig"
source "../../components/drivers/watchdog/Kconfig"
source "../../components/drivers/audio/Kconfig"
source "../../components/drivers/sensor/Kconfig"
source "../../components/drivers/touch/Kconfig"
source "../../components/drivers/graphic/Kconfig"
source "../../components/drivers/hwcrypto/Kconfig"
source "../../components/drivers/wlan/Kconfig"
source "../../components/drivers/led/Kconfig"
source "../../components/drivers/input/Kconfig"
source "../../components/drivers/mailbox/Kconfig"
source "../../components/drivers/hwspinlock/Kconfig"
source "../../components/drivers/phye/Kconfig"
source "../../components/drivers/ata/Kconfig"
source "../../components/drivers/nvme/Kconfig"
source "../../components/drivers/block/Kconfig"
source "../../components/drivers/scsi/Kconfig"
source "../../components/drivers/firmware/Kconfig"
source "../../components/drivers/hwcache/Kconfig"
source "../../components/drivers/regulator/Kconfig"
source "../../components/drivers/reset/Kconfig"
source "../../components/drivers/pmdomain/Kconfig"
source "../../components/drivers/thermal/Kconfig"
source "../../components/drivers/virtio/Kconfig"
source "../../components/drivers/nvmem/Kconfig"
source "../../components/drivers/dma/Kconfig"
source "../../components/drivers/mfd/Kconfig"
source "../../components/drivers/ofw/Kconfig"
source "../../components/drivers/pci/Kconfig"
source "../../components/drivers/pic/Kconfig"
source "../../components/drivers/pin/Kconfig"
source "../../components/drivers/pinctrl/Kconfig"
source "../../components/drivers/ktime/Kconfig"
source "../../components/drivers/clk/Kconfig"
source "../../components/drivers/hwtimer/Kconfig"

endmenu
```

## transform_projects/transform_rt_thread/RT_Thread_output/components/drivers/block/Kconfig
```kconfig
menuconfig RT_USING_BLK
    bool "Using Block device drivers"
    default n

if RT_USING_BLK
    source "../../components/drivers/block/partitions/Kconfig"
endif
```

## transform_projects/transform_rt_thread/RT_Thread_output/components/drivers/firmware/Kconfig
```kconfig
menuconfig RT_USING_FIRMWARE
    bool "Using Firmware"
    depends on RT_USING_DM
    default n

if RT_USING_FIRMWARE
    source "../../components/drivers/firmware/arm_scmi/Kconfig"
endif
```

## transform_projects/transform_rt_thread/RT_Thread_output/components/drivers/graphic/Kconfig
```kconfig
config RT_USING_LCD
    bool "Using LCD graphic drivers" if !RT_USING_DM
    default n

menuconfig RT_USING_GRAPHIC
    bool "Using Graphics device drivers"
    depends on RT_USING_DM
    default n

if RT_USING_GRAPHIC
    source "../../components/drivers/graphic/backlight/Kconfig"
    source "../../components/drivers/graphic/framebuffer/Kconfig"
    source "../../components/drivers/graphic/logo/Kconfig"
endif
```

## transform_projects/transform_rt_thread/RT_Thread_output/components/drivers/input/joystick/Kconfig
```kconfig
menuconfig RT_INPUT_JOYSTICK
    bool "Joystick"
    default n

if RT_INPUT_JOYSTICK
endif
```

## transform_projects/transform_rt_thread/RT_Thread_output/components/drivers/input/touchscreen/Kconfig
```kconfig
menuconfig RT_INPUT_TOUCHSCREEN
    bool "Touchscreens"
    select RT_USING_TOUCH
    default n

if RT_INPUT_TOUCHSCREEN
endif
```

## transform_projects/transform_rt_thread/RT_Thread_output/components/drivers/mfd/Kconfig
```kconfig
menuconfig RT_USING_MFD
    bool "Using Multifunction device drivers (MFD)"
    depends on RT_USING_DM
    default n

config RT_MFD_EDU
    bool "Educational device driver"
    depends on RT_USING_MFD
    depends on RT_USING_PCI
    depends on RT_USING_DMA
    default n

config RT_MFD_SYSCON
    bool "System Controller Register R/W"
    depends on RT_USING_MFD
    depends on RT_USING_OFW
    default y

if RT_USING_MFD
endif
```

## transform_projects/transform_rt_thread/RT_Thread_output/components/drivers/nvmem/Kconfig
```kconfig
menuconfig RT_USING_NVMEM
    bool "Using Non Volatile Memory (NVMEM) device drivers"
    depends on RT_USING_DM
    depends on RT_USING_OFW
    depends on RT_USING_PIN
    select RT_USING_ADT
    select RT_USING_ADT_REF
    default n

if RT_USING_NVMEM
endif
```
