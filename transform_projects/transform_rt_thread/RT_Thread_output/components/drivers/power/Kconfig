## transform_projects/transform_rt_thread/RT_Thread_output/components/drivers/power/Kconfig
```kconfig
source "../../components/drivers/power/reset/Kconfig"
source "../../components/drivers/power/supply/Kconfig"
```

## transform_projects/transform_rt_thread/RT_Thread_output/components/drivers/serial/device/Kconfig
```kconfig
config RT_SERIAL_EARLY_HVC
    bool "Early HVC"
    default n

config RT_SERIAL_PL011
    bool "ARM PL011"
    default n

source "../../components/drivers/serial/device/8250/Kconfig"
source "../../components/drivers/serial/device/virtual/Kconfig"
```

## transform_projects/transform_rt_thread/RT_Thread_output/components/legacy/Kconfig
```kconfig
source "../../components/legacy/usb/Kconfig"
source "../../components/legacy/fdt/Kconfig"
```

## transform_projects/transform_rt_thread/RT_Thread_output/components/net/Kconfig
```kconfig
menu "Network"

source "../../components/net/sal/Kconfig"
source "../../components/net/netdev/Kconfig"
source "../../components/net/lwip/Kconfig"
source "../../components/net/at/Kconfig"

endmenu
```

## transform_projects/transform_zrtos/ZRTOS_copy/arch/riscv/custom/Kconfig
```kconfig
# Copyright (c) 2025 Andes Technology Corporation
# SPDX-License-Identifier: Apache-2.0

if DT_HAS_ANDESTECH_ANDESCORE_V5_ENABLED

rsource "/home/ljd/wsMA_prototyp/ZRTOS_demo/zephyr/arch/riscv/custom/arch/riscv/custom/andes/Kconfig"

endif # DT_HAS_ANDESTECH_ANDESCORE_V5_ENABLED

if DT_HAS_SPINALHDL_VEXRISCV_ENABLED

rsource "/home/ljd/wsMA_prototyp/ZRTOS_demo/zephyr/arch/riscv/custom/arch/riscv/custom/vexriscv/Kconfig"

endif # DT_HAS_SPINALHDL_VEXRISCV_ENABLED

if DT_HAS_XUANTIE_E907_ENABLED

rsource "/home/ljd/wsMA_prototyp/ZRTOS_demo/zephyr/arch/riscv/custom/arch/riscv/custom/thead/Kconfig"
rsource "/home/ljd/wsMA_prototyp/ZRTOS_demo/zephyr/arch/riscv/custom/arch/riscv/custom/thead/Kconfig.core"

endif # DT_HAS_XUANTIE_E907_ENABLED
```
