## transform_projects/transform_zrtos/ZRTOS_copy/boards/shields/adafruit_aht20/Kconfig.shield
```kconfig
# Copyright (c) 2025 Jonas Berg
# SPDX-License-Identifier: Apache-2.0

config SHIELD_ADAFRUIT_AHT20
 bool
 default $(shields_list_contains,adafruit_aht20)
```

## transform_projects/transform_zrtos/ZRTOS_copy/boards/shields/adafruit_tsl2591/Kconfig.shield
```kconfig
# Copyright (c) 2025 Jonas Berg
# SPDX-License-Identifier: Apache-2.0

config SHIELD_ADAFRUIT_TSL2591
 bool
 default $(shields_list_contains,adafruit_tsl2591)
```

## transform_projects/transform_zrtos/ZRTOS_copy/boards/shields/adafruit_vcnl4040/Kconfig.shield
```kconfig
# Copyright (c) 2025 Jonas Berg
# SPDX-License-Identifier: Apache-2.0

config SHIELD_ADAFRUIT_VCNL4040
 bool
 default $(shields_list_contains,adafruit_vcnl4040)
```

## transform_projects/transform_zrtos/ZRTOS_copy/boards/shields/arducam_cu450_ov5640/Kconfig.shield
```kconfig
# Copyright (c) 2025 Renesas Electronics Corporation
# SPDX-License-Identifier: Apache-2.0

config SHIELD_ARDUCAM_CU450_OV5640_DVP
 bool
 default $(shields_list_contains,arducam_cu450_ov5640_dvp)
```

## transform_projects/transform_zrtos/ZRTOS_copy/boards/shields/atmel_rf2xx/Kconfig.shield
```kconfig
# Copyright (c) 2020 Gerson Fernando Budke <nandojve@gmail.com>
# SPDX-License-Identifier: Apache-2.0

config SHIELD_ATMEL_RF2XX
 bool
 default $(shields_list_contains,atmel_rf2xx)

config SHIELD_ATMEL_RF2XX_ARDUINO
 bool
 default $(shields_list_contains,atmel_rf2xx_arduino)

config SHIELD_ATMEL_RF2XX_MIKROBUS
 bool
 default $(shields_list_contains,atmel_rf2xx_mikrobus)

config SHIELD_ATMEL_RF2XX_XPRO
 bool
 default $(shields_list_contains,atmel_rf2xx_xpro)

config SHIELD_ATMEL_RF2XX_LEGACY
 bool
 default $(shields_list_contains,atmel_rf2xx_legacy)

config SHIELD_ATMEL_RF2XX_XPLAINED
 bool
 default $(shields_list_contains,atmel_rf2xx_xplained)
```

## transform_projects/transform_zrtos/ZRTOS_copy/boards/shields/boostxl_ulpsense/Kconfig.shield
```kconfig
# Copyright (c) 2021 Nordic Semiconductor ASA
# SPDX-License-Identifier: Apache-2.0

config SHIELD_BOOSTXL_ULPSENSE
 bool
 default $(shields_list_contains,boostxl_ulpsense)
```

## transform_projects/transform_zrtos/ZRTOS_copy/boards/shields/buydisplay_2_8_tft_touch_arduino/Kconfig.shield
```kconfig
# Copyright (c) 2020 Teslabs Engineering S.L.
# SPDX-License-Identifier: Apache-2.0

config SHIELD_BUYDISPLAY_2_8_TFT_TOUCH_ARDUINO
 bool
 default $(shields_list_contains,buydisplay_2_8_tft_touch_arduino)
```

## transform_projects/transform_zrtos/ZRTOS_copy/boards/shields/frdm_stbc_agm01/Kconfig.shield
```kconfig
# Copyright (c) 2021 Ryan Holleran
# SPDX-License-Identifier: Apache-2.0

config SHIELD_FRDM_STBC_AGM01
 bool
 default $(shields_list_contains,frdm_stbc_agm01)
```

## transform_projects/transform_zrtos/ZRTOS_copy/boards/shields/inventek_eswifi/Kconfig.defconfig
```kconfig
# Copyright (c) 2020 ATL Electronics
# SPDX-License-Identifier: Apache-2.0

if SHIELD_INVENTEK_ESWIFI || \
	SHIELD_INVENTEK_ESWIFI_ARDUINO_SPI || \
	SHIELD_INVENTEK_ESWIFI_ARDUINO_UART

if NETWORKING

orsource "/home/ljd/wsMA_prototyp/ZRTOS_demo/zephyr/boards/shields/inventek_eswifi/boards/shields/inventek_eswifi/boards/frdm_k64f.defconfig"
orsource "/home/ljd/wsMA_prototyp/ZRTOS_demo/zephyr/boards/shields/inventek_eswifi/boards/shields/inventek_eswifi/boards/nucleo_f767zi.defconfig"

choice WIFI_ESWIFI_BUS
	default WIFI_ESWIFI_BUS_SPI if SHIELD_INVENTEK_ESWIFI_ARDUINO_SPI
	default WIFI_ESWIFI_BUS_UART if SHIELD_INVENTEK_ESWIFI_ARDUINO_UART
	depends on WIFI_ESWIFI
endchoice

endif	# NETWORKING

endif	# SHIELD_INVENTEK_ESWIFI || \
	# SHIELD_INVENTEK_ESWIFI_ARDUINO_SPI || \
	# SHIELD_INVENTEK_ESWIFI_ARDUINO_UART
```

## transform_projects/transform_zrtos/ZRTOS_copy/boards/shields/max7219/Kconfig.shield
```kconfig
# Copyright (c) 2022 Jimmy Ou <yanagiis@gmail.com>
# SPDX-License-Identifier: Apache-2.0

config SHIELD_MAX7219_8X8
 bool
 default $(shields_list_contains,max7219_8x8)
```

## transform_projects/transform_zrtos/ZRTOS_copy/boards/shields/mikroe_3d_hall_3_click/Kconfig.shield
```kconfig
# Copyright The Zephyr Project Contributors
# SPDX-License-Identifier: Apache-2.0

config SHIELD_MIKROE_3D_HALL_3_CLICK
 bool
 default $(shields_list_contains,mikroe_3d_hall_3_click)
```

## transform_projects/transform_zrtos/ZRTOS_copy/boards/shields/mikroe_accel13_click/Kconfig.shield
```kconfig
# Copyright (c) 2023 Mark Olsson <mark@markolsson.se>
# SPDX-License-Identifier: Apache-2.0

config SHIELD_MIKROE_ACCEL13_CLICK
 bool
 default $(shields_list_contains,mikroe_accel13_click)
```

## transform_projects/transform_zrtos/ZRTOS_copy/boards/shields/mikroe_ambient_2_click/Kconfig.shield
```kconfig
# Copyright The Zephyr Project Contributors
# SPDX-License-Identifier: Apache-2.0

config SHIELD_MIKROE_AMBIENT_2_CLICK
 bool
 default $(shields_list_contains,mikroe_ambient_2_click)
```

## transform_projects/transform_zrtos/ZRTOS_copy/boards/shields/mikroe_illuminance_click/Kconfig.shield
```kconfig
# Copyright The Zephyr Project Contributors
# SPDX-License-Identifier: Apache-2.0

config SHIELD_MIKROE_ILLUMINANCE_CLICK
 bool
 default $(shields_list_contains,mikroe_illuminance_click)
```

## transform_projects/transform_zrtos/ZRTOS_copy/boards/shields/mikroe_lte_iot10_click/Kconfig.shield
```kconfig
# Copyright (c) 2025 Benjamin Cabé <benjamin@zephyrproject.org>
# SPDX-License-Identifier: Apache-2.0

config SHIELD_MIKROE_LTE_IOT10_CLICK
 bool
 default $(shields_list_contains,mikroe_lte_iot10_click)
```

## transform_projects/transform_zrtos/ZRTOS_copy/boards/shields/mikroe_proximity_9_click/Kconfig.shield
```kconfig
# Copyright The Zephyr Project Contributors
# SPDX-License-Identifier: Apache-2.0

config SHIELD_MIKROE_PROXIMITY_9_CLICK
 bool
 default $(shields_list_contains,mikroe_proximity_9_click)
```
