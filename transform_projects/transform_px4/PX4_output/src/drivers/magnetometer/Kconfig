## transform_projects/transform_px4/PX4_output/src/drivers/magnetometer/Kconfig
```kconfig
menu "Magnetometer"
    menuconfig COMMON_MAGNETOMETER
        bool "Common Magnetometer's"
        default n
        select DRIVERS_MAGNETOMETER_AKM_AK8963
        select DRIVERS_MAGNETOMETER_AKM_AK09916
        select DRIVERS_MAGNETOMETER_BOSCH_BMM150
        select DRIVERS_MAGNETOMETER_BOSCH_BMM350
        select DRIVERS_MAGNETOMETER_HMC5883
        select DRIVERS_MAGNETOMETER_QMC5883L
        select DRIVERS_MAGNETOMETER_QMC5883P
        select DRIVERS_MAGNETOMETER_ISENTEK_IST8308
        select DRIVERS_MAGNETOMETER_ISENTEK_IST8310
        select DRIVERS_MAGNETOMETER_LIS3MDL
        select DRIVERS_MAGNETOMETER_LSM303AGR
        select DRIVERS_MAGNETOMETER_RM3100
        select DRIVERS_MAGNETOMETER_MEMSIC_MMC5983MA
        select DRIVERS_MAGNETOMETER_ST_IIS2MDC
        help
            Enable default set of magnetometer drivers
    source "src/drivers/magnetometer/akm/Kconfig"
    source "src/drivers/magnetometer/bosch/Kconfig"
    source "src/drivers/magnetometer/hmc5883/Kconfig"
    source "src/drivers/magnetometer/isentek/Kconfig"
    source "src/drivers/magnetometer/lis3mdl/Kconfig"
    source "src/drivers/magnetometer/lsm303agr/Kconfig"
    source "src/drivers/magnetometer/lsm9ds1_mag/Kconfig"
    source "src/drivers/magnetometer/memsic/Kconfig"
    source "src/drivers/magnetometer/qmc5883l/Kconfig"
    source "src/drivers/magnetometer/qmc5883p/Kconfig"
    source "src/drivers/magnetometer/rm3100/Kconfig"
    source "src/drivers/magnetometer/st/Kconfig"
    source "src/drivers/magnetometer/vtrantech/Kconfig"
endmenu
```

## transform_projects/transform_px4/PX4_output/src/drivers/magnetometer/akm/Kconfig
```kconfig
menu "AKM"
    source "src/drivers/magnetometer/akm/ak09916/Kconfig"
    source "src/drivers/magnetometer/akm/ak8963/Kconfig"
endmenu
```

## transform_projects/transform_px4/PX4_output/src/drivers/magnetometer/bosch/Kconfig
```kconfig
menu "Bosch"
    source "src/drivers/magnetometer/bosch/bmm150/Kconfig"
    source "src/drivers/magnetometer/bosch/bmm350/Kconfig"
endmenu
```

## transform_projects/transform_px4/PX4_output/src/drivers/magnetometer/isentek/Kconfig
```kconfig
menu "Isentek"
source "src/drivers/magnetometer/isentek/ist8308/Kconfig"
source "src/drivers/magnetometer/isentek/ist8310/Kconfig"
endmenu #Isentek
```

## transform_projects/transform_px4/PX4_output/src/drivers/magnetometer/memsic/Kconfig
```kconfig
menu "Memsic"
    source "src/drivers/magnetometer/memsic/mmc5983ma/Kconfig"
endmenu
```

## transform_projects/transform_px4/PX4_output/src/drivers/magnetometer/vtrantech/Kconfig
```kconfig
menu "Vtrantech"
source "src/drivers/magnetometer/vtrantech/vcm1193l/Kconfig"
endmenu #Vtrantech
```

## transform_projects/transform_px4/PX4_output/src/drivers/optical_flow/Kconfig
```kconfig
menu "Optical flow"
    menuconfig COMMON_OPTICAL_FLOW
        bool "Common Optical flow"
        default n
        select DRIVERS_OPTICAL_FLOW_PAA3905
        select DRIVERS_OPTICAL_FLOW_PAW3902
        select DRIVERS_OPTICAL_FLOW_PMW3901
        select DRIVERS_OPTICAL_FLOW_PX4FLOW
        select DRIVERS_OPTICAL_FLOW_THONEFLOW
        ---help---
            Enable default set of optical flow drivers
    source "src/drivers/optical_flow/paa3905/Kconfig"
    source "src/drivers/optical_flow/paw3902/Kconfig"
    source "src/drivers/optical_flow/pmw3901/Kconfig"
    source "src/drivers/optical_flow/px4flow/Kconfig"
    source "src/drivers/optical_flow/thoneflow/Kconfig"
endmenu
```

## transform_projects/transform_px4/PX4_output/src/drivers/power_monitor/Kconfig
```kconfig
menu "Power monitor"
source "src/drivers/power_monitor/ina220/Kconfig"
source "src/drivers/power_monitor/ina226/Kconfig"
source "src/drivers/power_monitor/ina228/Kconfig"
source "src/drivers/power_monitor/ina238/Kconfig"
source "src/drivers/power_monitor/pm_selector_auterion/Kconfig"
source "src/drivers/power_monitor/voxlpm/Kconfig"
endmenu
```

## transform_projects/transform_px4/PX4_output/src/drivers/qshell/Kconfig
```kconfig
menu "qshell"
depends on PLATFORM_QURT || PLATFORM_POSIX
source "src/drivers/qshell/posix/Kconfig"
source "src/drivers/qshell/qurt/Kconfig"
endmenu #qshell
```

## transform_projects/transform_px4/PX4_output/src/drivers/rc/Kconfig
```kconfig
menu "RC"
    menuconfig COMMON_RC
        bool "Common RC"
        default n
        select DRIVERS_RC_CRSF_RC
        select DRIVERS_RC_DSM_RC
        select DRIVERS_RC_GHST_RC
        select DRIVERS_RC_SBUS_RC
        help
            Enable default set of radio control drivers
    source "src/drivers/rc/crsf_rc/Kconfig"
    source "src/drivers/rc/dsm_rc/Kconfig"
    source "src/drivers/rc/ghst_rc/Kconfig"
    source "src/drivers/rc/sbus_rc/Kconfig"
endmenu
```

## transform_projects/transform_px4/PX4_output/src/drivers/rpm/Kconfig
```kconfig
menu "RPM"
    menuconfig COMMON_RPM
        bool "Common RPM drivers"
        default n
        select DRIVERS_RPM_PCF8583
        select DRIVERS_RPM_RPM_SIMULATOR
        help
            Enable default set of RPM drivers
    source "src/drivers/rpm/pcf8583/Kconfig"
    source "src/drivers/rpm/rpm_simulator/Kconfig"
endmenu
```

## transform_projects/transform_px4/PX4_output/src/drivers/smart_battery/Kconfig
```kconfig
menu "Smart battery"
source "src/drivers/smart_battery/batmon/Kconfig"
endmenu #Smart battery
```

## transform_projects/transform_px4/PX4_output/src/drivers/telemetry/Kconfig
```kconfig
menu "Telemetry"
    menuconfig COMMON_TELEMETRY
        bool "Common telemetry module's"
        default n
        select DRIVERS_TELEMETRY_BST
        select DRIVERS_TELEMETRY_FRSKY_TELEMETRY
        select DRIVERS_TELEMETRY_HOTT
        ---help---
            Enable default set of telemetry drivers
    source "src/drivers/telemetry/bst/Kconfig"
    source "src/drivers/telemetry/frsky_telemetry/Kconfig"
    source "src/drivers/telemetry/hott/Kconfig"
    source "src/drivers/telemetry/iridiumsbd/Kconfig"
endmenu
```

## transform_projects/transform_px4/PX4_output/src/drivers/temperature_sensor/Kconfig
```kconfig
menu "TEMPERATURE_SENSOR"
source "src/drivers/temperature_sensor/mcp9808/Kconfig"
endmenu #TEMPERATURE_SENSOR
```

## transform_projects/transform_px4/PX4_output/src/drivers/transponder/Kconfig
```kconfig
menu "Transponder"
    menuconfig TRANSPONDER
        bool "Transponder"
        default n
        select DRIVERS_TRANSPONDER_SAGETECH_MXS
        help
            Enable default set of transponder drivers

    source "src/drivers/transponder/sagetech_mxs/Kconfig"
endmenu #transponder
```

## transform_projects/transform_px4/PX4_output/src/drivers/uwb/Kconfig
```kconfig
menu "UWB"
    menuconfig COMMON_UWB
        bool "common UWB Drivers"
        default n
        select DRIVERS_UWB_UWB_SR150
        ---help---
            Enable support for uwb drivers
    source "src/drivers/uwb/uwb_sr150/Kconfig"
endmenu
```

## transform_projects/transform_px4/PX4_output/src/examples/Kconfig
```kconfig
source "src/examples/dyn_hello/Kconfig"
source "src/examples/fake_gps/Kconfig"
source "src/examples/fake_imu/Kconfig"
source "src/examples/fake_magnetometer/Kconfig"
source "src/examples/hello/Kconfig"
source "src/examples/matlab_csv_serial/Kconfig"
source "src/examples/px4_mavlink_debug/Kconfig"
source "src/examples/px4_simple_app/Kconfig"
source "src/examples/work_item/Kconfig"
```

## transform_projects/transform_px4/PX4_output/src/modules/Kconfig
```kconfig
source "src/modules/airship_att_control/Kconfig"
source "src/modules/airspeed_selector/Kconfig"
source "src/modules/attitude_estimator_q/Kconfig"
source "src/modules/battery_status/Kconfig"
source "src/modules/camera_feedback/Kconfig"
source "src/modules/commander/Kconfig"
source "src/modules/control_allocator/Kconfig"
source "src/modules/dataman/Kconfig"
source "src/modules/ekf2/Kconfig"
source "src/modules/esc_battery/Kconfig"
source "src/modules/events/Kconfig"
source "src/modules/flight_mode_manager/Kconfig"
source "src/modules/fw_att_control/Kconfig"
source "src/modules/fw_autotune_attitude_control/Kconfig"
source "src/modules/fw_lateral_longitudinal_control/Kconfig"
source "src/modules/fw_mode_manager/Kconfig"
source "src/modules/fw_rate_control/Kconfig"
source "src/modules/gimbal/Kconfig"
source "src/modules/gyro_calibration/Kconfig"
source "src/modules/gyro_fft/Kconfig"
source "src/modules/hardfault_stream/Kconfig"
source "src/modules/internal_combustion_engine_control/Kconfig"
source "src/modules/land_detector/Kconfig"
source "src/modules/landing_target_estimator/Kconfig"
source "src/modules/load_mon/Kconfig"
source "src/modules/local_position_estimator/Kconfig"
source "src/modules/logger/Kconfig"
source "src/modules/mag_bias_estimator/Kconfig"
source "src/modules/manual_control/Kconfig"
source "src/modules/mavlink/Kconfig"
source "src/modules/mc_att_control/Kconfig"
source "src/modules/mc_autotune_attitude_control/Kconfig"
source "src/modules/mc_hover_thrust_estimator/Kconfig"
source "src/modules/mc_nn_control/Kconfig"
source "src/modules/mc_pos_control/Kconfig"
source "src/modules/mc_rate_control/Kconfig"
source "src/modules/muorb/Kconfig"
source "src/modules/navigator/Kconfig"
source "src/modules/payload_deliverer/Kconfig"
source "src/modules/px4iofirmware/Kconfig"
source "src/modules/rc_update/Kconfig"
source "src/modules/replay/Kconfig"
source "src/modules/rover_ackermann/Kconfig"
source "src/modules/rover_differential/Kconfig"
source "src/modules/rover_mecanum/Kconfig"
source "src/modules/sensors/Kconfig"
source "src/modules/simulation/Kconfig"
source "src/modules/spacecraft/Kconfig"
source "src/modules/temperature_compensation/Kconfig"
source "src/modules/time_persistor/Kconfig"
source "src/modules/uuv_att_control/Kconfig"
source "src/modules/uuv_pos_control/Kconfig"
source "src/modules/uxrce_dds_client/Kconfig"
source "src/modules/vtol_att_control/Kconfig"
source "src/modules/zenoh/Kconfig"
```

## transform_projects/transform_px4/PX4_output/src/modules/muorb/Kconfig
```kconfig
menu "MUORB"
depends on PLATFORM_QURT || PLATFORM_POSIX
source "src/modules/muorb/apps/Kconfig"
source "src/modules/muorb/slpi/Kconfig"
endmenu #MUORB
```

## transform_projects/transform_px4/PX4_output/src/modules/simulation/Kconfig
```kconfig
menu "Simulation"
    menuconfig COMMON_SIMULATION
        bool "Common simulation modules"
        default n
        depends on PLATFORM_POSIX
        select MODULES_SIMULATION_BATTERY_SIMULATOR
        select MODULES_SIMULATION_PWM_OUT_SIM
        select MODULES_SIMULATION_SENSOR_AIRSPEED_SIM
        select MODULES_SIMULATION_SENSOR_BARO_SIM
        select MODULES_SIMULATION_SENSOR_GPS_SIM
        select MODULES_SIMULATION_SENSOR_MAG_SIM
        select MODULES_SIMULATION_SYSTEM_POWER_SIMULATOR
        select MODULES_SIMULATION_SIMULATOR_MAVLINK
        select MODULES_SIMULATION_SIMULATOR_SIH
        ---help---
            Enable default set of simulation modules
    source "src/modules/simulation/battery_simulator/Kconfig"
    source "src/modules/simulation/gz_bridge/Kconfig"
    source "src/modules/simulation/gz_msgs/Kconfig"
    source "src/modules/simulation/gz_plugins/Kconfig"
    source "src/modules/simulation/pwm_out_sim/Kconfig"
    source "src/modules/simulation/sensor_agp_sim/Kconfig"
    source "src/modules/simulation/sensor_airspeed_sim/Kconfig"
    source "src/modules/simulation/sensor_baro_sim/Kconfig"
    source "src/modules/simulation/sensor_gps_sim/Kconfig"
    source "src/modules/simulation/sensor_mag_sim/Kconfig"
    source "src/modules/simulation/simulator_mavlink/Kconfig"
    source "src/modules/simulation/simulator_sih/Kconfig"
    source "src/modules/simulation/system_power_simulator/Kconfig"
endmenu
```

## transform_projects/transform_px4/PX4_output/src/systemcmds/Kconfig
```kconfig
source "src/systemcmds/actuator_test/Kconfig"
source "src/systemcmds/bl_update/Kconfig"
source "src/systemcmds/bsondump/Kconfig"
source "src/systemcmds/dmesg/Kconfig"
source "src/systemcmds/dumpfile/Kconfig"
source "src/systemcmds/dyn/Kconfig"
source "src/systemcmds/failure/Kconfig"
source "src/systemcmds/gpio/Kconfig"
source "src/systemcmds/hardfault_log/Kconfig"
source "src/systemcmds/hist/Kconfig"
source "src/systemcmds/i2c_launcher/Kconfig"
source "src/systemcmds/i2cdetect/Kconfig"
source "src/systemcmds/io_bypass_control/Kconfig"
source "src/systemcmds/launch_kmod/Kconfig"
source "src/systemcmds/led_control/Kconfig"
source "src/systemcmds/mft/Kconfig"
source "src/systemcmds/mft_cfg/Kconfig"
source "src/systemcmds/microbench/Kconfig"
source "src/systemcmds/mtd/Kconfig"
source "src/systemcmds/netman/Kconfig"
source "src/systemcmds/nshterm/Kconfig"
source "src/systemcmds/param/Kconfig"
source "src/systemcmds/perf/Kconfig"
source "src/systemcmds/reboot/Kconfig"
source "src/systemcmds/reflect/Kconfig"
source "src/systemcmds/sd_bench/Kconfig"
source "src/systemcmds/sd_stress/Kconfig"
source "src/systemcmds/serial_passthru/Kconfig"
source "src/systemcmds/serial_test/Kconfig"
source "src/systemcmds/shutdown/Kconfig"
source "src/systemcmds/system_time/Kconfig"
source "src/systemcmds/tests/Kconfig"
source "src/systemcmds/top/Kconfig"
source "src/systemcmds/topic_listener/Kconfig"
source "src/systemcmds/tune_control/Kconfig"
source "src/systemcmds/uorb/Kconfig"
source "src/systemcmds/usb_connected/Kconfig"
source "src/systemcmds/ver/Kconfig"
source "src/systemcmds/work_queue/Kconfig"
```

## transform_projects/transform_riot/RIOT_output/drivers/Kconfig
```kconfig
# Copyright (c) 2020 HAW Hamburg
#
# This file is subject to the terms and conditions of the GNU Lesser
# General Public License v2.1. See the file LICENSE in the top level
# directory for more details.

menu "Drivers"

menu "Actuator Device Drivers"
source "drivers/dfplayer/Kconfig"
source "drivers/motor_driver/Kconfig"
endmenu # Actuator Device Drivers

menu "Display Device Drivers"
source "drivers/ili9341/Kconfig"
source "drivers/lcd/Kconfig"
source "drivers/touch_dev_gestures/Kconfig"
endmenu # Display Device Drivers

menu "Miscellaneous Device Drivers"
source "drivers/at/Kconfig"
endmenu # Miscellaneous Device Drivers

source "drivers/Kconfig.net"

menu "Peripherals drivers"
endmenu # Peripherals drivers

menu "Sensor Device Drivers"
source "drivers/ads1x1x/Kconfig"
source "drivers/bmx055/Kconfig"
source "drivers/fxos8700/Kconfig"
source "drivers/gp2y10xx/Kconfig"
source "drivers/hdc1000/Kconfig"
source "drivers/hm330x/Kconfig"
source "drivers/hsc/Kconfig"
source "drivers/isl29020/Kconfig"
source "drivers/l3g4200d/Kconfig"
source "drivers/l3gxxxx/Kconfig"
source "drivers/lm75/Kconfig"
source "drivers/lpsxxx/Kconfig"
source "drivers/mag3110/Kconfig"
source "drivers/matrix_keypad/Kconfig"
source "drivers/mma8x5x/Kconfig"
source "drivers/opt3001/Kconfig"
source "drivers/paa5100je/Kconfig"
source "drivers/seesaw_soil/Kconfig"
source "drivers/sht2x/Kconfig"
source "drivers/sm_pwm_01c/Kconfig"
source "drivers/sps30/Kconfig"
source "drivers/tcs37727/Kconfig"
source "drivers/tmp00x/Kconfig"
source "drivers/vl6180x/Kconfig"
endmenu # Sensor Device Drivers

menu "Storage Device Drivers"
source "drivers/mtd_sdcard/Kconfig"
endmenu # Storage Device Drivers

endmenu # Drivers
```
