## test_dir/experiment_dec_copy/uo2/Kconfig
```kconfig
source "uo1/Kconfig"
source "uo1/Kconfig1"
source "uo1/Kconfig2"
source "uo1/Kconfig3"
```

## test_dir_/0_refactor_test_output/Kconfig
```kconfig
# fixtures/a/Kconfig
config FOO
	bool "Foo"
	help
	  choices are listed below.
	  default settings are used.
	  config file location.

config BAR
	def_tristate y

config SQ
	bool 'Single quoted'

if FOO && !BAZ
	if BAR
config NESTED
	bool "Nested"
	depends on FOO
	endif
endif
```

## test_dir_/transform_choice/Kconfig
```kconfig
mainmenu "Test (named) choice"

config OPT_Y
  bool "depends on OPT_Yn"

choice NAMED_CH
  bool
  prompt "pick bool named choice"
  default CH_A 
  depends on OPT_Y
  depends on OPT_TTT
  optional
  config CH_A 
    bool "Op A"
  config CH_B
    bool "Op B"
  menuconfig MCH_Z
    bool "MCH_Z"
endchoice   

source "uo1/Kconfig"

choice 
  prompt "pick tristate choice"
  tristate  
  config CH_T1
    tristate "Op T1"
  config CH_T2
    tristate "Op T2"
endchoice  
```

## test_dir_/transform_choice/uo1/Kconfig
```kconfig
config OPT_AAA 
  bool "Op AAA"
  default y

config OPT_BBB
  bool "Op BBB"

config OPT_CCC
  bool "Op CCC"

config OPT_DDD
  bool "if DDD"

config OPT_EEE
  bool "Op EEE"

config OPT_ZZZ
  bool "if OPT_ZZZ"

if OPT_ZZZ
choice NAMED_CH
  bool "P1"
  help 
    Some awesome help text  
    that should be transformed 
  depends on OPT_AAA
  default CH_C if OPT_BBB

  if OPT_DDD
  config CH_C
    bool "Op C" 
  menuconfig MC1
    bool "M"
  endif

  menuconfig MC2
    bool "MC2"
  config CMC2
    bool "CMC2"
    depends on MC2
  config CMC3
    bool "CMC3"
    depends on MC2
endchoice 
endif

choice NAMED_CH
  prompt "P2"
  depends on OPT_ZZZ
  default E 
  config CH_E
    bool "Op E"
  config CH_D
    bool "Op D"
endchoice

choice SINGLE_DEF
  prompt "P3 - single"
  help 
    Some awesome help text nr. 2 
    that should be transformed 
  depends on OPT_AAA
  default CH_SD if OPT_BBB
  config CH_SD
    bool "CH_SD"
  config CH_SD2
    bool "CH_SD2"
  menuconfig MC_SD1
    bool "MC_SD"
  if OPT_CCC
   menuconfig MC_SD2
    bool "MC_SD"
  endif
endchoice
    
```

## test_dir_/transform_choice_output/Kconfig
```kconfig
mainmenu "Test (named) choice"

config OPT_Y
  bool "depends on OPT_Yn"

choice
  prompt "pick bool named choice"
  default CH_A 
  depends on OPT_Y
  depends on OPT_TTT
  default CH_C if OPT_BBB && OPT_AAA && OPT_ZZZ
  prompt "P1" if OPT_AAA && OPT_ZZZ
  default E if OPT_ZZZ
  prompt "P2" if OPT_ZZZ
  help 
    Some awesome help text  
    that should be transformed 
  config CH_A 
    bool "Op A"
  config CH_B
    bool "Op B"
  if OPT_DDD
  config CH_C
    bool "Op C" if OPT_AAA && OPT_ZZZ
  endif
  config CMC2
    bool "CMC2" if OPT_AAA && OPT_ZZZ
    depends on MC2
  config CMC3
    bool "CMC3" if OPT_AAA && OPT_ZZZ
    depends on MC2
  config CH_E
    bool "Op E" if OPT_ZZZ
  config CH_D
    bool "Op D" if OPT_ZZZ
endchoice
  menuconfig MCH_Z
    bool "MCH_Z"
    depends on OPT_Y
    depends on OPT_TTT
  menuconfig MC1
    bool "M"
    depends on OPT_AAA && OPT_ZZZ
  menuconfig MC2
    bool "MC2"
    depends on OPT_AAA && OPT_ZZZ

source "uo1/Kconfig"

choice 
  prompt "pick tristate choice"
  config CH_T1
    tristate "Op T1"
  config CH_T2
    tristate "Op T2"
endchoice
```

## test_dir_/transform_choice_output/uo1/Kconfig
```kconfig
config OPT_AAA 
  bool "Op AAA"
  default y

config OPT_BBB
  bool "Op BBB"

config OPT_CCC
  bool "Op CCC"

config OPT_DDD
  bool "if DDD"

config OPT_EEE
  bool "Op EEE"

config OPT_ZZZ
  bool "if OPT_ZZZ"

if OPT_ZZZ
endif


choice
  prompt "P3 - single"
  help 
    Some awesome help text nr. 2 
    that should be transformed 
  depends on OPT_AAA
  default CH_SD if OPT_BBB
  config CH_SD
    bool "CH_SD"
  config CH_SD2
    bool "CH_SD2"
  if OPT_CCC
   menuconfig MC_SD2
    bool "MC_SD"
  endif
endchoice
  menuconfig MC_SD1
    bool "MC_SD"
    depends on OPT_AAA
    
```

## test_dir_/transform_configdefault/Kconfig
```kconfig
mainmenu "Test configdefault"

config FOO
  bool "first Option"

config FOO
  def_bool n

source "uo1/*"
```

## test_dir_/transform_configdefault_output/Kconfig
```kconfig
mainmenu "Test configdefault"

config FOO
  bool "first Option"

config FOO
  def_bool n
  default n && CN && CY && U1
  default CY && U1
  default CY && AA && C && U1

source "uo1/Kconfig1"
```

## test_dir_/transform_def/Kconfig
```kconfig
mainmenu "Test def_*"

option MODULES
  def_bool y 
  option modules  

config OPTION1
  def_bool y
  prompt "option bool"

config OPTION2
  def_tristate m
  prompt "option tristate"

config OPTION1
  def_int 5
  prompt "option int"

config OPTION1
  def_bool y
  prompt "option 1"
```

## test_dir_/transform_def_output/Kconfig
```kconfig
mainmenu "Test def_*"

config MODULES
  def_bool y 
  modules

config OPTION1
  def_bool y
  prompt "option bool"

config OPTION2
  def_tristate n
  prompt "option tristate"

config OPTION3
  int
  default 5
  prompt "option int"

config OPTION4
  hex
  default 0x8000000
  prompt "option hex"

config OPTION5
  string
  default "text"
  prompt "option string"
```

## test_dir_/transform_option/Kconfig
```kconfig
mainmenu "Test option attr"

config MODULES
  def_bool y
  option modules

config OPTION_M
  def_tristate m
  prompt "Option with type tristate"

config OPTION_A
  string "set default through $()"  
  default "$(ENV_A)"

config OPTION_AA
  string "set default through option env"  
  option env="ENV_A"
```

## test_dir_/transform_source/uo2/Kconfig
```kconfig
source "uo1/Kconfig"
rsource "uo1/Kconfig"

comment "(o)source/(o)rsource"
osource "u06/Kconfig"
orsource "uo22/Kconfig"

comment "next subfolder"
source "uo3/K*"

comment "more wildcards"
source "uo5/[!CD]*"
```

## test_dir_/transform_source_output/uo2/Kconfig
```kconfig
source "uo1/Kconfig"
source "uo2/uo1/Kconfig"

comment "(o)source/(o)rsource"

comment "next subfolder"
source "uo3/Kconfig"
source "uo3/Kconfig1"
source "uo3/Kconfig2"
source "uo3/Kconfig3"
source "uo3/Kconfig41"

comment "more glob"
source "uo5/AKconfig"
source "uo5/BKconfig"
```

## test_dir_old/exp_conf_def_copy/Kconfig
```kconfig
config FOO
  bool "first Option"

config FOO
  bool
  default n
  default y if CN && CY && U1
  default CY if U1
  default CY && AA if C && U1

source "cf_u1/Kconfig1"
```
